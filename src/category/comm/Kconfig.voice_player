## src/category/comm/Kconfig.voice_player
```kconfig
menu "Voice Player Configuration"

config PA_DEVICE_NAME
	string "PA Device Name"
	default "gpioa"
	help
	  Specify the PA (Power Amplifier) device name.
	  Default is "gpioa".

config VOICE_PLAYER_DEFAULT_VOLUME
	int "Default system volume (0-100)"
	default 70
	range 0 100
	help
	  System volume used when no saved value exists in KV storage.
	  This is the initial volume before the user adjusts it.

endmenu
```

## src/category/mini/Kconfig
```kconfig
menu "category mini"

config MCP_TOOL_EMOJI
    bool "mcp tool emoji"
    default y
    help
        Enable mcp tool emoji

config MCP_TOOL_MODEL_PERSONA_UPDATE
    bool "mcp tool model persona update"
    default y
    help
        Enable mcp tool model persona update

config MCP_TOOL_SHOW_QRCODE
    bool "mcp tool show qrcode"
    default y
    help
        Enable mcp tool show qrcode

config MCP_TOOL_LOADING
    bool "mcp tool loading"
    default y
    help
        Enable mcp tool loading

endmenu
```

## src/middleware/Kconfig
```kconfig
menu "application middleware"

rsource "audio/Kconfig"
rsource "alarm/Kconfig"
rsource "battery/Kconfig"
rsource "button/Kconfig"
rsource "log_upload/Kconfig"
rsource "power/Kconfig"
rsource "tone/Kconfig"
rsource "usb/Kconfig"
rsource "vendor_storage/Kconfig"
rsource "ota/Kconfig"
rsource "sd_music/Kconfig"
endmenu
```

## src/middleware/alarm/Kconfig
```kconfig
menu "alarm"

config ALARM_TEXT_MAX_LEN
    int "Alarm text max length"
    default 384
    help
        Maximum buffer size, in bytes, reserved for alarm reminder text.

config ALARM_RING_DURATION_MS
    int "Alarm ring stop timeout (ms)"
    default 60000
    help
        Maximum duration for alarm ringing before auto-stop.

endmenu
```

## src/middleware/audio/Kconfig
```kconfig
menu "Audio PA Manager"

config PA_PORT
    int "PA GPIO PORT NUM"
    default 1
    range 0 1

config PA_PIN
    int "PA GPIO PIN"
    default 8
    range 0 31

config PA_FUNC
    int "PA PIN IOMUX FUNCTION NUM"
    default 1

endmenu
```

## src/middleware/battery/Kconfig
```kconfig
config BATTERY_COLLECTION
    bool "Enable battery data collection"
    default n
    depends on POWER_MANAGER

if BATTERY_COLLECTION

config BATTERY_COLLECTION_ADC_PAD
    string "Battery Voltage ADC Pad (\"gpioa\" or \"gpiob\")"
    default "gpioa"

config BATTERY_COLLECTION_ADC_CHANNEL
    int "Battery Voltage ADC Channel Number"
    default 3
    range 0 7

config BATTERY_COLLECTION_CHARGE_DETECT_PAD
    string "Battery Charge Detect GPIO Pad (\"gpioa\" or \"gpiob\")"
    default "gpiob"

endif
```

## src/middleware/button/Kconfig
```kconfig
config FLEXIBLE_BUTTON
    bool "Enable flexible button support"
    default n
    help
        Enable flexible button library for ADC button support.
        This provides multi-button detection using ADC voltage levels.
```

## src/middleware/gamepad/Kconfig
```kconfig
menu "Gamepad (WebSocket 手柄接入)"
    visible if APPLICATION_UI

config GAMEPAD_ENABLE
    bool "Enable WebSocket gamepad server (UDP discovery + WS key input)"
    default n

config GAMEPAD_WS_PORT
    int "WebSocket server port"
    default 38200
    depends on GAMEPAD_ENABLE

config GAMEPAD_DISCOVERY_PORT
    int "UDP discovery port"
    default 38201
    depends on GAMEPAD_ENABLE

config GAMEPAD_UDP_PORT
    int "UDP gamepad key input port"
    default 38202
    depends on GAMEPAD_ENABLE
    help
      Low-latency key input channel. The port is negotiated via the
      WebSocket welcome/announce messages (field "udp_port"); clients
      send full-state bitmap frames here while keeping WS for rom
      transfer / state / heartbeat.

endmenu

config GAMEPAD_BLE
    bool "CodexPad-S10 BLE gamepad (Central)"
    default n
    depends on GAMEPAD_ENABLE && BLE
    help
      Direct BLE connection to CodexPad-S10 gamepad: scan (name prefix +
      manufacturer data verification) -> connect (7.5~10ms low latency) ->
      GATT subscribe 0xFFA1 input frames -> merge into the NES input
      bitmap. Runs alongside the WiFi (WS/UDP) gamepad.
```

## src/middleware/log_upload/Kconfig
```kconfig
config LOG_UPLOAD
    bool "Enable business log upload"
    default n

if LOG_UPLOAD

config LOG_UPLOAD_BUFFER_CAPACITY_KB
    int "Log upload buffer capacity (KB)"
    default 512
    help
      Size of the local ring buffer used to retain recent business logs
      for on-demand upload.

endif
```

## src/middleware/ota/Kconfig
```kconfig
config OTA
    bool "Enable online resources update"
    default n

if OTA

config OTA_DISABLE_APP_UPDATE
    bool "Force disable app OTA update"
    default n

config OTA_DISABLE_WAKEWORD_UPDATE
    bool "Force disable wake word OTA update"
    default n

config OTA_DISABLE_TONE_UPDATE
    bool "Force disable prompt tone OTA update"
    default n

config OTA_DISABLE_EMOJI_UPDATE
    bool "Force disable emoji OTA update"
    default n

config OTA_MODEM_LOCK
    bool "Lock modem AT commands during flash erase"
    depends on LISA_MODEM
    default y
    help
      Pause AT command transmission and drain UART RX buffer before
      flash erase operations. This prevents data loss from interrupt
      latency during long (~1.3s) erase cycles.
      Disable only if no modem shares the flash erase path.

endif
```

## src/middleware/power/Kconfig
```kconfig
config POWER_MANAGER
    bool "Enable Power Manager"
    default n

if POWER_MANAGER

config POWER_MANAGER_POWER_EN_GPIO_PAD
    string "Power Enable GPIO Pad (\"gpioa\" or \"gpiob\")"
    default "gpiob"

config POWER_MANAGER_POWER_KEY_GPIO_PAD
    string "Power Key GPIO Pad (\"gpioa\" or \"gpiob\")"
    default "gpiob"

config POWER_MANAGER_USB_DETECT_GPIO_PAD
    string "USB Detect GPIO Pad (\"gpioa\" or \"gpiob\")"
    default "gpiob"

endif
```

## src/middleware/sd_music/Kconfig
```kconfig
config MIDDLEWARE_SD_MUSIC
    bool "SD card offline music middleware"
    depends on FILE_SYSTEM
    depends on FATFS_FILESYSTEM
    depends on LSFS
    depends on LSFS_FAT
    depends on DISK_DRIVER_SDMMC
    select FATFS_FFCONF_OVERRIDE
    default y
    help
      Core middleware for SD card offline music support:
      - File scanning (MP3 detection, ID3v1 parsing)
      - Card hotplug detection and management
      - Cloud upload of card events and file metadata

      This middleware is consumed by service_sd_music (apps/arcs-mini/services).
      It also enables the FatFs ffconf override used for UTF-8 Chinese file
      names. The app must point CONFIG_FATFS_FFCONF_NAME to the sd_music
      override header.
```

## src/middleware/sip/Kconfig
```kconfig
config MIDDLEWARE_SIP
    bool "LAN SIP video call middleware"
    depends on LWIP
    default n
    help
      Self-implemented minimal SIP stack plus G.711 audio and MJPEG/RTP
      video, used for LAN peer-to-peer video calls between the device
      and a host program built from the same core sources
      (src/middleware/sip/host builds sip_peer on Ubuntu).

      - core/ is pure C (BSD sockets via sip_osal only) and is shared
        verbatim between the firmware and the host peer.
      - device/sip_service.c owns FreeRTOS tasks, the audio tap, the
        camera/JPEG pipeline and the call focus channel.

      Enable together with WIFI and LWIP in the application config.
```

## src/middleware/tone/Kconfig
```kconfig
menu "Tone Manager"

config TONE
    bool "Enable Tone Manager"
    default y
    help
      Enable tone manager for playing system audio prompts.
      This module provides tone playback functionality for
      system notifications and user feedback.

endmenu
```

## src/middleware/usb/Kconfig
```kconfig
menu "Application usb menu"

config APP_USB_AUDIO_ENABLE
    bool "Enable usb audio device"
    depends on TINY_USB || (CHERRYUSB && CHERRYUSB_DEVICE_AUDIO)
    default n

config APP_USB_CDC_ENABLE
    bool "Enable usb cdc device"
    depends on TINY_USB
    default n

config APP_USB_ROLE_DETECT
    bool "Enable automatic hardware USB role switching"
    depends on BOARD_ARCS_MINI3 && LISA_I2C1
    depends on CHERRYUSB && CHERRYUSB_DEVICE && CHERRYUSB_HOST
    default n
    help
        Read the USB-C role controller on the Mini 3 I2C1 bus. STATUS bit 0
        reports connection state; TYPE bit 3 selects Host/Source and bit 4
        selects Device/Sink.

if APP_USB_ROLE_DETECT

choice
    prompt "USB role detection mode"
    default APP_USB_ROLE_DRP

config APP_USB_ROLE_DRP
    bool "Enable Dual Role Port (DRP) mode"
    default y

config APP_USB_ROLE_HOST_ONLY
    bool "Enable Host Only mode"
    default n

config APP_USB_ROLE_DEVICE_ONLY
    bool "Enable Device Only mode"
    default n

endchoice

endif

endmenu
```

## src/middleware/vendor_storage/Kconfig
```kconfig
menu "MAC Address Storage"

choice MAC_STORAGE_METHOD
    prompt "MAC Address Storage Method"
    default MAC_EFUSE_ENABLE
    help
      Select the method for storing WiFi MAC address.
      - eFuse: Use SDK eFuse interface (recommended for production)
      - Vendor Storage: Use Flash vendor storage partition

    config MAC_EFUSE_ENABLE
        bool "Use eFuse for MAC storage"
        help
          Use SDK eFuse interface to read MAC address.
          MAC is written during factory test and stored in eFuse.
          Priority: Flash fixzone > eFuse > NVS (random).

    config VENDOR_STORAGE_ENABLE
        bool "Use Vendor Storage for MAC storage"
        help
          Use Flash vendor storage partition to store MAC address.
          MAC can be written at runtime.
endchoice

if VENDOR_STORAGE_ENABLE
    config VENDOR_STORAGE_SIZE
        int "Vendor storage size"
        default 4096
        help
          Set the size of the vendor storage in bytes.

    config VENDOR_STORAGE_OFFSET
        hex "Vendor storage offset"
        default 0x3E000
        help
          Set the offset for the vendor storage in bytes.
endif

endmenu
```

## src/server/Kconfig
```kconfig
config SERVER_VOICE_LSCHAT
    bool "Enable LSCHAT Voice Server"
    default n

if SERVER_VOICE_LSCHAT

config APP_WAKEUP_ENABLE
    bool "Enable wake word (wakeup engine)"
    default y
    help
      Master switch for wake word functionality. When disabled, platform
      init skips loading wakeup algo resources and never calls
      app_wakeup_init(): no mic capture / wakeup engine / AEC reference
      playback occupation. Related entry points (standby, sensitivity,
      wake word OTA stop) degrade to no-ops.

config APP_VOICE_OUTPUT_ENABLE
    bool "Enable voice output (prompt tones + TTS)"
    default y
    help
      Master switch for speech output. When disabled, voice_player_tone_submit
      and voice_player_tts_submit_url return immediately: no prompt tones
      (network success / netcfg guide / wakeup / OTA ...) and no LLM TTS
      playback. Music player is not affected. Useful when the product path
      owns audio0 (e.g. NES game) and any interleaved prompt would fight
      over the audio stream (distortion).

config MCP_TOOL_EMOJI_ENABLE
    bool "Enable emoji tool"
    default n

config MCP_TOOL_CAMERA_ENABLE
    bool "Enable camera tool"
    default n

config LSCHAT_WAKEUP_CLOUD_NOISE_GATE_THRESHOLD
    int "Wakeup cloud audio noise gate threshold"
    default 128
    range 0 32767
    help
      Samples whose absolute amplitude is below this threshold are muted
      before wakeup output audio is sent to cloud ASR.

endif

config AUDIO_DEFAULT_MIC_GAIN_A_DB
    int "Default analog microphone gain (dB)"
    default 0
    range -12 36

config AUDIO_DEFAULT_MIC_GAIN_D_DB
    int "Default digital microphone gain (dB)"
    default 0
    range -83 42

config AUDIO_DEFAULT_REF_GAIN_A_DB
    int "Default analog reference gain (dB)"
    default 0
    range -12 36

config AUDIO_DEFAULT_REF_GAIN_D_DB
    int "Default digital reference gain (dB)"
    default 0
    range -83 42

config AUDIO_DEFAULT_SPK_GAIN_A_DB
    int "Default analog speaker gain (dB)"
    default -6
    range -24 6

config AUDIO_DEFAULT_SPK_GAIN_D_DB
    int "Default digital speaker gain (dB)"
    default 0
    range -113 30
```
