## modules/lschat/samples/session_voice/chat_draw/testcase.yaml
```yaml
tests:
  samples.session_voice.chat_draw.linux:
    tags: linux
    build_only: true
```

## modules/lschat/samples/session_voice/chat_music/testcase.yaml
```yaml
tests:
  samples.session_voice.chat_music.linux:
    tags: linux
    build_only: true
```

## modules/lschat/samples/session_voice/chat_vlume/testcase.yaml
```yaml
tests:
  samples.session_voice.chat_volume.linux:
    tags: linux
    build_only: true
```

## modules/lschat/samples/session_voice/chat_weather/testcase.yaml
```yaml
tests:
  samples.session_voice.chat_weather.linux:
    tags: linux
    build_only: true
```

## modules/lschat/samples/session_voice_encode/ico_encode/testcase.yaml
```yaml
tests:
  samples.session_voice_encode.ico_encode.linux:
    tags: linux
    build_only: true
```

## modules/lschat/samples/session_voice_encode/speex-nb_encode/testcase.yaml
```yaml
tests:
  samples.session_voice_encode.speex-nb_encode.linux:
    tags: linux
    build_only: true
```

## modules/lschat/samples/session_voice_encode/speex-wb_encode/testcase.yaml
```yaml
tests:
  samples.session_voice_encode.speex-wb_encode.linux:
    tags: linux
    build_only: true
```

## modules/lschat/tests/session_request_tests/testcase.yaml
```yaml
tests:
  tests.session_request_tests..linux:
    tags: linux
    build_only: true
```

## modules/lschat/tests/session_voice_encode_tests/testcase.yaml
```yaml
tests:
  tests.session_voice_encode_tests..linux:
    tags: linux
    build_only: true
```

## modules/lschat/west.yml
```yaml
manifest:
  remotes:
    - name: listenai
      url-base: https://cloud.listenai.com/zephyr
  projects:
    - name: csk
      remote: listenai
      revision: bugfix/sleep_api_conflict
      path: csk
      import:
        file: west.yml
        name-allowlist:
          - zephyr
          - cmsis
          - mbedtls
          - csk6_cm33
          - protobuf-c
          - esp-hosted
          - littlefs
          - wifi_manager
          - tinycrypt
    - name: lisa
      path: modules/lisa
      url: https://cloud.listenai.com/CSKG836746/lisa.git
      submodules: true
      revision: 069cebcaafbc017be0e516a6f90757fc6f5f530c
```

## src/Kconfig
```kconfig
rsource "category/Kconfig"
rsource "server/Kconfig"
rsource "middleware/Kconfig"
```

## src/category/Kconfig
```kconfig
menu "Application cateory"

choice APPLICATION_CATEORY
    prompt "Select Application cateory"

    default CATEGORY_YUBA

    config CATEGORY_YUBA
        bool "Yuba"

    config CATEGORY_EVB
        bool "evb board"

    config CATEGORY_MINI
        bool "mini board"

endchoice

orsource "comm/Kconfig"
orsource "evb/Kconfig"
orsource "mini/Kconfig"
orsource "yuba/Kconfig"

endmenu
```

## src/category/comm/Kconfig
```kconfig
config APP_WAKE_WORD_DEFAULT
    string "Default wake word text"
    default "小聆小聆"
    help
        Default text used by the UI and voice chat when no OTA wake word
        is stored. Keep it consistent with the board's bundled resources.

config ROMFS_IMAGE_ADDR
    hex "Address of romfs iamge"
    default 0x30100000

config ROMFS_IMAGE_SIZE
    hex "Size of romfs iamge"
    default 0x700000

rsource "Kconfig.rcmd"
rsource "Kconfig.cloud"
rsource "Kconfig.voice_player"
```

## src/category/comm/Kconfig.cloud
```kconfig
menu "Cloud Service Configuration"

config CLOUD_PRODUCT_ID_DEFAULT
    string "Cloud Product ID"
    default "xxxxxxxx-xxxx-xxxx-xxxx-xxxxxxxxxxxx"
    help
        The Product ID assigned by the cloud service for this device.

config CLOUD_SECRET_ID_DEFAULT
    string "Cloud Secret ID"
    default "xxxxxxxx-xxxx-xxxx-xxxx-xxxxxxxxxxxx"
    help
        The Secret ID assigned by the cloud service for this device.

config CLOUD_FULL_DUPLEX_ENABLE
    bool "Enable Full Duplex Mode"
    default n
    help
        Enable or disable full duplex communication with the cloud service.
        When enabled, the device can send and receive audio data simultaneously.

if CLOUD_FULL_DUPLEX_ENABLE

config CLOUD_FULL_DUPLEX_TIMEOUT_MS
    int "Full Duplex Timeout (ms)"
    default 90000
    help
        Timeout value in milliseconds for full duplex communication.
        If no activity is detected within this timeout period, the full duplex
        session will be terminated.
endif

config CLOUD_IDLE_EXIT_TIMEOUT_MS
    int "Idle Exit Timeout (ms)"
    default 10000
    help
        Local business timeout in milliseconds.
        After TTS playback ends, if no valid IAT text is received within this
        timeout, the device will actively exit the current session.

config CLOUD_STAGING_MODE_ENABLE
    bool "Enable Staging Mode"
    default n
    help
        Enable or disable staging mode for testing purposes.
        When enabled, the device will connect to the staging environment
        of the cloud service instead of the production environment.
endmenu
```

## src/category/comm/Kconfig.rcmd
```kconfig
menu "Recognize Command Router Configuration"

choice RCMD_ROUTER_STRATEGY
    prompt "Command router strategy"
    default RCMD_ROUTER_STRATEGY_ONLINE_FIRST
    help
        Select the routing strategy for voice commands:
        - ONLINE_FIRST: Prefer online recognition, fall back to offline when device is offline
        - OFFLINE_ONLY: Only process offline recognition results
        - TIMEOUT_FALLBACK: Cache offline command and wait for online result with timeout

    config RCMD_ROUTER_STRATEGY_ONLINE_FIRST
        bool "Online first"
        help
            Process online results with priority. When device is online, ignore offline
            results and wait for online recognition. When device is offline, process
            offline results immediately.

    config RCMD_ROUTER_STRATEGY_OFFLINE_ONLY
        bool "Offline only"
        help
            Only process offline voice recognition results. Online results are ignored.
            This mode is useful for fully offline scenarios.

    config RCMD_ROUTER_STRATEGY_TIMEOUT_FALLBACK
        bool "Timeout fallback"
        help
            Cache offline command and wait for online result. If online result arrives
            before timeout, process online result and invalidate cached offline command.
            If timeout occurs, process the cached offline command.
endchoice


if RCMD_ROUTER_STRATEGY_TIMEOUT_FALLBACK

config RCMD_ROUTER_ONLINE_TIMEOUT_MS
    int "Online command timeout (ms)"
    default 3000
    range 100 10000
    depends on RCMD_ROUTER_STRATEGY_TIMEOUT_FALLBACK
    help
        Timeout value in milliseconds for waiting online command result.
        Only applicable when TIMEOUT_FALLBACK strategy is selected.
        If no online result arrives within this timeout, the cached offline
        command will be executed.
endif
endmenu
```
