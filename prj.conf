## CMakeLists.txt
```
cmake_minimum_required(VERSION 3.13)

set(CMAKE_EXPORT_COMPILE_COMMANDS ON)

find_package(listenai-cmake REQUIRED HINTS $ENV{ARCS_BASE})

project(aiui)

include(version.cmake)

add_definitions(-DCONFIG_EXT_RAM)

# Cloud provider selection
if(CONFIG_XIAOZHI_CLOUD)
    add_definitions(-DXIAOZHI_CLOUD)
    message(STATUS "Using XIAOZHI_CLOUD (Xiaozhi cloud service)")
elseif(CONFIG_MY_CLOUD)
    add_definitions(-DMY_CLOUD)
    message(STATUS "Using MY_CLOUD (self-hosted server)")
elseif(CONFIG_LISTEN_CLOUD)
    add_definitions(-DLISTEN_CLOUD)
    message(STATUS "Using LISTEN_CLOUD (AIUI)")
else()
    # Default to XIAOZHI_CLOUD if none is specified
    add_definitions(-DXIAOZHI_CLOUD)
    message(STATUS "Using XIAOZHI_CLOUD (Xiaozhi cloud service) - default")
endif()

# Add project root directory to include path for app-config-tls-generic.h and memap.h
listenai_include_directories(${CMAKE_CURRENT_SOURCE_DIR})

add_subdirectory(src)
add_subdirectory(modules)

listenai_add_executable(${PROJECT_NAME})

target_link_options(${PROJECT_NAME} PRIVATE
    -Wl,--wrap,gettimeofday
    -Wl,--wrap,time
    -Wl,--wrap,gmtime_r
)
```

## Kconfig
```
config FLEXIBLE_BUTTON
    bool "Flexible Button"
    default n

config BATTERY_COLLECTION
    bool "Battery Collection"
    default n

config LOW_WIFI_CLI
    bool "Low Wifi Cli"
    default n

config LSPLATFORM_DEFAULT_PRODUCT_ID
    string "LSPlatform default product id"
    default "cf75e7a9-66b6-41e3-918a-141800aebb5b"

config LSPLATFORM_DEFAULT_SECRET_ID
    string "LSPlatform default secret id"
    default "e354f1f0-34e5-488f-8ef2-f6db2a44c815"

config DEFAULT_MIC_GAIN
    int "Default mic gain"
    range 0 100
    default 80

config DEFAULT_AEC_GAIN
    int "Default aec gain"
    range 0 100
    default 0

config DEFAULT_VOLUME
    int "Default volume"
    range 0 100
    default 70

choice CLOUD_PROVIDER
    prompt "Cloud Provider Selection"
    default XIAOZHI_CLOUD

config LISTEN_CLOUD
    bool "ListenAI Cloud (AIUI)"
    help
      Use ListenAI AIUI cloud service.

config MY_CLOUD
    bool "Self-hosted Cloud Server"
    help
      Use self-hosted cloud server with separate ASR/LLM/TTS services.

config XIAOZHI_CLOUD
    bool "Xiaozhi Cloud Service"
    help
      Use Xiaozhi cloud service for voice assistant.

endchoice

config MY_CLOUD_HOST
    string "Self-hosted Cloud Server Host"
    default "192.168.1.169"
    depends on MY_CLOUD
    help
      The host address of the self-hosted cloud server.

config XIAOZHI_CLOUD_HOST
    string "Xiaozhi Cloud Server Host"
    default "api.tenclass.net"
    depends on XIAOZHI_CLOUD
    help
      The host address of the Xiaozhi cloud server.

config XIAOZHI_CLOUD_PATH
    string "Xiaozhi Cloud Path"
    default "/xiaozhi/v1/"
    depends on XIAOZHI_CLOUD
    help
      The path for Xiaozhi cloud WebSocket API.

config XIAOZHI_CLOUD_USE_SSL
    bool "Use SSL for Xiaozhi Cloud"
    default y
    depends on XIAOZHI_CLOUD
    help
      Enable SSL/TLS for secure connection to Xiaozhi cloud.

rsource "$LISTENAI_MODULES"
rsource "modules/Kconfig"
```

## prj.conf
```kconfig
# 项目可根据需要在此文件中设置对应的配置
CONFIG_ARCS_HAL_WARNING_DISABLE=y
CONFIG_SDK_MODULE_EASYLOGGER=y
CONFIG_EASYLOGGER_LINE_BUF_SIZE=4096
CONFIG_EASYLOGGER_ASYNC_BUF_SIZE=20480
CONFIG_BOOT_HART=n

# Cloud provider selection
# MY_CLOUD=y enables self-hosted server (ASR:9200, LLM:9400, TTS:9300)
# LISTEN_CLOUD=y enables ListenAI AIUI service
# XIAOZHI_CLOUD=y enables Xiaozhi cloud service
# CONFIG_MY_CLOUD=y
# CONFIG_LISTEN_CLOUD=y
CONFIG_XIAOZHI_CLOUD=y

# Self-hosted cloud server configuration
CONFIG_MY_CLOUD_HOST="192.168.1.100"

# Xiaozhi cloud configuration
# CONFIG_XIAOZHI_CLOUD_HOST="api.tenclass.net"
# CONFIG_XIAOZHI_CLOUD_PATH="/xiaozhi/v1/"
# CONFIG_XIAOZHI_CLOUD_USE_SSL=1

# CONFIG_ARCS_HAL_DEBUG=y
CONFIG_MODULE_FREERTOS=y
CONFIG_MODULE_HEAP=y
CONFIG_LINK_OPTION_NOSYS_SPECS=y
CONFIG_FREERTOS_STATIC_ALLOCATION_ENABLE=y

CONFIG_ARCS_CP_CORE=y
#using mbedtls for hardware decoding(IF CONFIG_WX_SQLITE3_HARD_CODEC)
CONFIG_SDK_MODULE_MBEDTLS=y
CONFIG_CUSTOM_MBEDTLS_CFG_FILE=y
CONFIG_MBEDTLS_CFG_FILE="app-config-tls-generic.h"
CONFIG_MBEDTLS_HARDWARE_ENTROPY=y
# CONFIG_MBEDTLS_HARDWARE_AES=y
# CONFIG_MBEDTLS_HARDWARE_SHA1=y
# CONFIG_MBEDTLS_HARDWARE_SHA256=y
# CONFIG_MBEDTLS_HARDWARE_SHA512=y
# CONFIG_MBEDTLS_HARDWARE_AES_CCM=y
# CONFIG_MBEDTLS_HARDWARE_AES_GCM=y
# CONFIG_MBEDTLS_HARDWARE_ECC=y

# System support
CONFIG_MBEDTLS_HAVE_ASM=y
CONFIG_MBEDTLS_HAVE_TIME_DATE=y
CONFIG_MBEDTLS_SSL_ALPN=y

# Save RAM at the expense of ROM
CONFIG_MBEDTLS_AES_ROM_TABLES=y
# mbed TLS feature support
CONFIG_MBEDTLS_CIPHER_MODE_CBC_ENABLED=y
CONFIG_MBEDTLS_KEY_EXCHANGE_RSA_ENABLED=y
CONFIG_MBEDTLS_KEY_EXCHANGE_ECDHE_RSA_ENABLED=y
# Supported TLS versions
CONFIG_MBEDTLS_TLS_VERSION_1_0=y
CONFIG_MBEDTLS_TLS_VERSION_1_1=y
CONFIG_MBEDTLS_TLS_VERSION_1_2=y
# mbed TLS modules
CONFIG_MBEDTLS_CIPHER_AES_ENABLED=y
CONFIG_MBEDTLS_CIPHER=y
CONFIG_MBEDTLS_CTR_DRBG_ENABLED=y
CONFIG_MBEDTLS_ENTROPY_ENABLED=y
CONFIG_MBEDTLS_MD=y
CONFIG_MBEDTLS_MAC_MD5_ENABLED=y
CONFIG_MBEDTLS_HASH_MD5_ENABLED=y
CONFIG_MBEDTLS_MAC_SHA1_ENABLED=y
CONFIG_MBEDTLS_HASH_SHA1_ENABLED=y
CONFIG_MBEDTLS_MAC_SHA256_ENABLED=y
CONFIG_MBEDTLS_SHA256_SMALLER=y
CONFIG_MBEDTLS_HASH_SHA256_ENABLED=y
CONFIG_MBEDTLS_DTLS=y
CONFIG_MBEDTLS_SERVER_NAME_INDICATION=y
CONFIG_MBEDTLS_ECDH_C=y
CONFIG_MBEDTLS_ECP_C=y
CONFIG_MBEDTLS_CIPHER_GCM_ENABLED=y
CONFIG_MBEDTLS_ECP_DP_SECP256R1_ENABLED=y
CONFIG_MBEDTLS_MAC_SHA512_ENABLED=y
CONFIG_MBEDTLS_HASH_SHA512_ENABLED=y
CONFIG_MBEDTLS_PEM_CERTIFICATE_FORMAT=y
CONFIG_MBEDTLS_SSL_MAX_CONTENT_LEN=16384
CONFIG_MBEDTLS_CTR_DRBG_ENABLED=y

# CONFIG_MBEDTLS_DEBUG=y

CONFIG_MBEDTLS_INTERNAL_MEM_ALLOC=n
CONFIG_MBEDTLS_EXTERNAL_MEM_ALLOC=y

CONFIG_LWIP=y
CONFIG_WIFI=y

CONFIG_ARCS_HAL_WLIF=y
CONFIG_ARCS_HAL_EVENT=y
CONFIG_ARCS_HAL_CLI_CMD=y
CONFIG_ARCS_HAL_MODULE_SHELL=y
CONFIG_ARCS_HAL_UTILS=y

CONFIG_MODULE_ZE_TLS=y
CONFIG_MODULE_HTTPCLIENT=y
CONFIG_MODULE_NOPOLL=y
CONFIG_MODULE_CORESNTP=y
CONFIG_LWIP_OPTION_SO_REUSE=y
CONFIG_LWIP_OPTION_LWIP_DNS=y

CONFIG_MEM_CONFIG=n
CONFIG_MEM_CONFIG_USE_CUSTOM_FILE=y

CONFIG_MEM_CONFIG=n
CONFIG_MEM_CONFIG_USE_CUSTOM_FILE=y
CONFIG_HEAP_SIZE=0x5e00
CONFIG_BACK_TRACE=y

CONFIG_PSRAM_HEAP_SIZE=0x400000

CONFIG_DCACHE_ENABLE=y

# 使能collection-c
CONFIG_SDK_MODULE_COLLECTIONS_C=y

CONFIG_CORE_SPINLOCK=n

CONFIG_CJSON=y

CONFIG_SDK_MODULE_EASYFLASH=y

CONFIG_SDK_MODULE_LETTER_SHELL=y
CONFIG_SDK_MODULE_LETTER_SHELL_CONFIG_FILE="shell_cfg_user.h"


CONFIG_TINY_USB=y
CONFIG_TINY_USB_USE_CUSTOM_CONFIG_FILE=y
CONFIG_TINY_USB_CONFIG_FILE="tusb_config.h"


# 文件系统配置
CONFIG_FILE_SYSTEM=y
CONFIG_FATFS_FILESYSTEM=y

# DISK驱动使能
CONFIG_DISK_DRIVER=y

# DISK SDMMC驱动使能及配置
CONFIG_DISK_DRIVER_SDMMC=y

# DISK FLASH驱动使能及配置
CONFIG_DISK_DRIVER_FLASH=y
CONFIG_DISK_FLASH_START_ADDR=0xF00000
CONFIG_DISK_FLASH_MAX_RW_SIZE=4096
CONFIG_DISK_FLASH_ERASE_ALIGNMENT=4096
CONFIG_DISK_FLASH_ERASE_BLOCK_SIZE=4096
CONFIG_DISK_FLASH_SECTOR_SIZE=4096
CONFIG_DISK_FLASH_VOLUME_SIZE=1048576

# 抽象文件系统
CONFIG_LSFS=y
CONFIG_LSFS_FAT=y
CONFIG_TUSB_APP_CLASS=y
CONFIG_ADB_SYNC=y
CONFIG_ADB_SHELL=y
CONFIG_ADB_SHELL_BUFFER_SIZE=1024
CONFIG_ADB_PUSH_PULL_DEFAULT_ROOT="/SD:/adb/"
# DISK驱动使能
CONFIG_DISK_DRIVER=y


# 抽象文件系统
CONFIG_LSFS=y
CONFIG_LSFS_FAT=y
CONFIG_FS_ENV_MEMORY_MANAGEMENT_USE_PSRAM=y
#WIFI MANAGER

CONFIG_WIFI_MANAGER=y

CONFIG_LISA_PORTING=y

CONFIG_EASYLOGGER_USE_POSIX_TIME=y
CONFIG_SDK_MODULE_COREHTTP=y
CONFIG_SDK_MODULE_SPEEXDSP=y
CONFIG_SDK_MODULE_MEMPOOL=y

CONFIG_SDK_MODULE_CURL=n
CONFIG_WIFI_MGR_NVS_PARTITION_OFFSET=0xff0000

CONFIG_LISA_DISPLAY=y
CONFIG_LISA_DISPLAY_ST7789P3=y
CONFIG_LISA_DISPLAY_TE_SYNC=y
CONFIG_LISA_DISPLAY_CPDMA_ROTATE=y
CONFIG_LISA_DISPLAY_INTERFACE_SPI_4_LINE=y
CONFIG_DISPLAY_ST7789P3_WIDTH=240
CONFIG_DISPLAY_ST7789P3_HEIGHT=240
CONFIG_DISPLAY_ST7789P3_X_OFFSET=0

CONFIG_LISA_TOUCH=y
CONFIG_LISA_TOUCH_CST328=y

CONFIG_SDK_MODULE_LVGL8=y
CONFIG_LV_DEMO_SYS_HEAP=y

CONFIG_LVGL_USE_INDEPENDENT_HEAP=y
CONFIG_LVGL_HEAP_SIZE=0x100000

CONFIG_LV_DRIVER_PIXEL_ALIGN_SIZE=16
CONFIG_LV_USE_DEMO_WIDGETS=y
CONFIG_LV_USE_GPU_CSK_DMA2D=y
CONFIG_LV_DOUBLE_VDB=y
CONFIG_LV_USE_PERF_MONITOR=n
CONFIG_LV_DRIVER_FULL_REFRESH=y
CONFIG_LV_CUSTOM_MONITOR=n
CONFIG_LV_REFR_UNCONDITIONAL_AREA_JOIN=y
CONFIG_LV_DRIVER_ROTATE_90=y
CONFIG_LV_CONF_SKIP=n
CONFIG_LV_USE_RPC=n
CONFIG_LV_USE_RPC_THRESHOLD=8000
CONFIG_LV_CUSTOM_TASK_CPU_PER=n
CONFIG_LV_IMG_CACHE_DEF_SIZE=1

CONFIG_LS_LV_INDEV_TASK_FILTERING=y
CONFIG_LS_LV_INDEV_TASK_PRIO=5
CONFIG_LS_LV_INDEV_TASK_STACK_SIZE=1024
CONFIG_LS_LV_INDEV_TASK_QUEUE_SIZE=4
CONFIG_LV_INDEV_DEF_SCROLL_THROW=4
CONFIG_LV_FONT_FMT_TXT_LARGE=y


# CONFIG_EASYLOGGER_LOG_LEVEL_DEBUG=y

CONFIG_ARCS_HAL_LSF=y
CONFIG_IPC_LSF=y
CONFIG_LSF_CLIENT=y

CONFIG_WIFI_MANAGER=y

CONFIG_MAC_MANAGER=y
CONFIG_MAC_MANAGER_MAC_BY_CHIP_ID=y

CONFIG_LISA_TOUCH_I2C_SPINLOCK=n
CONFIG_SDK_MODULE_MP3_DECODER=y
CONFIG_SDK_MODULE_AAC_DECODER=y
CONFIG_ARCS_HAL_DCACHE_COHERENT=n
CONFIG_FREERTOS_FAST_FUNC_SECTION=".text"

CONFIG_LISA_PORTING=y
CONFIG_LISA_OS=y
CONFIG_LISA_KV=y
CONFIG_LISA_NETWORK=y
CONFIG_SDK_MODULE_SPEEXDSP=n
CONFIG_SDK_MODULE_LISA_PLAYER=y
CONFIG_SDK_MODULE_RESAMPLE=n
CONFIG_SDK_MODULE_SPEEXDSP=y
CONFIG_LISA_PORTING=y
CONFIG_LOG=y
CONFIG_DISK_MEM=n
CONFIG_DISK_MEM_SERVER=n
CONFIG_LISA_DISPLAY_INTERFACE_SPI_4_LINES=y
CONFIG_LOG_MODE_ASYNC=y

CONFIG_BOOT=n

CONFIG_LWIP=y
CONFIG_WIFI=y
CONFIG_WIFI_LWIP_SAME_CORE=y
CONFIG_LWIP_OPTION_LWIP_DNS=y
CONFIG_LWIP_OPTION_SO_REUSE=y
CONFIG_LOW_WIFI_CLI=y

CONFIG_ARCS_HAL_WCND_GPADC_IC_MUTEX=n
CONFIG_ARCS_HAL_IC_MUTEX=n

CONFIG_LISAUI=y
CONFIG_EBUS=y

# camera
CONFIG_COMPONENT_CAMERA=y
CONFIG_CAMERA_INTERFACE_DVP=y
CONFIG_BF3901_SUPPORT=n
CONFIG_GC0328_SUPPORT=y

#GPDMA
CONFIG_ARCS_GPDMA_DATA_ONLY=y
CONFIG_LWIP_TX_BUF_COPY=y
CONFIG_WIFI_TX_BUF_COPY=y

CONFIG_ARCS_HAL_WCND_RF_SELFCALI_FROM_NV=n
CONFIG_LISA_FLASH_MSG=y
CONFIG_BATTERY_COLLECTION=y
CONFIG_FLEXIBLE_BUTTON=y

CONFIG_ARCS_HAL_IPC=y
CONFIG_ARCS_HAL_FLASH_IF=y
CONFIG_ARCS_HAL_IPC_FLASH_AGENT=y
CONFIG_ARCS_HAL_IPC_HALT_PEER_CORE=y

CONFIG_ARCS_HAL_NVS=y
CONFIG_BLE=y
CONFIG_BLE_PROFILE_HOGPD=y
CONFIG_BLE_PROFILE_NETCFG_BLES=y
CONFIG_BLE_PROFILE_BASS=y

CONFIG_LISA_KV_TYPE_EF=y
CONFIG_ADB_SYNC=n
CONFIG_SYSLOG_PRINTK_REDIRECT=n
CONFIG_SYSLOG_PRINTF_REDIRECT=n
CONFIG_COMPILE_OPTION_WARNING_AS_ERROR=y
CONFIG_LISA_DISPLAY_COLOR_INVERT=y
CONFIG_SDK_MODULE_ICO=y

CONFIG_BOARDS_CHOICE_ARCS_MINI=y

# Enable IJG JPEG library for photo recognition
CONFIG_SDK_MODULE_IJG=y
```

## src/main.c
```c
#define TAG "main"

#include <stdio.h>
#include "lisa_kv.h"
#include "lisa_log.h"
#include "wifi_manager/wifi_manager.h"
#include "lisa_typedef.h"
#include "lisa_thread.h"
#include "pa_manager.h"
#include "FreeRTOSConfig.h"
#include "app_player.h"
#include "evs_utils.h"
#include "sysheap.h"
#include "listen_system.h"
#include "listen_mic_gain.h"
#include "app_tone.h"
#include "tone.h"
#include "listen_flash.h"
#include "app_client.h"
#ifdef XIAOZHI_CLOUD
#include "xiaozhi/xz_cloud.h"
#endif
#include "listen_wifi.h"
#include "assistant_controller.h"
#include "assistant_view.h"
#include "ic_message.h"
#include "cJSON.h"
#include "esp_heap_caps.h"
#include "project_version.h"
#include "config_parser.h"
#include "Driver_WDT.h"
#include "chip.h"
#include "nvs.h"
#include "power/power_manager.h"
#include "lisa_display.h"
#include "lisa_aiui.h"
#include "bt_app_if.h"
#include "alarm_next.h"
#include "alarm_ring.h"

#if (CONFIG_FLEXIBLE_BUTTON)
#include "lisa_btn.h"

#endif
#include "lisa_kv.h"

// #include "video_camera.h"

#include "IOMuxManager.h"
#include "Driver_GPIO.h"

#include "lsfs.h"
#include "listen_volume.h"
#include "led.h"
#include "assistant_controller.h"
#include "video_camera.h"
#include "lisaui_manager.h"
#include "user_groups.h"
#include "controller/apps/groups/llm/launcher/pages/launcher_pages.h"
#include "controller/apps/groups/llm/launcher/group_launcher.h"

// 是否使用Litedac
// 需要配合lisaplayer的arcs_track.c中的配置项同步修改
#define ARCS_DAC_USE_LITE_DAC (1)

// BLE广播启动重试配置
#define BLE_ADV_START_MAX_RETRIES (5)
#define BLE_ADV_START_RETRY_DELAY_MS (100)

/**
 * @brief Factory reset function - to be implemented by user
 */
static void factory_reset(void)
{
    printf("\n=== Starting Factory Reset ===\n");

    // Clear WiFi configurations
    printf("Clearing WiFi configurations...\n");
    int ret1 = lisa_kv_del("wifi-info-count");
    int ret2 = lisa_kv_del("wifi-list");
    printf("  - wifi-info-count delete: %s\n", ret1 == 0 ? "Success" : "Failed");
    printf("  - wifi-list delete: %s\n", ret2 == 0 ? "Success" : "Failed");

    // Delete user credentials
    printf("Deleting user credentials...\n");
    int ret3 = lisa_kv_del("user.pid");
    int ret4 = lisa_kv_del("user.sid");
    int ret5 = lisa_kv_del("user.volume");
    int ret6 = lisa_kv_del("user.mic_gain");
    int ret7 = lisa_kv_del("user.aec_gain");

    printf("  - user_pid delete: %s\n", ret3 == 0 ? "Success" : "Failed");
    printf("  - user_sid delete: %s\n", ret4 == 0 ? "Success" : "Failed");
    printf("  - user_token delete: %s\n", ret5 == 0 ? "Success" : "Failed");
    printf("  - user_mic_gain delete: %s\n", ret6 == 0 ? "Success" : "Failed");
    printf("  - user_aec_gain delete: %s\n", ret7 == 0 ? "Success" : "Failed");

    // Add any additional reset operations here
    
    printf("=== Factory Reset Completed ===\n\n");
}

static void network_reset(void)
{
    printf("\n=== Starting Network Reset ===\n");

    // Clear WiFi configurations
    printf("Clearing WiFi configurations...\n");
    int ret1 = lisa_kv_del("wifi-info-count");
    int ret2 = lisa_kv_del("wifi-list");
    printf("  - wifi-info-count delete: %s\n", ret1 == 0 ? "Success" : "Failed");
    printf("  - wifi-list delete: %s\n", ret1 == 0 ? "Success" : "Failed");

    printf("=== Network Reset Completed ===\n\n");
}

#define APP_TASK_STACK (4096 * 2)
#define APP_TASK_PRIO  LISA_OS_PRIORITY_NORMAL

extern void listen_vol_adjust(int vol);
extern void ls_builtin_play_random_music(void);  // from player/music_random.c

static int __handle_wifi_stack_init_done(void *arg)
{
    LISA_LOGI(TAG, "Wifi Stack Init Done");

    // // Flash init
    // listen_flash_init();
    // LISA_LOGI(TAG, "flash init end");

    // // EasyFlash init
    // easyflash_init();
    // LISA_LOGI(TAG, "easyflash init end");

    // #if !defined(ARCS_DAC_USE_LITE_DAC)
    //     // PA init
    //     pa_manager_pre_init();
    //     pa_manager_init(PA_MGR_NONE);
    //     LISA_LOGI(TAG, "PA init end");

    //     // Speaker init
    //     listen_spk_init();
    //     LISA_LOGI(TAG, "speaker init end");
    // #endif

    //     // System init
    //     ls_sys_init(TIMEZONE_SHANGHAI);
    //     LISA_LOGI(TAG, "system init end");

    //     // Tone init
    //     app_tone_default_init();
    //     LISA_LOGI(TAG, "tone init end");

    //     // LisaPlayer init
    //     app_player_init();
    //     LISA_LOGI(TAG, "app_player init end");

    //     // Welcome
    //     extern void app_main(void);
    //     app_main();

    //     extern int ui_start(void);
    //     ui_start();

    //     LISA_LOGI(TAG, "Application Ready!!!");

    return 0;
}

static void shutdown(void)
{
    LISA_LOGI(TAG, "shutdown");

    pa_manager_onoff(0);

#ifdef CONFIG_LISA_KV_POWEROFF_SAVE
    lisa_kv_poweroff_save();
#endif

    app_led_off();
    lisa_display_blanking_on(lisa_display_get());
    lisa_display_set_brightness(lisa_display_get(), 0);

    vTaskDelay(100);
}

static void _main_wifi_stack_init_done_cb(void)
{
    evs_handler_post_runnable(__handle_wifi_stack_init_done, NULL);
}

void enter_ble_config(bool play_audio)
{
    LISA_LOGI(TAG, "=== Entering BLE Config Mode ===");
    
    if (play_audio) {
        LISA_LOGI(TAG, "Triggering CONTROLLER_EVENT_OPT_ENTER_BLE_CONFIG");
        assist_controller_trigger_event(CONTROLLER_EVENT_OPT_ENTER_BLE_CONFIG, NULL, 0);
    } else {
        LISA_LOGI(TAG, "Skipping audio playback for BLE config");
    }
    
    LISA_LOGI(TAG, "Starting BLE advertising with max %d retries", BLE_ADV_START_MAX_RETRIES);
    
    int ble_ret = -1;
    for (int retry = 0; retry < BLE_ADV_START_MAX_RETRIES; retry++) {
        LISA_LOGI(TAG, "BLE advertising attempt %d/%d (address 0, mode BLE_ADV_GEN)", 
                  retry + 1, BLE_ADV_START_MAX_RETRIES);
        
        ble_ret = app_ble_adv_start(0, BLE_ADV_GEN);
        
        if (ble_ret == pdTRUE) {
            LISA_LOGI(TAG, "BLE advertising started successfully on attempt %d/%d", 
                      retry + 1, BLE_ADV_START_MAX_RETRIES);
            break;
        } else {
            if (retry < BLE_ADV_START_MAX_RETRIES - 1) {
                LISA_LOGW(TAG, "BLE advertising start failed on attempt %d/%d (ret: %d), retrying...", 
                          retry + 1, BLE_ADV_START_MAX_RETRIES, ble_ret);
                lisa_thread_delay(BLE_ADV_START_RETRY_DELAY_MS);
            } else {
                LISA_LOGE(TAG, "BLE advertising start failed on all %d attempts (final ret: %d)", 
                          BLE_ADV_START_MAX_RETRIES, ble_ret);
            }
        }
    }
    
    if (ble_ret == 0) {
        LISA_LOGI(TAG, "=== BLE Config Mode Ready ===");
    } else {
        LISA_LOGE(TAG, "=== BLE Config Mode Failed to Start ===");
    }
}

static void play_random_music_task(void *arg)
{
    LISA_LOGI(TAG, "play_random_music_task started");
    
    char song_name[128] = {0};
    int ret = music_manager_fetch_and_play_random(song_name, sizeof(song_name));
    if (ret != 0) {
        LISA_LOGE(TAG, "Failed to play random music");
    } else {
        LISA_LOGI(TAG, "Playing random music: %s", song_name);
    }
    
    vTaskDelete(NULL);
}

#if (CONFIG_FLEXIBLE_BUTTON)
#ifdef XIAOZHI_CLOUD
/* 按钮防抖保护 */
#define BUTTON_DEBOUNCE_MS 500  /* 500ms 防抖时间 */

/* 按钮事件类型 */
typedef enum {
    BTN_EVENT_STOP_INTERACTION,
    BTN_EVENT_START_INTERACTION,
} btn_event_type_e;

/* 按钮事件消息 */
typedef struct {
    btn_event_type_e event_type;
} btn_event_msg_t;

/* 按钮事件处理队列和任务 */
static QueueHandle_t s_button_event_queue = NULL;
static SemaphoreHandle_t s_button_mutex = NULL;
static lisa_thread_t *s_button_event_thread = NULL;

/* 按钮事件处理任务 (持久任务，使用队列接收事件) */
static void button_event_task(void *arg)
{
    (void)arg;
    LISA_LOGI(TAG, "Button event task started");

    while (1) {
        btn_event_msg_t msg;
        if (xQueueReceive(s_button_event_queue, &msg, portMAX_DELAY) == pdTRUE) {
            xz_cloud_t cloud = xz_cloud_get_instance();
            if (!cloud) {
                LISA_LOGE(TAG, "Failed to get cloud instance");
                continue;
            }

            switch (msg.event_type) {
            case BTN_EVENT_STOP_INTERACTION:
                LISA_LOGI(TAG, "Handle: Stop interaction (S key)");
                xz_cloud_stop_interaction(cloud);
                alarm_ring_stop();
                break;
            case BTN_EVENT_START_INTERACTION:
                LISA_LOGI(TAG, "Handle: Start interaction (F key)");
                xz_cloud_wakeup(cloud);
                alarm_ring_stop();
                break;
            }
        }
    }
}

/* 初始化按钮事件处理任务 */
static void button_event_handler_init(void)
{
    if (s_button_event_queue != NULL) {
        return;  /* 已经初始化 */
    }

    /* 创建事件队列 */
    s_button_event_queue = xQueueCreate(4, sizeof(btn_event_msg_t));
    if (!s_button_event_queue) {
        LISA_LOGE(TAG, "Failed to create button event queue");
        return;
    }

    /* 创建互斥锁 */
    s_button_mutex = xSemaphoreCreateMutex();
    if (!s_button_mutex) {
        LISA_LOGE(TAG, "Failed to create button mutex");
        vQueueDelete(s_button_event_queue);
        s_button_event_queue = NULL;
        return;
    }

    /* 创建持久任务处理事件 */
    lisa_thread_attr_t attr = {
        .name = "btn_event",
        .stack_size = 8192,
        .priority = LISA_OS_PRIORITY_NORMAL
    };
    s_button_event_thread = lisa_thread_create(&attr, button_event_task, NULL);
    if (!s_button_event_thread) {
        LISA_LOGE(TAG, "Failed to create button event task");
        vQueueDelete(s_button_event_queue);
        vSemaphoreDelete(s_button_mutex);
        s_button_event_queue = NULL;
        s_button_mutex = NULL;
        return;
    }

    LISA_LOGI(TAG, "Button event handler initialized");
}
#endif

static void button_callback_handle(lisa_btn_event_t event, const lisa_btn_info_t *info)
{
    static uint32_t last_button_tick = 0;
    uint32_t current_tick = xTaskGetTickCount();

    LISA_LOGI(TAG, "Button %d event: %d", info->id, event);

    /* 只处理Power按键 */
    if (info->id != LISA_BTN_ID_POWER) {
        return;
    }

    /* 防抖保护：忽略短时间内重复的点击 */
    if (event == LISA_BTN_PRESS_CLICK) {
        if (last_button_tick > 0 && (current_tick - last_button_tick) < pdMS_TO_TICKS(BUTTON_DEBOUNCE_MS)) {
            LISA_LOGW(TAG, "Button debounced: %u ms since last press",
                     (uint32_t)((current_tick - last_button_tick) * portTICK_PERIOD_MS));
            return;
        }
        last_button_tick = current_tick;
    }

    switch (event) {
    case LISA_BTN_PRESS_CLICK:
        /* 单击: 根据小智云状态判断行为 (F/S键等效) */
#ifdef XIAOZHI_CLOUD
        /* 确保按钮事件处理器已初始化 */
        if (s_button_event_queue == NULL) {
            button_event_handler_init();
        }

        if (xz_cloud_is_connected()) {
            /* 使用互斥锁保护 */
            if (xSemaphoreTake(s_button_mutex, pdMS_TO_TICKS(100)) == pdTRUE) {
                btn_event_msg_t msg;

                xz_cloud_t cloud = xz_cloud_get_instance();
                if (xz_cloud_is_interacting(cloud)) {
                    /* 正在交互，发送停止 (S键等效) */
                    msg.event_type = BTN_EVENT_STOP_INTERACTION;
                } else {
                    /* 未交互，发送开始 (F键等效) */
                    msg.event_type = BTN_EVENT_START_INTERACTION;
                }

                /* 发送到队列 (非阻塞) */
                if (xQueueSend(s_button_event_queue, &msg, 0) != pdTRUE) {
                    LISA_LOGW(TAG, "Button event queue full, dropping event");
                }

                xSemaphoreGive(s_button_mutex);
            }
        } else {
            /* 小智云未连接，播放随机音乐 */
            LISA_LOGI(TAG, "Single click: playing random music (xiaozhi not connected)");

            lisa_thread_attr_t attr = {
                .name = "rand_music",
                .stack_size = 4096,
                .priority = LISA_OS_PRIORITY_NORMAL
            };
            lisa_thread_create(&attr, play_random_music_task, NULL);

            alarm_ring_stop();
        }
#else
        /* 非小智云模式，播放随机音乐 */
        LISA_LOGI(TAG, "Single click: playing random music");

        lisa_thread_attr_t attr = {
            .name = "rand_music",
            .stack_size = 4096,
            .priority = LISA_OS_PRIORITY_NORMAL
        };
        lisa_thread_create(&attr, play_random_music_task, NULL);

        alarm_ring_stop();
#endif
        break;

    case LISA_BTN_PRESS_DOUBLE_CLICK:
        /* 双击: 停止音乐播放 */
        LISA_LOGI(TAG, "power button double click, stop music playback");
        audio_player_stop_by_user();
        break;

    case LISA_BTN_PRESS_TRIPLE_CLICK:
        /* 三击: 调出小程序配置页 */
        LISA_LOGI(TAG, "power button triple click, toggle info page");
        assist_controller_trigger_event(CONTROLLER_EVENT_OPT_TOGGLE_INFO_PAGE, NULL, 0);
        break;
    case LISA_BTN_PRESS_QUADRUPLE_CLICK:
        /* 四击 */
        break;
    case LISA_BTN_PRESS_QUINTUPLE_CLICK:
    case LISA_BTN_PRESS_REPEAT_CLICK:
        LISA_LOGI(TAG, "power button repeat click count: %d", info->click_count);
        if (info->click_count >= 8) { /* 连击超过8下: 恢复出厂设置 */
            LISA_LOGI(TAG, "Do factory reset");
            enter_audio_idle();
            extern int play_factory_reset_audio(void);
            play_factory_reset_audio();
            enter_ble_config(false);
            factory_reset();
            app_cloud_disconnect();
            wifi_mgr_sta_disconnect(false);
            extern int change_info_page(lisaui_userdata_qrcode_inter_mode_e mode);
            change_info_page(LISAUI_USERDATA_QRCODE_INTER_CONFIGURE_NETWORK);
        } else if (info->click_count >= 5) { /* 连击超过5下: 进入BLE配置模式 */
            LISA_LOGI(TAG, "Do network reset");
            enter_audio_idle();
            enter_ble_config(true);
            network_reset();
            app_cloud_disconnect();
            wifi_mgr_sta_disconnect(false);
            extern int change_info_page(lisaui_userdata_qrcode_inter_mode_e mode);
            change_info_page(LISAUI_USERDATA_QRCODE_INTER_CONFIGURE_NETWORK);
        }
        break;

    case LISA_BTN_PRESS_LONG_HOLD:
        /* 长按: 关机 */
        if (get_usb_status() == USB_STATUS_PLUG) {
            LISA_LOGI(TAG, "USB connected, ignore long press shutdown");
        } else {
            LISA_LOGI(TAG, "power button long press hold, shutting down...");
            power_shutdown();
        }
        break;

    default:
        break;
    }
}
#endif

#if CFG_NVS
#define NVDS_FLASH_ADDRESS_OFFSET (0xFF8000) // The last 32KB of 16B flash
#define NVDS_FLASH_SIZE           (0x8000)   // 32KB
struct nvs_fs arcs_nvs_fs;
FLASH_DEV arcs_flash_dev = {.base_addr = CMN_FLASHC_BASE,
                            .d_width = 4,
                            .sclk_div = 0xFF, // divider is 1
                            .run_mod = RUN_WITHOUT_INT,
                            .timeout = 0x180000};
int arcs_nvs_init(void)
{
    struct flash_pages_info info;
    flash_if_init(&arcs_flash_dev, 0, 0);
    arcs_nvs_fs.offset = NVDS_FLASH_ADDRESS_OFFSET;
    arcs_nvs_fs.flash_device = &arcs_flash_dev;
    flash_get_page_info_by_offs(&arcs_flash_dev, arcs_nvs_fs.offset, &info);
    arcs_nvs_fs.sector_size = info.size;
    arcs_nvs_fs.sector_count = NVDS_FLASH_SIZE / info.size;
    nvds_init(&arcs_nvs_fs);
    return 0;
}
#endif

static void log_shell_backend_output(const uint8_t *log, uint32_t len, void *data)
{
    extern void lisa_shell_output_raw(const char *data, int len);
    lisa_shell_output_raw((const char *)log, len);
}

static void app_task(void *param)
{
    ipc_mem_init(1);
    ipc_master_init(NULL);
    LISA_LOGI(TAG, "app task enter");

    ls_sys_init(TIMEZONE_SHANGHAI);
    LISA_LOGI(TAG, "system init end");

    extern int lisa_shell_init(void);

    lisa_shell_init();

    /* shell的串口和系统默认的日志输出串口是同一个, 这里暂停系统默认的日志输出 */
    lisa_log_backend_pause("sys.log");
    lisa_log_backend_add("user.shell", log_shell_backend_output, NULL);

    // extern int lisa_log_init(void);
    // lisa_log_init();
    // lisa_log_output_handle_set(lisa_shell_output_raw);

    /**
     * AP侧先核间通信建立后再进行wifi初始化
     * 此处先进行核间通信的建立
     */

    ic_message_init();
    LISA_LOGI(TAG, "IC message init end");

    // extern int sdmmc_hard_init(void);
    // sdmmc_hard_init();

#ifdef CONFIG_LISA_KV_TYPE_LSFS
    extern int user_fs_init(void);
    user_fs_init();
#endif

    // Check if KV storage is already initialized (e.g., from factory reset)
    lisa_kv_init();

    evs_utils_init();

    extern void update_device_id(void);
    update_device_id();

    extern int user_usb_start(void);
    user_usb_start();

    extern bool app_usb_msc_enabled(void);
    /* USB-MSC模式下, 不运行应用程序, 只支持USB文件传输 */
    if (app_usb_msc_enabled()) {
        while (1) {
            lisa_thread_delay(1000);
        }
    }

    int ret;
    // struct lsfs_file_t file;

    // lsfs_file_t_init(&file);
    // ret = lsfs_open(&file, "/SD:/font/lv_font_chinese_18.bin", LSFS_O_READ);
    // if (ret != 0) {
    //     LISA_LOGE(TAG, "lvgl font file not found, do not start ui");
    //     while(1) {
    // 		lisa_thread_delay(1000);
    // 	}
    // }
    // lsfs_close(&file);
    arcs_nvs_init();

    // Utils init
    LISA_LOGI(TAG, "utils init end");

    // Wifi预初始化
    ls_wifi_pre_init(_main_wifi_stack_init_done_cb);
    LISA_LOGI(TAG, "BLE init start\n");
    ls_ble_init();
    LISA_LOGI(TAG, "BLE init end\n");

    extern void comm_service_init(void);
    comm_service_init();
    LISA_LOGI(TAG, "comm service init end");

    /* LED service */
    app_led_init();
    app_led_off();
    extern void audio_play_service_start();
    audio_play_service_start();
    LISA_LOGI(TAG, "audio play service start");

    extern void audio_record_service_start();
    audio_record_service_start();
    LISA_LOGI(TAG, "audio record service start");

#if !defined(ARCS_DAC_USE_LITE_DAC)
    // PA init
    pa_manager_pre_init();
    pa_manager_init(PA_MGR_NONE);
    LISA_LOGI(TAG, "PA init end");

    // Speaker init
    listen_spk_init();
    LISA_LOGI(TAG, "speaker init end");
#endif

    // System init

    // Tone init
    app_tone_default_init();
    LISA_LOGI(TAG, "tone init end");

    pa_manager_pre_init();
    pa_manager_init(PA_MGR_NONE);
    LISA_LOGI(TAG, "PA init end");

    // LisaPlayer init
    app_player_init();
    LISA_LOGI(TAG, "app_player init end");


    // Welcome
    extern void app_main(void);
    app_main();

    // extern int ui_start(void);
    // ui_start();

    LISA_LOGI(TAG, "Application Ready!!!");

#if (CONFIG_FLEXIBLE_BUTTON)
    lisa_btn_init(button_callback_handle, NULL);
#endif

#if (CONFIG_BATTERY_COLLECTION)
    battery_adc_sample_init();
#endif
    listen_mic_gain_init();
    assistant_view_userdata_load();

    video_camera_init();
    camera_senor_release();

    assist_controller_init();

    // Check if WiFi account is already configured
    bool has_wifi_config = false;

    // Use the same API as wifi list command to get saved WiFi networks
    wifi_mgr_sta_config_t *matched_list = NULL;
    ret = wifi_mgr_storage_search_ap(&matched_list, SEARCH_ALL, NULL);

    if (ret > 0 && matched_list != NULL) {
        printf("Found %d saved WiFi network(s)\n", ret);

        // Print the found WiFi configurations for debugging
        for (int i = 0; i < ret; i++) {
            printf("WiFi config [%d]: SSID=[%s], BSSID=[%02x:%02x:%02x:%02x:%02x:%02x]\n", i + 1, matched_list[i].ssid,
                   matched_list[i].bssid[0], matched_list[i].bssid[1], matched_list[i].bssid[2],
                   matched_list[i].bssid[3], matched_list[i].bssid[4], matched_list[i].bssid[5]);
        }

        has_wifi_config = true;

        // Free the matched list
        free(matched_list);
    } else if (ret == 0) {
        printf("No saved WiFi networks found\n");
    } else {
        printf("Failed to get saved WiFi networks, error: %d\n", ret);
    }

    if (!has_wifi_config) {
        printf("No valid WiFi configuration found\n");
        extern int change_info_page(lisaui_userdata_qrcode_inter_mode_e mode);
        change_info_page(LISAUI_USERDATA_QRCODE_INTER_CONFIGURE_NETWORK);
        enter_ble_config(true);
    } else {
        ;
    }

    // Add your logic here based on has_wifi_config
}

static void *cjson_malloc(size_t sz)
{
    return exram_malloc(4, sz);
}

static void cjson_free(void *ptr)
{
    exram_free(ptr);
}

cJSON_Hooks cjson_hooks = {
    .malloc_fn = cjson_malloc,
    .free_fn = cjson_free,
};

int main(int argc, char **argv)
{
    /* 关闭看门狗 */
    WDT_RegDef *wdt_hw = (WDT_RegDef *)IP_AP_WDT;
    wdt_hw->REG_WREN.all = 0x5AA5;
    wdt_hw->REG_CTRL.all = 0;

    printf("\r\n");
    printf("project commit: %s\r\n", PROJECT_VERSION_COMMIT);
    printf("project version: %s\r\n", PROJECT_VERSION_STR);
    printf("\r\n");

    GPIO_Initialize(GPIOB(), NULL, NULL);
    usb_plug_detect_gpio_init();

    power_config_t power_cfg = {
        .on_shutdown = shutdown,
    };
    power_init(&power_cfg);

    /* 等待长按 3s */
    if (!power_wait_settle()) {
        power_shutdown();
        return 0;
    }

    app_led_blink(50, 50);

    heap_caps_malloc_extmem_enable(16);
    cJSON_InitHooks(&cjson_hooks);

    uint32_t time = xTaskGetTickCount();
    const Config *config = config_init((const char *)0x300f0000);
    time = xTaskGetTickCount() - time;
    if (config) {
        config_print(config);
    } else {
        printf("config parse failed\n");
    }
    printf("config parse elapsed time: %d ms\n", time);

    printk("Application start\n");
    lisa_thread_attr_t att = {.name = "APP_BOOT_TASK", .stack_size = APP_TASK_STACK, .priority = APP_TASK_PRIO};

    lisa_thread_create(&att, app_task, NULL);
}
```

## src/app_algo.c
```c
#include "cJSON.h"
#include "stdbool.h"
#include "lisa_log.h"
#include "lisa_mem.h"
#include "evs_utils.h"
#include "app_algo.h"
#include "app_client.h"
#include <string.h>

#define TAG "algo"

typedef struct wakeup_play_id
{
    char *keyword;
    int16_t audio_id;
} wakeup_play_id_t;

/** 是否为数字 */
static bool is_digit(char str) { return (str >= '0' && str <= '9'); }

/** 是否为特殊字符 */
static bool is_special(char str) { return (str == '\r'); }

const wakeup_play_id_t play_id_table[] = {
	{"xiao xian xiao xian", 0},
	{"da kai kong tiao", 1},
	{"guan bi kong tiao", 2},
	{"guan bi ping xian", 3},
	{"zhi leng mo shi", 4},
	{"zhi re mo shi", 5},
	{"song feng mo shi", 6},
	{"chu shi mo shi", 7},
	{"da kai jing hua", 8},
	{"guan bi jing hua", 9},
	{"da kai sha jun", 10},
	{"guan bi sha jun", 11},
	{"di su feng", 12},
	{"zhong su feng", 13},
	{"zui xiao feng", 14},
	{"gao su feng", 15},
	{"zui da feng", 16},
	{"da kai deng guang", 17},
	{"guan bi deng guang", 18},
	{"da kai shui mian", 19},
	{"guan bi shui mian", 20},
	{"zhao ming mo shi", 21},
	{"hui jia mo shi", 22},
	{"li jia mo shi", 23},
	{"quan kai mo shi", 24},
	{"quan guan mo shi", 25},
	{"yue du mo shi", 26},
	{"ying yin mo shi", 27},
	{"shui mian mo shi", 28},
	{"qi chuang mo shi", 29},
	{"jiu can mo shi", 30},
	{"er shi du", 31},
	{"er shi yi du", 32},
	{"er shi er du", 33},
	{"er shi san du", 34},
	{"er shi si du", 35},
	{"er shi wu du", 36},
	{"da kai chuang lian", 37},
	{"guan bi chuang lian", 38},
	{"da kai yang tai deng", 39},
	{"guan bi yang tai deng", 40},
	{"da kai yao tou", 41},
	{"guan bi yao tou", 42},
	{"tiao gao wen du", 43}, {"sheng gao wen du", 43},
	{"tiao di wen du", 44}, {"jiang di wen du", 44},
	{"da kai shang xia bai feng", 45},
	{"ting zhi shang xia bai feng", 46},
	{"da kai zuo you bai feng", 47},
	{"ting zhi zuo you bai feng", 48},
	{"kai qi bai feng", 49},
	{"ting zhi bai feng", 50},
	{"zui da yin liang", 51},
	{"zui xiao yin liang", 52},
	{"zeng da yin liang", 53},
	{"jian xiao yin liang", 54},
	{"da kai fu re", 55},
	{"guan bi fu re", 56},
	{"da kai ping xian", 57},
	{"NULL", -1}, // 结尾标记
};

/**
 * 移除字符串中的数字
 * @param input     待处理字符串
 * @return          处理后的字符串
 */
static char* __remove_digits_and_special(char* input)
{
    char* dest = input;
    char* src = input;

    while(*src) {
        if(is_digit(*src) || is_special(*src)) { src++; continue; }
        *dest++ = *src++;
    }
    *dest = '\0';
    return input;
}

int app_algo_keyword_and_kid_extract(const uint8_t *const in, uint8_t *out, int max_len)
{
	int ret = -1;
	if (in && out) {
		cJSON *root = cJSON_Parse(in);
		if (root) {
			cJSON *rlt_json = cJSON_GetObjectItem(root, "rlt");
			if (rlt_json) {
				if (cJSON_GetArraySize(rlt_json) > 0) {
					cJSON *rlt0_json = cJSON_GetArrayItem(rlt_json, 0);
					if (rlt0_json) {
						cJSON *key_json = cJSON_GetObjectItem(rlt0_json, "keyword");
						cJSON *kid_json = cJSON_GetObjectItem(rlt0_json, "iresid");
						cJSON *threshlod_json = cJSON_GetObjectItem(rlt0_json, "ncm");
						if (key_json && threshlod_json) {
							char *proc_keyword = __remove_digits_and_special(key_json->valuestring);
							if (proc_keyword) {
								ret = 0;
								const int kw_len = strlen(proc_keyword);
								if (kw_len < max_len) {
									memcpy(out, proc_keyword, kw_len + 1);
								} else {
									strncpy(out, proc_keyword, max_len);
								}
							}
						}
					}
				}
			}
			cJSON_Delete(root);
		}
	}

	return ret;
}

int local_tone_get(const uint8_t *keyword)
{
	for (int i = 0; play_id_table[i].audio_id != -1; i++) {
		if (strcmp(keyword, play_id_table[i].keyword) == 0) {
			LISA_LOGD(TAG, "keyword: %s", keyword);
			return play_id_table[i].audio_id;
		}
	}
	return -1;
}

static int __handle_algo_prewakeup_runnable(void *arg)
{
	char *pre_wakeup_info = (char *)arg;
	LISA_LOGD(TAG, "Pre Wakeup: %s", pre_wakeup_info);

	lisa_mem_free(pre_wakeup_info);
	return 0;
}

/**
 * @brief 	复写算法预唤醒处理事件
 * @param	info	算法预唤醒信息
 */
void handle_algo_prewake(char *info)
{
	char *pre_info = lisa_mem_calloc(1, strlen(info) + 1);
	strcpy(pre_info, info);
	if (evs_handler_post_runnable(__handle_algo_prewakeup_runnable, pre_info) != 0)
	{
		lisa_mem_free(pre_info);
	}
}

static int __handle_algo_doa_runnable(void *arg)
{
	uint16_t angle = *((uint16_t *)arg);
	LISA_LOG(TAG, "******** CSK DOA %d ********", angle);

	lisa_mem_free(arg);
	return 0;
}

/**
 * @brief 	复写算法 DOA 事件
 * @param	angle	角度值
 */
void handle_algo_doa(uint16_t angle)
{
	uint16_t *doa = lisa_mem_alloc(sizeof(uint16_t));
	*doa = angle;
	if (evs_handler_post_runnable(__handle_algo_doa_runnable, doa) != 0)
	{
		lisa_mem_free(doa);
	}
}

/**
 * @brief 	复写算法 ESR 结果处理逻辑
 * @param	info	ESR结果字符串
 */
void handle_algo_esr(char *info, uint32_t len)
{
	app_client_wakeup(info, len);
}

/**
 * @brief 	复写算法 ESR 超时逻辑
 */
void handle_algo_esr_timeout()
{
	app_client_algo_timeout();
}

/**
 * @brief 	复写算法录音处理逻辑
*/
void handle_algo_record(const char *audio, int len)
{
	static uint32_t algo_frame_count = 0;
	if (++algo_frame_count % 100 == 1) {
		LISA_LOGI("algo", "handle_algo_record: frame=%lu", algo_frame_count);
	}
	app_client_record(audio, len);
}
```

## src/app_algo.h
```c
/**
 * @brief   算法相关处理
 * @version 0.1
 * @date    2022-11-11
 * 
 * Copyright (C) 2022 ANHUI LISTENAI Co., LTD All Rights Reserved
 */

#ifndef __LISTENAI_ALGO_PROC_H__
#define __LISTENAI_ALGO_PROC_H__

#include "stdint.h"
#include "stdbool.h"

/**
 * 从算法的Param1中解析出 keyword 和 kid
 * @param in 	            算法JSON串
 * @param out	            解析后的字符串
 * @param max_len	        解析后字符串最大长度
 * @return  0       解析成功
 * @return  -1      解析失败
 */
int app_algo_keyword_and_kid_extract(const uint8_t *const in, uint8_t *out, int max_len);

/**
 * 从算法的Param1中解析出 keyword 转化成tone对应的 ID
 * @param keyword 	    算法中得到的keyword
 * @return  >=0     解析成功，返回提示音id
 * @return  -1      解析失败
 */
int local_tone_get(const uint8_t *keyword);

#endif
```

## src/app_client.h
```c
#ifndef __APPLICATION_CLIENT_H__
#define __APPLICATION_CLIENT_H__

#include <stdint.h>
#include <stdbool.h>

#ifdef MY_CLOUD
struct jk_cloud;
#endif
#ifdef XIAOZHI_CLOUD
struct xz_cloud_s;
#endif

typedef struct app_client_s {
	short *buffer;
	uint32_t buffer_size;
	struct listen_audiomgr_s *audio_mgr;
	struct short_player_s *short_player;
	struct audioplayer_s *audio_player;
	struct tts_player_s *tts_player;
	struct sound_player_s *sound_player;
	struct play_mode_s *play_mode;
#ifdef MY_CLOUD
	struct jk_cloud *cloud;
#elif defined(XIAOZHI_CLOUD)
	struct xz_cloud_s *cloud;
#else
	struct app_cloud_s *cloud;
#endif
} app_client_t;

app_client_t *app_client_create();

app_client_t *app_client_get_instance();

/**
 * @brief 	送录音音频
 * @param	audio	录音数据
 * @param	len		录音数据长度
 */
void app_client_record(const char *audio, int len);

/**
 * @brief 	本地唤醒 + 识别 + 超时
 * @param  	data	识别JSON消息
 * @param  	len     消息长度
 */
void app_client_wakeup(const uint8_t *data, uint32_t len);

/**
 * @brief 	ESR 超时
 */
void app_client_algo_timeout();

/**
 * @brief 	停止 Client
 */
void app_client_stop();

#endif
```

## src/comm_service.c
```c
#include <string.h>
#include "cache.h"
#include "comm_service.h"
#include "ic_message.h"
#include "lisa_log.h"
#include "lisa_thread.h"

#include "FreeRTOS.h"
#include "semphr.h"

#define TAG "comm"

typedef struct
{
    uint32_t func;
    uint32_t status;
    char result[1024];
} __attribute__((aligned(32))) func_ack_t;

SemaphoreHandle_t ivw_ctrl_sem = NULL;

__attribute__((weak)) void handle_algo_esr(char *info, uint32_t len)
{
	LISA_LOGI(TAG, "algo esr: %s", info);
}

__attribute__((weak)) void handle_algo_esr_timeout()
{
	LISA_LOGI(TAG, "algo esr timeout");
}

static int32_t ivw_message_cb(ic_message_handle_info_t *handle, ic_message_msg_info_t* msg){

    uint32_t data = *(uint32_t*)msg->msg;

    func_ack_t *func = (func_ack_t *)data;
    if (func) {
        HAL_InvalidateDCache_by_Addr((uint32_t *)func, sizeof(func_ack_t));

        LISA_LOGV(TAG, "[%p] func: %d, status: %x", func, func->func, func->status);
        switch (func->func) {
            case FUNC_IVW_START_E: {
                // LISA_LOGD(TAG, "ivw start");
            } break;
            case FUNC_IVW_STATUS_E: {
                // LISA_LOGI(TAG, "ivw status");
            } break;
            case FUNC_IVW_TIMEOUT_E:{
                handle_algo_esr_timeout();
            } break;
            case FUNC_IVW_RESULT_E: {
                handle_algo_esr(func->result, strlen(func->result) + 1);
            }  break;
            case FUNC_IVW_CTRL_CMD_E: {
                LISA_LOGI(TAG, "ivw ctrl cmd");
                xSemaphoreGive(ivw_ctrl_sem);
            } break;
            default: {
                LISA_LOGD(TAG, "unknown func: %d", func->func);
            } break;
        }
    }

    return 0;
}

void comm_service_init()
{
    int32_t data = 0, send_count = 0;
    ic_message_register_by_id(IC_MESSAGE_ID_IVW, ivw_message_cb, NULL);
    do {
        send_count++;
        int ret = ic_message_msg_send_by_id(IC_MESSAGE_ID_IVW, IC_MESSAGE_MSG_TYPE_CMD, &data, sizeof(data));
        if (ret ==0) {
            break;
        } else {
            LISA_LOGV(TAG, "[%d] check ap ivw msg", send_count);
        }
    } while(1);

    ivw_ctrl_sem = xSemaphoreCreateBinary();
    lisa_thread_mdelay(500);
}

void lis_ivw_idle(void)
{
    func_descriptors_t ivw_ctrl = {
        .func = FUNC_IVW_CTRL_CMD_E,
        .ivw.cmd = e_algo_idle_set,
    };
    uint32_t send_msg =(uint32_t)&ivw_ctrl;

    LOGI("iwv_ctrl: %p", &ivw_ctrl);
    HAL_FlushDCache_by_Addr((uint32_t *)&ivw_ctrl, sizeof(func_descriptors_t));
    int ret = ic_message_msg_send_by_id(IC_MESSAGE_ID_IVW, IC_MESSAGE_MSG_TYPE_CMD, &send_msg, sizeof(uint8_t*));
    if (ret != 0) {
        LISA_LOGE(TAG, "send ivw idle cmd failed");
    }
    xSemaphoreTake(ivw_ctrl_sem, pdMS_TO_TICKS(10000));
}

void lis_ivw_run(void)
{
    func_descriptors_t ivw_ctrl = {
        .func = FUNC_IVW_CTRL_CMD_E,
        .ivw.cmd = e_algo_run_set,
    };
    uint32_t send_msg =(uint32_t)&ivw_ctrl;

    HAL_FlushDCache_by_Addr((uint32_t *)&ivw_ctrl, sizeof(func_descriptors_t));
    int ret = ic_message_msg_send_by_id(IC_MESSAGE_ID_IVW, IC_MESSAGE_MSG_TYPE_CMD, &send_msg, sizeof(uint8_t*));
    if (ret != 0) {
        LISA_LOGE(TAG, "send ivw run cmd failed");
        return ;
    }
    xSemaphoreTake(ivw_ctrl_sem, pdMS_TO_TICKS(10000));
}


void lis_ivw_gain_set(int8_t al, int8_t ar, int8_t dl, int8_t dr)
{
    func_descriptors_t ctrl = {
        .func = FUNC_IVW_CTRL_CMD_E,
        .ivw.cmd = e_algo_gain_set,
        .ivw.data = {
            al,
            ar,
            dl,
            dr,
        },
    };
    uint32_t send_msg =(uint32_t)&ctrl;
    HAL_FlushDCache_by_Addr((uint32_t *)&ctrl, sizeof(ctrl));
    int ret = ic_message_msg_send_by_id(IC_MESSAGE_ID_IVW, IC_MESSAGE_MSG_TYPE_CMD, &send_msg, sizeof(uint8_t*));
    if (ret != 0) {
        LISA_LOGE(TAG, "send ivw gain cmd failed");
    }
    xSemaphoreTake(ivw_ctrl_sem, pdMS_TO_TICKS(10000));
}
```

## src/comm_service.h
```c
/**
 * CP & AP Common Service
 * @date 2025.04.16
 */

#ifndef __LISTENAI_COMM_SERVICE_H__
#define __LISTENAI_COMM_SERVICE_H__

#include <stdint.h>

#define _PACKED_ __attribute__((packed))

typedef enum
{
    FUNC_IVW_START_E = 1,
    FUNC_IVW_STATUS_E,
    FUNC_IVW_RESULT_E,
    FUNC_IVW_TIMEOUT_E,
    FUNC_IVW_CTRL_CMD_E,
} ivw_func_e;

typedef enum {
    e_algo_init_cmd,
    e_algo_timeout_set,
    e_algo_cmd_get,
    e_algo_workmode_set,
    e_algo_stage_set,
    e_algo_idle_set,
    e_algo_run_set,
    e_algo_gain_set,
    e_algo_cmd_count
} algo_cmd_msg_e;

typedef struct
{
    uint8_t cmd;
	uint8_t data[8];
} _PACKED_ ivw_item_t;

typedef struct
{
    uint32_t func;
    union
    {
        ivw_item_t ivw;
    };
} __attribute__((aligned(32))) func_descriptors_t;

/**
 * Common service init
 */
void comm_service_init();

void cp2ap_msg_send();

void lis_ivw_idle(void);

void lis_ivw_run(void);
void lis_ivw_gain_set(int8_t al, int8_t ar, int8_t dl, int8_t dr);
#endif
```
