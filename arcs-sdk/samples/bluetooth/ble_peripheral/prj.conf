## sample.yaml
```
tests:
  samples.bluetooth.ble_peripheral:
    programmer: arcs
    runner: uart
    log_analyzer:
      type: "regex"
      pattern: "BLE Stack Initialized"
```

## prj.conf
```kconfig
# 项目可根据需要在此文件中设置对应的配置
CONFIG_ARCS_HAL_WARNING_DISABLE=y

CONFIG_BACK_TRACE=y

CONFIG_ARCS_CP_CORE=y
# CONFIG_ARCS_HAL_DEBUG=y
CONFIG_ARCS_HAL_LOG_LEVEL_WARN=y

CONFIG_RTOS_AL=y
CONFIG_ARCS_HAL_WCND=y
CONFIG_ARCS_HAL_BTOS=y

# NVS 和 Flash IF 组件
CONFIG_ARCS_HAL_FLASH_IF=y
CONFIG_ARCS_HAL_NVS=y

# 目前 BLE 组件依赖 WiFi 组件提供的 RF 初始化，未来会逐步拆分
CONFIG_LISA_WIFI=y
CONFIG_WIFI_LWIP_SAME_CORE=y

CONFIG_BLE=y
CONFIG_BLE_PROFILE_HOGPD=y
CONFIG_BLE_PROFILE_NETCFG_BLES=y
CONFIG_BLE_PROFILE_BASS=y
CONFIG_LISA_BLUETOOTH=y
# 启用 BLE NVDS 支持以持久化配对信息
CONFIG_LISA_BLUETOOTH_NVDS=y
# 启用 RPA 解析列表，支持 Android 随机 MAC 地址
CONFIG_LISA_BLUETOOTH_RESOVLE_LIST_ADD=y

# 禁用连接参数更新禁用功能，解决连接超时问题
CONFIG_BLE_PEER_FEAT_CON_PARAM_DIS=n

# LCD Display 配置
CONFIG_LISA_DEVICE=y
CONFIG_LISA_GPIO_DEVICE=y
CONFIG_LISA_GPIOA=y
CONFIG_LISA_GPIOB=y
CONFIG_LISA_PWM=y
CONFIG_LISA_SPI0=y
CONFIG_LISA_DISPLAY_DEVICE=y
CONFIG_LISA_DISPLAY_PANEL_ST7789P3=y
CONFIG_PANEL_ST7789P3_WIDTH=240
CONFIG_PANEL_ST7789P3_HEIGHT=240
CONFIG_PANEL_ST7789P3_X_OFFSET=0
CONFIG_LISA_DISPLAY_BUS_SPI_4WIRE=y
# Color inversion: enable (JPEG and LVGL samples use y)
CONFIG_LISA_DISPLAY_COLOR_INVERT=y
```

## src/main.c
```c
/*
 * Copyright (c) 2025, LISTENAI
 *
 * SPDX-License-Identifier: Apache-2.0
 */

/**
 * @file main.c
 * @brief BLE 外设示例
 *
 * 本示例演示如何使用 LISA Bluetooth 组件实现 BLE 外设功能：
 * 1. 自定义广播数据
 * 2. 自定义扫描响应数据
 * 3. 自定义 GAP 配置
 */

#define LOG_TAG "sample"
#include <lisa_log.h>

#include <stdio.h>
#include <stdlib.h>
#include <string.h>

#include "arcs_ap_base.h"
#include "spiflash.h"
#include "arcs_flash_if.h"
#include "nvs.h"
#include "lisa_bluetooth.h"
#include "bt_app_if.h"
#include "hogpd_msg.h"
#include "hogpd.h"
#include "IOMuxManager.h"
#include "Driver_GPIO.h"
#include "pinmux.h"
#include "lcd_logo.h"

#include "FreeRTOS.h"
#include "task.h"

#if CFG_NVS
#define NVDS_FLASH_ADDRESS_OFFSET   (0xFF8000) //The last 32KB of 16B flash
#define NVDS_FLASH_SIZE      (0x8000) //32KB

struct nvs_fs arcs_nvs_fs;
FLASH_DEV arcs_flash_dev  = {
    .base_addr = CMN_FLASHC_BASE,
    .d_width = 4,
    .sclk_div = 0xFF, //divider is 1
    .run_mod = RUN_WITHOUT_INT,
    .timeout = 0x180000
};

static int arcs_nvs_init(void)
{
    struct flash_pages_info info;

    flash_if_init(&arcs_flash_dev, 0, 0);

    //init nvs module
    arcs_nvs_fs.offset = NVDS_FLASH_ADDRESS_OFFSET;
    arcs_nvs_fs.flash_device = &arcs_flash_dev;
    flash_get_page_info_by_offs(&arcs_flash_dev, arcs_nvs_fs.offset, &info);
    arcs_nvs_fs.sector_size = info.size;
    arcs_nvs_fs.sector_count = NVDS_FLASH_SIZE/info.size;

    nvds_init(&arcs_nvs_fs);

    return 0;
}
#endif

static const uint8_t user_adv_data[] = {
    // Flags
    0x02, 0x01, 0x06,
    // Complete List of 16-bit Service UUIDs: HID (0x1812)
    0x03, 0x03, 0x12, 0x18,
    // Complete Local Name: "LISA_BLE"
    0x09, 0x09, 'L', 'I', 'S', 'A', '_', 'B', 'L', 'E',
};

const uint8_t* lisa_bt_get_adv_data(uint8_t *len)
{
    *len = sizeof(user_adv_data);
    return user_adv_data;
}

static const uint8_t user_scan_rsp_data[] = {
    // Manufacturer Specific Data
    0x05, 0xFF, 0xAB, 0x0A, 0x01, 0x02,
};

const uint8_t* lisa_bt_get_scan_rsp_data(uint8_t *len)
{
    *len = sizeof(user_scan_rsp_data);
    return user_scan_rsp_data;
}

void lisa_bt_gap_config(ble_gap_cfg_t *cfg)
{
    // Set custom MAC address
    uint8_t mac[6] = {0x11, 0x22, 0x33, 0x44, 0x55, 0x66};
    memcpy(cfg->addr.addr, mac, 6);
    
    // Set custom device name
    const char *name = "LISA_CUSTOM";
    cfg->name_len = strlen(name);
    if (cfg->name_len > sizeof(cfg->name)) {
        cfg->name_len = sizeof(cfg->name);
    }
    memcpy(cfg->name, name, cfg->name_len);
}

// HOGPD 回调结构（在 custom_service.c 中定义）
extern const hogpd_cb_t ble_hogpd_cb;

static void *gpio_handler = NULL;
static volatile bool button_pressed = false;
static bool hogpd_enabled = false;
static uint8_t last_connected_state = 0;

// GPIO 中断回调
static void gpio_button_callback(uint32_t event, void *workspace)
{
    if (event & (1 << POWER_KEY_PIN)) {
        LISA_LOGI(LOG_TAG, "Button pressed!");
        button_pressed = true;
        // 禁用中断防止抖动
        GPIO_Control(gpio_handler, CSK_GPIO_INTR_DISABLE, (1 << POWER_KEY_PIN));
    }
}

// 初始化 GPIO
static void gpio_button_init(void)
{
    // 配置引脚复用
    lisa_gpiob_pinmux();

    // 获取 GPIO 句柄
    gpio_handler = GPIOB();

    // 初始化 GPIO
    GPIO_Initialize(gpio_handler, gpio_button_callback, NULL);

    // 设置为输入
    GPIO_SetDir(gpio_handler, (1 << POWER_KEY_PIN), CSK_GPIO_DIR_INPUT);

    // 配置下降沿触发中断（按键按下）
    GPIO_Control(gpio_handler,
        CSK_GPIO_DEBOUNCE_DISABLE |
        CSK_GPIO_SET_INTR_NEGATIVE_EDGE |
        CSK_GPIO_INTR_ENABLE, (1 << POWER_KEY_PIN));

    LISA_LOGI(LOG_TAG, "GPIO button initialized (PB%d)", POWER_KEY_PIN);
}

// 发送"下一首"媒体按键
static void send_media_next_track(void)
{
    // 媒体控制 HID 报告格式：
    // Report ID: 0x03, Report Index: HIDS_MEDIA_INDEX (2)
    // Scan Next Track: Usage ID 0x00B5 (小端序: 0xB5, 0x00)

    // 发送"按下"报告
    uint8_t media_report_press[] = {0xB5, 0x00};
    int ret = ble_hogpd_report_upd(0, HIDS_MEDIA_INDEX, sizeof(media_report_press), media_report_press);
    if (ret == 0) {
        LISA_LOGI(LOG_TAG, "Media press sent: 0x%02X%02X", media_report_press[0], media_report_press[1]);
    } else {
        LISA_LOGE(LOG_TAG, "Failed to send media press: %d", ret);
        return;
    }

    // 短暂延迟后发送"抬起"报告
    vTaskDelay(pdMS_TO_TICKS(50));

    uint8_t media_report_release[] = {0x00, 0x00};
    ret = ble_hogpd_report_upd(0, HIDS_MEDIA_INDEX, sizeof(media_report_release), media_report_release);
    if (ret == 0) {
        LISA_LOGI(LOG_TAG, "Media release sent");
    } else {
        LISA_LOGE(LOG_TAG, "Failed to send media release: %d", ret);
    }
}

int main(int argc, char **argv)
{
    LISA_LOGI(LOG_TAG, "=== BLE Peripheral with HID Keyboard ===");

    arcs_nvs_init();

    // 射频校准
    ls_rf_probe();
    ls_rf_cali_proc();

    // 初始化 GPIO
    gpio_button_init();

    // BLE 初始化
    lisa_bluetooth_init();

    LISA_LOGI(LOG_TAG, "BLE Stack Initialized");

    // 初始化 LCD 并显示 Logo
    lcd_show_logo();

    // Start Advertising
    app_ble_adv_start(0, BLE_ADV_GEN);

    LISA_LOGI(LOG_TAG, "Press POWER_KEY (PB4) to send 'Next Track' media key");

    while (1) {
        // 检查连接状态
        uint8_t connected = app_ble_connected_state(0);
        if (connected && !hogpd_enabled && connected != last_connected_state) {
            // 连接建立，启用 HOGPD 服务和连接参数更新
            LISA_LOGI(LOG_TAG, "BLE connected, enabling HOGPD service");
            ble_hogpd_enable(0);
            ble_gap_set_con_param_dis(0);  // 启用连接参数更新，解决连接超时问题
            hogpd_enabled = true;
        }
        last_connected_state = connected;

        if (button_pressed) {
            button_pressed = false;

            // 检查是否已连接
            if (hogpd_enabled) {
                // 发送媒体按键
                send_media_next_track();
            } else {
                LISA_LOGW(LOG_TAG, "BLE not connected, ignoring button");
            }

            // 短暂延迟后重新启用中断
            vTaskDelay(pdMS_TO_TICKS(200));
            GPIO_Control(gpio_handler, CSK_GPIO_INTR_ENABLE, (1 << POWER_KEY_PIN));
        }

        vTaskDelay(pdMS_TO_TICKS(100));
    }

    return 0;
}
```

## src/custom_service.c
```c
/*
 * Copyright (c) 2025, LISTENAI
 *
 * SPDX-License-Identifier: Apache-2.0
 */

/**
 * @file custom_service.c
 * @brief 自定义 BLE 服务实现
 *
 * 本文件实现了一个示例 BLE 服务，包含多种类型的特征值：
 * 1. 只读特征值
 * 2. 只写特征值
 * 3. 通知特征值
 * 4. 读写特征值
 * 5. 安全读取特征值（需要配对/认证）
 */

#include "custom_service.h"
#include "ble_gatt.h"
#include "hogpd_msg.h"
#include "hogpd.h"
#include <string.h>

#define LOG_TAG "custom_svc"
#include "lisa_log.h"

/* 自定义服务 UUID 定义 */
#define CUSTOM_SVC_UUID              0x1234
#define CUSTOM_CHAR_READ_UUID        0x1235
#define CUSTOM_CHAR_WRITE_UUID       0x1236
#define CUSTOM_CHAR_NOTIFY_UUID      0x1237
#define CUSTOM_CHAR_READ_WRITE_UUID  0x1238
#define CUSTOM_CHAR_SEC_READ_UUID    0x1239

// HID Report Map（完整版本，包含所有报告）
static const uint8_t hid_report_map[] = {
    // Keyboard
    0x05, 0x01,                    // USAGE_PAGE (Generic Desktop)
    0x09, 0x06,                    // USAGE (Keyboard)
    0xa1, 0x01,                    // COLLECTION (Application)

    0x85, HIDS_KB_REPORT_ID,       //   REPORT_ID (Keyboard)
    0x05, 0x07,                    //   USAGE_PAGE (Keyboard)
    0x19, 0x4b,                    //   USAGE_MINIMUM (Keyboard PageUp)
    0x29, 0x52,                    //   USAGE_MAXIMUM (Keyboard UpArrow)
    0x15, 0x00,                    //   LOGICAL_MINIMUM (0)
    0x25, 0x01,                    //   LOGICAL_MAXIMUM (1)
    0x75, 0x01,                    //   REPORT_SIZE (1)
    0x95, 0x08,                    //   REPORT_COUNT (8)
    0x81, 0x02,                    //   INPUT (Data,Var,Abs)

    0x95, 0x01,                    //   REPORT_COUNT (1)
    0x75, 0x08,                    //   REPORT_SIZE (8)
    0x81, 0x03,                    //   INPUT (Cnst,Var,Abs)

    0x95, 0x05,                    //   REPORT_COUNT (5)
    0x75, 0x01,                    //   REPORT_SIZE (1)
    0x05, 0x08,                    //   USAGE_PAGE (LEDs)
    0x19, 0x01,                    //   USAGE_MINIMUM (Num Lock)
    0x29, 0x05,                    //   USAGE_MAXIMUM (Kana)
    0x91, 0x02,                    //   OUTPUT (Data,Var,Abs)

    0x95, 0x01,                    //   REPORT_COUNT (1)
    0x75, 0x03,                    //   REPORT_SIZE (3)
    0x91, 0x03,                    //   OUTPUT (Cnst,Var,Abs)

    0x95, 0x6,                     //   REPORT_COUNT (6)
    0x75, 0x08,                    //   REPORT_SIZE (8)
    0x15, 0x00,                    //   LOGICAL_MINIMUM (0)
    0x25, 0xff,                    //   LOGICAL_MAXIMUM (101)
    0x05, 0x07,                    //   USAGE_PAGE (Keyboard)
    0x19, 0x00,                    //   USAGE_MINIMUM (Reserved (no event indicated))
    0x29, 0xff,                    //   USAGE_MAXIMUM (Keyboard Application)
    0x81, 0x00,                    //   INPUT (Data,Ary,Abs)
    0xc0,                          //   END_COLLECTION

    // Mouse
    0x05, 0x01,                    // USAGE_PAGE (Generic Desktop)
    0x09, 0x02,                    // USAGE (Mouse)
    0xa1, 0x01,                    // COLLECTION (Application)

    0x85, HIDS_MOUSE_REPORT_ID,    //   REPORT_ID (Mouse)
    0x09, 0x01,                    //   USAGE_PAGE (Pointer)
    0xa1, 0x00,                    //   COLLECTION (PHYSICAL)
    0x05, 0x09,                    //   USAGE_PAGE (BUTTON)
    0x19, 0x01,                    //   USAGE_MINIMUM (1)
    0x29, 0x05,                    //   USAGE_MAXIMUM (5)
    0x15, 0x00,                    //   LOGICAL_MINIMUM (0)
    0x25, 0x01,                    //   LOGICAL_MAXIMUM (1)
    0x95, 0x05,                    //   REPORT_COUNT (5)
    0x75, 0x01,                    //   REPORT_SIZE (1)
    0x81, 0x02,                    //   INPUT (Data,Var,Abs)
    0x95, 0x01,                    //   REPORT_COUNT (1)
    0x75, 0x03,                    //   REPORT_SIZE (3)
    0x81, 0x01,                    //   INPUT (CONSTANT); 3 bit padding
    0x05, 0x01,                    //   USAGE_PAGE (Generic Desktop)
    0x09, 0x30,                    //   USAGE (X)
    0x09, 0x31,                    //   USAGE (Y)
    0x09, 0x38,                    //   USAGE (Wheel)
    0x15, 0x81,                    //   LOGICAL_MINIMUM (-127)
    0x25, 0x7f,                    //   LOGICAL_MAXIMUM (127)
    0x75, 0x08,                    //   REPORT_SIZE (8)
    0x95, 0x03,                    //   REPORT_SIZE (3)
    0x81, 0x06,                    //   INPUT (Data,Var,Rel); 3 position bytes(X,Y,Wheel)
    0xc0,                          // END_COLLECTION
    0xc0,                          // END_COLLECTION

    // Media Consumer Control
    0x05, 0x0C,                    // USAGE_PAGE (Consumer Devices)
    0x09, 0x01,                    // USAGE (Consumer Control)
    0xA1, 0x01,                    // COLLECTION (Application)
    0x85, HIDS_MEDIA_REPORT_ID,    // REPORT_ID (3)
    0x19, 0x00,                    // USAGE_MINIMUM (0x00)
    0x2A, 0x9C, 0x02,              // USAGE_MAXIMUM (0x029C)
    0x15, 0x00,                    // LOGICAL_MINIMUM (0x00)
    0x26, 0x9C, 0x02,              // LOGICAL_MAXIMUM (0x029C)
    0x95, 0x01,                    // REPORT_COUNT (1)
    0x75, 0x10,                    // REPORT_SIZE (0x10)
    0x81, 0x00,                    // INPUT (Data,Ary,Abs)
    0xC0,                          // END_COLLECTION

    // Voice data report
    0x05, 0x0C,                    // Usage Page (Consumer Devices)
    0x09, 0x01,                    // Usage (Consumer Control)
    0xA1, 0x01,                    // Collection (Application)
    0x85, HIDS_VOICE_DATA_IN_REPORT_ID,  // Report ID=0xFC
    0x95, 0xff,                    // REPORT_COUNT (255)
    0x75, 0x08,                    // REPORT_SIZE (8)
    0x15, 0x00,                    // LOGICAL_MINIMUM (0)
    0x26, 0xFF, 0x00,              // LOGICAL_MAXIMUM (255)
    0x81, 0x00,                    // INPUT (Data,Ary,Abs)
    0xC0,                          // END_COLLECTION

    // GDE ACK in
    0x05, 0x0C,                    // Usage Page (Consumer Devices)
    0x09, 0x01,                    // Usage (Consumer Control)
    0xA1, 0x01,                    // Collection (Application)
    0x85, HIDS_GDE_ACK_IN_REPORT_ID,   // Report ID=0xF8
    0x95, 0xff,                    // REPORT_COUNT (255)
    0x75, 0x08,                    // REPORT_SIZE (8)
    0x15, 0x00,                    // LOGICAL_MINIMUM (0)
    0x26, 0xFF, 0x00,              // LOGICAL_MAXIMUM (255)
    0x81, 0x00,                    // INPUT (Data,Ary,Abs)
    0xC0,                          // END_COLLECTION

    // GDE Feedback
    0x05, 0x0C,                    // Usage Page (Consumer Devices)
    0x09, 0x01,                    // Usage (Consumer Control)
    0xA1, 0x01,                    // Collection (Application)
    0x85, HIDS_GDE_FEEDBACK_IN_REPORT_ID,  // Report ID=0xF9
    0x95, 0xff,                    // REPORT_COUNT (255)
    0x75, 0x08,                    // REPORT_SIZE (8)
    0x15, 0x00,                    // LOGICAL_MINIMUM (0)
    0x26, 0xFF, 0x00,              // LOGICAL_MAXIMUM (255)
    0x81, 0x00,                    // INPUT (Data,Ary,Abs)
    0xC0,                          // END_COLLECTION
};

// HOGPD 回调函数
static void ble_hid_read_cmp(uint32_t token, uint8_t val_id)
{
    LISA_LOGI(LOG_TAG, "HID read complete, val_id=%d", val_id);
}

static void ble_hid_send_cmp(uint32_t token, uint8_t val_id)
{
    LISA_LOGI(LOG_TAG, "HID send complete, val_id=%d", val_id);
}

static void ble_hid_rcv(uint8_t conidx, uint16_t index, uint16_t length,
                        uint16_t offset, uint8_t *data)
{
    LISA_LOGI(LOG_TAG, "HID received: idx=%d, len=%d", index, length);
}

// HOGPD 回调结构定义
const hogpd_cb_t ble_hogpd_cb = {
    .cb_read_cmp = ble_hid_read_cmp,
    .cb_notify_cmp = ble_hid_send_cmp,
    .cb_write_cmp = NULL,
    .cb_read_ind = NULL,
    .cb_notify_ind = NULL,
    .cb_write_ind = ble_hid_rcv,
};

/**
 * @brief 属性数据库索引枚举
 */
enum {
    IDX_SVC,                        /**< 服务声明 */
    
    IDX_CHAR_READ_DECL,             /**< 只读特征值声明 */
    IDX_CHAR_READ_VAL,              /**< 只读特征值数值 */
    
    IDX_CHAR_WRITE_DECL,            /**< 只写特征值声明 */
    IDX_CHAR_WRITE_VAL,             /**< 只写特征值数值 */
    
    IDX_CHAR_NOTIFY_DECL,           /**< 通知特征值声明 */
    IDX_CHAR_NOTIFY_VAL,            /**< 通知特征值数值 */
    IDX_CHAR_NOTIFY_CFG,            /**< 通知特征值 CCCD (Client Characteristic Configuration Descriptor) */
    
    IDX_CHAR_READ_WRITE_DECL,       /**< 读写特征值声明 */
    IDX_CHAR_READ_WRITE_VAL,        /**< 读写特征值数值 */
    
    IDX_CHAR_SEC_READ_DECL,         /**< 安全读特征值声明 */
    IDX_CHAR_SEC_READ_VAL,          /**< 安全读特征值数值 */
    
    IDX_NB,                         /**< 属性总数 */
};

/* GATT 用户回调 ID，注册时由协议栈分配 */
static uint8_t custom_user_lid = 0;
/* 服务起始句柄，添加服务时由协议栈分配 */
static uint16_t custom_start_hdl = 0;

/**
 * @brief 属性数据库定义
 * 
 * 定义服务和特征值的属性，包括 UUID、权限和最大长度。
 */
static const ble_gatt_att16_desc_t custom_att_db[IDX_NB] = {
    // Service Declaration
    [IDX_SVC] = {BLE_GATT_DECL_PRIMARY_SERVICE, BLE_PROP(RD), 0},

    // Char 1: Read (只读)
    [IDX_CHAR_READ_DECL] = {BLE_GATT_DECL_CHARACTERISTIC, BLE_PROP(RD), 0},
    [IDX_CHAR_READ_VAL] = {CUSTOM_CHAR_READ_UUID, BLE_PROP(RD), 20},

    // Char 2: Write (只写，支持 Write Request 和 Write Command)
    [IDX_CHAR_WRITE_DECL] = {BLE_GATT_DECL_CHARACTERISTIC, BLE_PROP(RD), 0},
    [IDX_CHAR_WRITE_VAL] = {CUSTOM_CHAR_WRITE_UUID, BLE_PROP(WC) | BLE_PROP(WR), 20},

    // Char 3: Notify (通知)
    [IDX_CHAR_NOTIFY_DECL] = {BLE_GATT_DECL_CHARACTERISTIC, BLE_PROP(RD), 0},
    [IDX_CHAR_NOTIFY_VAL] = {CUSTOM_CHAR_NOTIFY_UUID, BLE_PROP(N), 20},
    [IDX_CHAR_NOTIFY_CFG] = {BLE_GATT_DESC_CLIENT_CHAR_CFG, BLE_PROP(RD) | BLE_PROP(WR), 0},

    // Char 4: Read/Write (可读可写)
    [IDX_CHAR_READ_WRITE_DECL] = {BLE_GATT_DECL_CHARACTERISTIC, BLE_PROP(RD), 0},
    [IDX_CHAR_READ_WRITE_VAL] = {CUSTOM_CHAR_READ_WRITE_UUID, BLE_PROP(RD) | BLE_PROP(WC) | BLE_PROP(WR), 20},

    // Char 5: Secure Read (安全读取，需要认证)
    [IDX_CHAR_SEC_READ_DECL] = {BLE_GATT_DECL_CHARACTERISTIC, BLE_PROP(RD), 0},
    [IDX_CHAR_SEC_READ_VAL] = {CUSTOM_CHAR_SEC_READ_UUID, BLE_PROP(RD) | BLE_SEC_LVL(RP, AUTH), 20},
};

/**
 * @brief 处理 GATT 读取请求的回调函数
 * 
 * @param conidx 连接索引
 * @param user_lid GATT 用户回调 ID
 * @param token 请求令牌
 * @param hdl 属性句柄
 * @param offset 读取偏移量
 * @param max_length 最大读取长度
 */
static void cb_att_read_get(uint8_t conidx, uint8_t user_lid, uint16_t token, uint16_t hdl, uint16_t offset, uint16_t max_length)
{
    uint16_t idx = hdl - custom_start_hdl;
    uint8_t data[] = "Hello LISA"; // 示例数据
    uint16_t len = sizeof(data);
    
    LISA_LOGI(LOG_TAG, "Read request: idx=%d, offset=%d", idx, offset);

    // 根据索引判断读取哪个特征值
    if (idx == IDX_CHAR_READ_VAL || idx == IDX_CHAR_READ_WRITE_VAL || idx == IDX_CHAR_SEC_READ_VAL) {
        // 发送读取确认，返回数据
        ble_gatt_srv_att_read_get_cfm(conidx, user_lid, token, 0, len, len, data);
    } else if (idx == IDX_CHAR_NOTIFY_CFG) {
        // 读取 CCCD 配置 (通常由协议栈维护，这里仅作示例)
        uint16_t ccc_val = 0; 
        ble_gatt_srv_att_read_get_cfm(conidx, user_lid, token, 0, 2, 2, (uint8_t*)&ccc_val);
    } else {
        // 属性未找到或不可读
        ble_gatt_srv_att_read_get_cfm(conidx, user_lid, token, 0x0A /* ATT_ERR_ATTRIBUTE_NOT_FOUND */, 0, 0, NULL);
    }
}

/**
 * @brief 处理 GATT 写入请求的回调函数
 * 
 * @param conidx 连接索引
 * @param user_lid GATT 用户回调 ID
 * @param token 请求令牌
 * @param hdl 属性句柄
 * @param offset 写入偏移量
 * @param p_data 写入数据指针 (包含数据长度和内容)
 */
static void cb_att_val_set(uint8_t conidx, uint8_t user_lid, uint16_t token, uint16_t hdl, uint16_t offset, void* p_data)
{
    uint16_t idx = hdl - custom_start_hdl;
    // 注意：p_data 结构依赖于具体的协议栈实现，这里假设已处理
    
    LISA_LOGI(LOG_TAG, "Write request: idx=%d", idx);
    
    // 发送写入确认
    ble_gatt_srv_att_val_set_cfm(conidx, user_lid, token, 0);
    
    // 如果是通知配置被写入，可以在这里处理通知开启/关闭逻辑
    if (idx == IDX_CHAR_NOTIFY_CFG) {
        LISA_LOGI(LOG_TAG, "CCCD updated");
    }
}

/**
 * @brief 通知/指示发送完成回调
 * 
 * @param conidx 连接索引
 * @param user_lid GATT 用户回调 ID
 * @param dummy 虚拟参数
 * @param status 发送状态
 */
static void cb_event_sent(uint8_t conidx, uint8_t user_lid, uint16_t dummy, uint16_t status)
{
    LISA_LOGI(LOG_TAG, "Event sent status: %d", status);
}

/**
 * @brief 获取属性信息回调 (用于 Read by Type 等请求)
 * 
 * @param conidx 连接索引
 * @param user_lid GATT 用户回调 ID
 * @param token 请求令牌
 * @param hdl 属性句柄
 */
static void cb_att_info_get(uint8_t conidx, uint8_t user_lid, uint16_t token, uint16_t hdl)
{
    uint16_t idx = hdl - custom_start_hdl;
    uint16_t length = 0;
    
    // 返回属性的当前长度
    if (idx == IDX_CHAR_READ_VAL) length = 20;
    else if (idx == IDX_CHAR_WRITE_VAL) length = 20;
    else if (idx == IDX_CHAR_NOTIFY_VAL) length = 20;
    else if (idx == IDX_CHAR_READ_WRITE_VAL) length = 20;
    else if (idx == IDX_CHAR_SEC_READ_VAL) length = 20;
    else if (idx == IDX_CHAR_NOTIFY_CFG) length = 2;
    
    ble_gatt_srv_att_info_get_cfm(conidx, user_lid, token, 0, length);
}

/* GATT 服务回调函数集合 */
static const ble_gatt_srv_cb_t custom_cb = {
    .cb_event_sent = cb_event_sent,
    .cb_att_read_get = cb_att_read_get,
    .cb_att_event_get = NULL, // 不使用 Reliable Write
    .cb_att_info_get = cb_att_info_get,
    .cb_att_val_set = cb_att_val_set,
};

/**
 * @brief 初始化自定义服务
 * 
 * 注册 GATT 用户回调并添加服务到数据库。
 * 此函数应在协议栈初始化完成后调用。
 */
void app_ble_init_cmp(void)
{
    LISA_LOGI(LOG_TAG, "Initializing BLE Services");

    // 1. 注册 GATT 用户回调
    // pref_mtu: 512, prio: 0
    ble_gatt_user_register(512, 0, &custom_cb, &custom_user_lid);

    // 2. 添加自定义服务
    // uuid: 0x1234 (CUSTOM_SVC_UUID)
    // nb_att: IDX_NB (属性数量)
    ble_gatt_db_svc16_add(custom_user_lid, 0, CUSTOM_SVC_UUID, IDX_NB, NULL, custom_att_db, IDX_NB, &custom_start_hdl);

    LISA_LOGI(LOG_TAG, "Custom Service added, start_hdl=%d", custom_start_hdl);

    // 3. 初始化 HOGP HID 服务
    uint8_t svc_features = HOGPD_CFG_KEYBOARD | HOGPD_CFG_MOUSE |
                          HOGPD_CFG_PROTO_MODE | HOGPD_CFG_REPORT_NTF_EN;
    uint8_t report_char_cfg = HOGPD_CFG_REPORT_IN;
    hogpd_report_map_t report_map = {
        .size = sizeof(hid_report_map),
        .remain_size = 0,
        .rep_map = (uint8_t *)hid_report_map
    };

    uint16_t ret = ble_hogpd_init(svc_features, report_char_cfg,
                                  (hogpd_cb_t *)&ble_hogpd_cb, &report_map);
    if (ret == 0) {
        LISA_LOGI(LOG_TAG, "HOGPD service initialized");
        // 不在这里启用，等待连接建立后再启用
    } else {
        LISA_LOGE(LOG_TAG, "Failed to init HOGPD: 0x%x", ret);
    }
}
```

## src/custom_service.h
```c
#ifndef CUSTOM_SERVICE_H
#define CUSTOM_SERVICE_H

void app_ble_init_cmp(void);

#endif
```

## src/lcd_logo.c
```c
/*
 * Copyright (c) 2025, LISTENAI
 *
 * SPDX-License-Identifier: Apache-2.0
 */

/**
 * @file lcd_logo.c
 * @brief LCD 显示 Logo 示例
 */

#include <lisa_device.h>
#include <lisa_display.h>
#include <lisa_mem.h>
#include <stdint.h>
#include "IOMuxManager.h"
#include "lisa_gpio.h"
#include "board.h"
#include "pinmux.h"
#include "logo_data.h"

#define LOG_TAG "lcd_logo"
#include <lisa_log.h>

int lcd_show_logo(void)
{
    LISA_LOGI(LOG_TAG, "LCD Logo display started");

    // 配置 LCD 所需的引脚复用
    lisa_spi0_pinmux();   // SPI0: LCD_CS, LCD_SPI_DATA, LCD_SPI_CLK
    lisa_gpioa_pinmux();  // GPIOA: LCD_CD
    lisa_gpiob_pinmux();  // GPIOB: LCD_RST
    lisa_pwm_pinmux();    // PWM: LCD_PWM (backlight)

    lisa_device_t *gpioa_dev = lisa_device_get("gpioa");
    lisa_device_t *gpiob_dev = lisa_device_get("gpiob");

    // Display 配置 (SPI 4-Wire, ST7789P3)
    lisa_display_config_t display_config = {
        .bus_type = LISA_DISPLAY_BUS_SPI_4WIRE,
        .bus_config = {.spi_4wire =
                           {
                               .spi_dev = lisa_device_get("spi0"),
                               .cs_gpio = gpioa_dev,
                               .cs_pin = LCD_CS_PIN,
                               .dc_gpio = gpioa_dev,
                               .dc_pin = LCD_CD_PIN,
                               .spi_freq = 50 * 1000 * 1000,

                           }},
        .backlight = {.type = LISA_DISPLAY_BACKLIGHT_TYPE_PWM,
                      .config.pwm = {.channel = 1, .dev = lisa_device_get("pwm0"), .freq = 2000}},
        .rst_gpio = gpiob_dev,
        .rst_pin = LCD_RST_PIN,
    };

    lisa_device_t *display_device = lisa_device_get("display");
    if (!display_device) {
        LISA_LOGE(LOG_TAG, "Failed to get display device");
        return -1;
    }

    lisa_display_attach_bus(display_device, &display_config);

    lisa_display_capabilities_t caps;
    lisa_display_get_capabilities(display_device, &caps);
    LISA_LOGI(LOG_TAG, "Display: %d x %d", caps.width, caps.height);

    // 打开显示和背光
    lisa_display_blanking_off(display_device);
    lisa_display_set_brightness(display_device, 100);

    // 设置显示方向（如果图片旋转了，可以修改这个值）
    // 0=0°, 1=90°, 2=180°, 3=270°
    lisa_display_set_orientation(display_device, LISA_DISPLAY_ORIENTATION_0);

    // 显示 Logo - 逐行渲染
    int line_bytes = LOGO_WIDTH * 2;
    uint8_t *buf = lisa_mem_alloc(line_bytes);
    if (!buf) {
        LISA_LOGE(LOG_TAG, "Failed to allocate line buffer");
        return -1;
    }

    LISA_LOGI(LOG_TAG, "Displaying logo (%d x %d)", LOGO_WIDTH, LOGO_HEIGHT);

    lisa_display_buffer_desc_t desc = {
        .width = LOGO_WIDTH,
        .height = 1,
        .buf_size = line_bytes,
        .pitch = line_bytes,
    };

    for (int y = 0; y < LOGO_HEIGHT; y++) {
        // 复制一行数据到缓冲区
        int offset = y * line_bytes;
        for (int x = 0; x < line_bytes; x++) {
            buf[x] = logo_data[offset + x];
        }
        lisa_display_write(display_device, 0, y, &desc, buf);
    }

    lisa_mem_free(buf);

    LISA_LOGI(LOG_TAG, "Logo displayed successfully");
    return 0;
}
```

## src/lcd_logo.h
```c
/*
 * Copyright (c) 2025, LISTENAI
 *
 * SPDX-License-Identifier: Apache-2.0
 */

#ifndef LCD_LOGO_H
#define LCD_LOGO_H

/**
 * @brief 初始化 LCD 并显示 Logo
 *
 * @return 0 成功, 负数 失败
 */
int lcd_show_logo(void);

#endif /* LCD_LOGO_H */
```
