## CMakeLists.txt
```
cmake_minimum_required(VERSION 3.19)

set(CMAKE_EXPORT_COMPILE_COMMANDS ON)

find_package(listenai-cmake REQUIRED HINTS $ENV{ARCS_BASE})

project(arcs)

listenai_include_directories(${CMAKE_CURRENT_SOURCE_DIR})
listenai_include_directories(${CMAKE_CURRENT_SOURCE_DIR}/src)
listenai_include_directories(${CMAKE_CURRENT_SOURCE_DIR}/src/app_translation)

add_subdirectory(src)

listenai_add_executable(${PROJECT_NAME})
```

## sample.yaml
```
tests:
  samples.algorithms.translation:
    build_only: true
```

## prj.conf
```kconfig
# 使用自定义内存配置文件和自定义链接脚本
CONFIG_MEM_CONFIG=n
CONFIG_MEM_FLASH_BASE=0x308D0000
CONFIG_MEM_FLASH_SIZE=0x0072D000
CONFIG_MEM_PSRAM_BASE=0x28800000
CONFIG_MEM_PSRAM_SIZE=0x00800000
CONFIG_MEM_SRAM_BASE=0x20010000
CONFIG_MEM_SRAM_SIZE=0x00024800

# CP core
CONFIG_ARCS_CP_CORE=y

# not boot loader
CONFIG_BOOT_HART=n
CONFIG_BOOT=n

# C LIB
CONFIG_LINK_OPTION_NONE_SPECS=y

# HEAP
CONFIG_HEAP_SIZE=0x3AD0
CONFIG_PSRAM_HEAP_SIZE=0x700000

# CPP
CONFIG_LINK_CPP_RUNTIME_SECTIONS=n
CONFIG_CPP_EXCEPTIONS=n

# Debug
CONFIG_BACK_TRACE=y

# freertos
CONFIG_FREERTOS_STATIC_ALLOCATION_ENABLE=y

# main task
CONFIG_MAIN_TASK_STACK_SIZE=8192
CONFIG_MAIN_TASK_PRIORITY=5

# IPC
CONFIG_ARCS_HAL_LSF=y
CONFIG_IPC_LSF=y
CONFIG_DISK_MEM=y
CONFIG_DISK_MEM_SERVER=y
CONFIG_DISK_DRIVER=y
CONFIG_DISK_DRIVER_SDMMC=y

# GPDMA
CONFIG_ARCS_GPDMA_FULL_INIT=y

# Device
CONFIG_LISA_DEVICE=y
CONFIG_LISA_SDMMC_DEVICE=y

# acomp translation
CONFIG_ACOMP=y
CONFIG_ACOMP_TRANSLATION=y
CONFIG_ACOMP_RESMGR=y
CONFIG_ACOMP_TRANS_RES_ENCN_ENC_A_EMMC_ADDR=0x0
CONFIG_ACOMP_TRANS_RES_ENCN_ENC_A_SIZE=3306480
CONFIG_ACOMP_TRANS_RES_ENCN_ENC_B_EMMC_ADDR=0x500000
CONFIG_ACOMP_TRANS_RES_ENCN_ENC_B_SIZE=3286864
CONFIG_ACOMP_TRANS_RES_ENCN_ENC_C_EMMC_ADDR=0xA00000
CONFIG_ACOMP_TRANS_RES_ENCN_ENC_C_SIZE=3286864
CONFIG_ACOMP_TRANS_RES_ENCN_ENC_D_EMMC_ADDR=0xF00000
CONFIG_ACOMP_TRANS_RES_ENCN_ENC_D_SIZE=3286864
CONFIG_ACOMP_TRANS_RES_ENCN_ENC_E_EMMC_ADDR=0x1400000
CONFIG_ACOMP_TRANS_RES_ENCN_ENC_E_SIZE=3286864
CONFIG_ACOMP_TRANS_RES_ENCN_ENC_F_EMMC_ADDR=0x1900000
CONFIG_ACOMP_TRANS_RES_ENCN_ENC_F_SIZE=3561152
CONFIG_ACOMP_TRANS_RES_ENCN_DEC_EMMC_ADDR=0x1E00000
CONFIG_ACOMP_TRANS_RES_ENCN_DEC_SIZE=4429216
CONFIG_ACOMP_TRANS_RES_ENCN_DEC_EMB_EMMC_ADDR=0x2300000
CONFIG_ACOMP_TRANS_RES_ENCN_DEC_EMB_SIZE=1936384
CONFIG_ACOMP_TRANS_RES_ENCN_ENC_EMB_EMMC_ADDR=0x2800000
CONFIG_ACOMP_TRANS_RES_ENCN_ENC_EMB_SIZE=1936384
CONFIG_ACOMP_TRANS_RES_CNEN_ENC_A_EMMC_ADDR=0x2D00000
CONFIG_ACOMP_TRANS_RES_CNEN_ENC_A_SIZE=3306480
CONFIG_ACOMP_TRANS_RES_CNEN_ENC_B_EMMC_ADDR=0x3200000
CONFIG_ACOMP_TRANS_RES_CNEN_ENC_B_SIZE=3286864
CONFIG_ACOMP_TRANS_RES_CNEN_ENC_C_EMMC_ADDR=0x3700000
CONFIG_ACOMP_TRANS_RES_CNEN_ENC_C_SIZE=3286864
CONFIG_ACOMP_TRANS_RES_CNEN_ENC_D_EMMC_ADDR=0x3C00000
CONFIG_ACOMP_TRANS_RES_CNEN_ENC_D_SIZE=3286864
CONFIG_ACOMP_TRANS_RES_CNEN_ENC_E_EMMC_ADDR=0x4100000
CONFIG_ACOMP_TRANS_RES_CNEN_ENC_E_SIZE=3286864
CONFIG_ACOMP_TRANS_RES_CNEN_ENC_F_EMMC_ADDR=0x4600000
CONFIG_ACOMP_TRANS_RES_CNEN_ENC_F_SIZE=3561152
CONFIG_ACOMP_TRANS_RES_CNEN_DEC_EMMC_ADDR=0x4B00000
CONFIG_ACOMP_TRANS_RES_CNEN_DEC_SIZE=4429216
CONFIG_ACOMP_TRANS_RES_CNEN_DEC_EMB_EMMC_ADDR=0x5000000
CONFIG_ACOMP_TRANS_RES_CNEN_DEC_EMB_SIZE=1936384
CONFIG_ACOMP_TRANS_RES_CNEN_ENC_EMB_EMMC_ADDR=0x5500000
CONFIG_ACOMP_TRANS_RES_CNEN_ENC_EMB_SIZE=1936384

# watchdog
CONFIG_BOOT_WITH_WATCHDOG=y
CONFIG_WATCHDOG_ENABLE=n
```

## src/main.c
```c
#include <stdio.h>

#include "FreeRTOS.h"
#include "task.h"

#include "ic_message.h"
#include "lisa_device.h"
#include "lisa_sdmmc.h"

#include "acomp.h"
#include "app_translation.h"

#if defined(CONFIG_DISK_MEM_SERVER)
#include "disk_mem.h"
#endif

#define TAG "main"
#include "lisa_log.h"

int main(int argc, char **argv)
{
    LISA_LOGI(TAG, "CP=======! Hard ID: %d", CONFIG_HARTID);

    ic_message_init();
    LISA_LOGI(TAG, "ic_message_init done!");

#if defined(CONFIG_LISA_SDMMC_DEVICE)
    int ret;
    lisa_device_t *sdmmc;

    sdmmc = lisa_device_get("sdmmc0");
    if (!sdmmc) {
        LISA_LOGE(TAG, "get sdmmc0 failed");
    } else {
        ret = lisa_sdmmc_probe(sdmmc);
        if (ret != LISA_DEVICE_OK) {
            LISA_LOGE(TAG, "sdmmc probe failed: %d", ret);
        } else {
            LISA_LOGI(TAG, "sdmmc probe success");
        }
    }
#endif

#if defined(CONFIG_DISK_MEM_SERVER)
    disk_mem_urpc_init();
    LISA_LOGI(TAG, "disk_mem_urpc_init done!");
#endif

    vTaskDelay(pdMS_TO_TICKS(2000));

    acomp_init();

    return app_translation_init();
}
```
