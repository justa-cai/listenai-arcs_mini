## CMakeLists.txt
```
cmake_minimum_required(VERSION 3.19)

set(CMAKE_EXPORT_COMPILE_COMMANDS ON)

find_package(listenai-cmake REQUIRED HINTS $ENV{ARCS_BASE})

project(arcs)

# listenai_include_directories(${CMAKE_CURRENT_SOURCE_DIR})

add_subdirectory(src)

listenai_add_executable(${PROJECT_NAME})
```

## sample.yaml
```
tests:
  samples.algorithms.face_detect:
    build_only: true
```

## prj.conf
```kconfig
# CP核内存布局（与 memap.h 一致）
CONFIG_MEM_FLASH_BASE=0x30800000
CONFIG_MEM_FLASH_SIZE=0x00800000

CONFIG_MEM_PSRAM_BASE=0x28800000
CONFIG_MEM_PSRAM_SIZE=0x800000

CONFIG_MEM_SRAM_BASE=0x20010000
CONFIG_MEM_SRAM_SIZE=0x20000

CONFIG_MEM_IPC_BASE=0x20040000
CONFIG_MEM_IPC_SIZE=0x2000

CONFIG_MEM_LUNA_SHARED_BASE=0x20042000
CONFIG_MEM_LUNA_SHARED_SIZE=0x7000

CONFIG_MEM_APRAM_BASE=0x20050000
CONFIG_MEM_APRAM_SIZE=0x60000

# CP core
CONFIG_ARCS_CP_CORE=y

# not boot loader
# CP这里一定不能使能，否则会初始化时钟和PSRAM，和AP冲突
CONFIG_BOOT_HART=n
CONFIG_BOOT=n

# C LIB
CONFIG_LINK_OPTION_NONE_SPECS=y

# HEAP
CONFIG_HEAP_SIZE=0x10000
CONFIG_PSRAM_HEAP_SIZE=0x200000

# CPP
CONFIG_LINK_CPP_RUNTIME_SECTIONS=n
CONFIG_CPP_EXCEPTIONS=n

# Debug
CONFIG_BACK_TRACE=y

# freertos
CONFIG_FREERTOS_STATIC_ALLOCATION_ENABLE=y

# main task
CONFIG_MAIN_TASK_STACK_SIZE=8192
CONFIG_MAIN_TASK_PRIORITY=5

# IPC
CONFIG_ARCS_HAL_LSF=y
CONFIG_IPC_LSF=y
CONFIG_DISK_MEM=n
# CONFIG_ARCS_HAL_IC_MUTEX=n

# GPDMA
CONFIG_ARCS_GPDMA_FULL_INIT=y

# acomp fd
CONFIG_ACOMP=y
CONFIG_ACOMP_FD=y

CONFIG_ACOMP_FD_RES_FACE_DETECT_ADDRESS=0x30100000
CONFIG_ACOMP_FD_RES_FACE_DETECT_LENGTH=450936
CONFIG_ACOMP_FD_RES_FACE_ALIGN_ADDRESS=0x30170000
CONFIG_ACOMP_FD_RES_FACE_ALIGN_LENGTH=557304
CONFIG_ACOMP_FD_RES_FACE_LIVE_ADDRESS=0x30200000
CONFIG_ACOMP_FD_RES_FACE_LIVE_LENGTH=734752
CONFIG_ACOMP_FD_FACE_VERIFY_ADDRESS=0x302C0000
CONFIG_ACOMP_FD_FACE_VERIFY_LENGTH=1936808

# watchdog
CONFIG_BOOT_WITH_WATCHDOG=y
CONFIG_WATCHDOG_ENABLE=n

# work queue
CONFIG_WORK_QUEUE=y
```

## src/main.c
```c
#include "stdio.h"
#include <string.h>
#include <stdbool.h>

#include "FreeRTOS.h"

#include "ic_message.h"

#include "app_fd.h"
#include "app_fd_image_input.h"

#include "test_image.h"

#define TAG "main"

#include "lisa_log.h"

int main(int argc, char **argv)
{
    printf("CP=======! Hard ID: %d\n", CONFIG_HARTID);

    ic_message_init();
    LISA_LOGI(TAG, "ic_message_init done!");

    vTaskDelay(pdMS_TO_TICKS(2000));

    /* 算法组件初始化 */
    acomp_init();
    
    /* 人脸识别组件初始化 */
    app_fd_init();

    /* 人脸识别组件输入图片数据流初始化 */
    app_fd_image_stream_init();

    image_frame_t image_frame = {
        .image_data = (uint8_t *)yuyv422_320_240,
        .image_index = 0,
        .image_length = yuyv422_320_240_len,
        .image_width = 320,
        .image_height = 240,
        .image_format = PIX_FMT_YUV422_YUYV_PACKED,
    };

    while(1){
        vTaskDelay(pdMS_TO_TICKS(1000));
        /* 给算法组件输入图片数据 */
        app_fd_image_send(&image_frame);
    }

    return 0;
}
```
