## CMakeLists.txt
```
cmake_minimum_required(VERSION 3.19)

set(CMAKE_EXPORT_COMPILE_COMMANDS ON)

find_package(listenai-cmake REQUIRED HINTS $ENV{ARCS_BASE})

project(arcs)

listenai_include_directories(${CMAKE_CURRENT_SOURCE_DIR})
listenai_include_directories(${CMAKE_CURRENT_SOURCE_DIR}/src)
listenai_include_directories(${CMAKE_CURRENT_SOURCE_DIR}/src/app_cv)

add_subdirectory(src)

listenai_add_executable(${PROJECT_NAME})
```

## sample.yaml
```
tests:
  samples.algorithms.spv:
    build_only: true
```

## prj.conf
```kconfig
# 使用自定义内存配置文件和自定义链接脚本
CONFIG_MEM_CONFIG=n
CONFIG_MEM_FLASH_BASE=0x308D0000
CONFIG_MEM_FLASH_SIZE=0x0072D000
CONFIG_MEM_PSRAM_BASE=0x28800000
CONFIG_MEM_PSRAM_SIZE=0x00800000
CONFIG_MEM_SRAM_BASE=0x20010000
CONFIG_MEM_SRAM_SIZE=0x00024800

# CP core
CONFIG_ARCS_CP_CORE=y

# not boot loader
CONFIG_BOOT_HART=n
CONFIG_BOOT=n

# C LIB
CONFIG_LINK_OPTION_NONE_SPECS=y

# HEAP
CONFIG_HEAP_SIZE=0x3AD0
CONFIG_PSRAM_HEAP_SIZE=0x700000

# CPP
CONFIG_LINK_CPP_RUNTIME_SECTIONS=n
CONFIG_CPP_EXCEPTIONS=n

# Debug
CONFIG_BACK_TRACE=y

# freertos
CONFIG_FREERTOS_STATIC_ALLOCATION_ENABLE=y

# main task
CONFIG_MAIN_TASK_STACK_SIZE=8192
CONFIG_MAIN_TASK_PRIORITY=5

# IPC
CONFIG_ARCS_HAL_LSF=y
CONFIG_IPC_LSF=y
CONFIG_DISK_MEM=y
CONFIG_DISK_MEM_SERVER=y
CONFIG_DISK_DRIVER=y
CONFIG_DISK_DRIVER_SDMMC=y

# GPDMA
CONFIG_ARCS_GPDMA_FULL_INIT=y

# Device
CONFIG_LISA_DEVICE=y
CONFIG_LISA_SDMMC_DEVICE=y

# acomp cv
CONFIG_ACOMP=y
CONFIG_ACOMP_CV=y
CONFIG_ACOMP_RESMGR=y
CONFIG_ACOMP_CV_RES_CUTLINE_EMMC_ADDR=0x9B00000
CONFIG_ACOMP_CV_RES_CUTLINE_SIZE=461952
CONFIG_ACOMP_CV_RES_OCR_EMMC_ADDR=0xA000000
CONFIG_ACOMP_CV_RES_OCR_SIZE=4586672

# watchdog
CONFIG_BOOT_WITH_WATCHDOG=y
CONFIG_WATCHDOG_ENABLE=n
```

## src/main.c
```c
#include <stdio.h>

#include "FreeRTOS.h"
#include "task.h"

#include "ic_message.h"
#include "lisa_device.h"
#include "lisa_sdmmc.h"

#include "acomp.h"
#include "app_cv.h"

#if defined(CONFIG_DISK_MEM_SERVER)
#include "disk_mem.h"
#endif

#define TAG "main"
#include "lisa_log.h"

int main(int argc, char **argv)
{
    int ret;

    LISA_LOGI(TAG, "CP=======! Hard ID: %d", CONFIG_HARTID);

    ic_message_init();
    LISA_LOGI(TAG, "ic_message_init done!");

#if defined(CONFIG_LISA_SDMMC_DEVICE)
    lisa_device_t *sdmmc;

    sdmmc = lisa_device_get("sdmmc0");
    if (sdmmc == NULL) {
        LISA_LOGE(TAG, "get sdmmc0 failed");
    } else {
        ret = lisa_sdmmc_probe(sdmmc);
        if (ret != LISA_DEVICE_OK) {
            LISA_LOGE(TAG, "sdmmc probe failed: %d", ret);
        } else {
            LISA_LOGI(TAG, "sdmmc probe success");
        }
    }
#endif

#if defined(CONFIG_DISK_MEM_SERVER)
    disk_mem_urpc_init();
    LISA_LOGI(TAG, "disk_mem_urpc_init done!");
#endif

    vTaskDelay(pdMS_TO_TICKS(2000));

    acomp_init();

    ret = app_cv_init();
    if (ret != 0) {
        return ret;
    }

    return app_cv_send_test_image();
}
```
