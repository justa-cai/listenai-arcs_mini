## Kconfig
```
# Copyright (c) 2026, LISTENAI
# SPDX-License-Identifier: Apache-2.0

osource "$ARCS_BASE/Kconfig"
```

## sample.yaml
```
tests:
  samples.algorithms.palm:
    build_only: true
```

## prj.conf
```kconfig
# CP核内存布局（与 memap.h 一致）
CONFIG_MEM_FLASH_BASE=0x30800000
CONFIG_MEM_FLASH_SIZE=0x00800000

CONFIG_MEM_PSRAM_BASE=0x28800000
CONFIG_MEM_PSRAM_SIZE=0x800000

CONFIG_MEM_SRAM_BASE=0x20010000
CONFIG_MEM_SRAM_SIZE=0x20000

CONFIG_MEM_IPC_BASE=0x20040000
CONFIG_MEM_IPC_SIZE=0x2000

CONFIG_MEM_LUNA_SHARED_BASE=0x20042000
CONFIG_MEM_LUNA_SHARED_SIZE=0x7000

CONFIG_MEM_APRAM_BASE=0x20050000
CONFIG_MEM_APRAM_SIZE=0x60000

# CP core
CONFIG_ARCS_CP_CORE=y

# not boot loader
# CP这里一定不能使能，否则会初始化时钟和PSRAM，和AP冲突
CONFIG_BOOT_HART=n
CONFIG_BOOT=n

# C LIB
CONFIG_LINK_OPTION_NONE_SPECS=y

# HEAP
CONFIG_HEAP_SIZE=0x10000
CONFIG_PSRAM_HEAP_SIZE=0x200000

# CPP
CONFIG_LINK_CPP_RUNTIME_SECTIONS=n
CONFIG_CPP_EXCEPTIONS=n

# Debug
CONFIG_BACK_TRACE=y

# freertos
CONFIG_FREERTOS_STATIC_ALLOCATION_ENABLE=y

# main task
CONFIG_MAIN_TASK_STACK_SIZE=8192
CONFIG_MAIN_TASK_PRIORITY=5

# IPC
CONFIG_ARCS_HAL_LSF=y
CONFIG_IPC_LSF=y
CONFIG_DISK_MEM=n

# GPDMA
CONFIG_ARCS_GPDMA_FULL_INIT=y

# acomp palm
CONFIG_ACOMP=y
CONFIG_ACOMP_PALM=y

CONFIG_ACOMP_PALM_RES_DETECT_ADDRESS=0x30090000
CONFIG_ACOMP_PALM_RES_DETECT_LENGTH=83288
CONFIG_ACOMP_PALM_RES_VERIFY_ADDRESS=0x300B0000
CONFIG_ACOMP_PALM_RES_VERIFY_LENGTH=92680

# watchdog
CONFIG_BOOT_WITH_WATCHDOG=y
CONFIG_WATCHDOG_ENABLE=n

# work queue
CONFIG_WORK_QUEUE=y
```

## src/main.c
```c
#include <stdint.h>
#include <stdio.h>

#include "FreeRTOS.h"
#include "task.h"

#include "acomp.h"
#include "ic_message.h"

#include "app_palm.h"
#include "app_palm_image_input.h"
#include "test_image.h"

#define TAG "main"
#include "lisa_log.h"

int main(int argc, char **argv)
{
    (void)argc;
    (void)argv;

    int ret;
    uint32_t frame_index = 0U;

    LISA_LOGI(TAG, "CP=======! Hard ID: %d", CONFIG_HARTID);

    ic_message_init();
    LISA_LOGI(TAG, "ic_message_init done!");

    vTaskDelay(pdMS_TO_TICKS(2000));

    acomp_init();

    ret = app_palm_init();
    if (ret != 0) {
        return ret;
    }

    ret = app_palm_image_stream_init();
    if (ret != 0) {
        return ret;
    }

    palm_image_frame_t image_frame = {
        .image_data = (uint8_t *)palm_320_240_bin,
        .image_index = 0,
        .image_length = palm_320_240_bin_len,
        .image_width = 320,
        .image_height = 240,
        .image_format = ACOMP_PALM_PIX_FMT_BGR888,
    };

    while (1) {
        vTaskDelay(pdMS_TO_TICKS(1000));
        image_frame.image_index = frame_index++;
        (void)app_palm_image_send(&image_frame);
    }

    return 0;
}
```
