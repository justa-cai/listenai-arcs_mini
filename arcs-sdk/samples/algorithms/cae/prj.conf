## CMakeLists.txt
```
cmake_minimum_required(VERSION 3.19)
set(CMAKE_EXPORT_COMPILE_COMMANDS ON)
find_package(listenai-cmake REQUIRED HINTS $ENV{ARCS_BASE})
project(arcs)

listenai_include_directories(${CMAKE_CURRENT_SOURCE_DIR})
listenai_include_directories(${CMAKE_CURRENT_SOURCE_DIR}/src)
listenai_include_directories(${CMAKE_CURRENT_SOURCE_DIR}/src/app_cae)

listenai_add_executable(${PROJECT_NAME})

target_sources(${PROJECT_NAME}
    PRIVATE src/main.c
    PRIVATE src/app_cae/app_cae.c
    PRIVATE src/app_cae/cae_audio_in.c
    PRIVATE src/app_cae/cae_audio_out.c
    PRIVATE src/app_cae/cae_uac.c
)
```

## sample.yaml
```
tests:
  samples.algorithms.cae:
    programmer: arcs
    runner: uart
    build_only: true
    log_analyzer:
      type: "regex"
      pattern: "CAE 音频输入已启动"
```

## prj.conf
```kconfig
# CP核内存布局（与 memap.h 一致）
CONFIG_MEM_FLASH_BASE=0x30800000
CONFIG_MEM_FLASH_SIZE=0x00800000

CONFIG_MEM_PSRAM_BASE=0x28800000
CONFIG_MEM_PSRAM_SIZE=0x800000

# CP core
CONFIG_ARCS_CP_CORE=y

# not boot loader
CONFIG_BOOT_HART=n
CONFIG_BOOT=n

# C LIB
CONFIG_LINK_OPTION_NONE_SPECS=y

# HEAP
CONFIG_HEAP_SIZE=0x10000
CONFIG_PSRAM_HEAP_SIZE=0x700000

# CPP
CONFIG_LINK_CPP_RUNTIME_SECTIONS=n
CONFIG_CPP_EXCEPTIONS=n

# Debug
CONFIG_BACK_TRACE=y

# freertos
CONFIG_FREERTOS_STATIC_ALLOCATION_ENABLE=y

# main task
CONFIG_MAIN_TASK_STACK_SIZE=8192
CONFIG_MAIN_TASK_PRIORITY=5

# cJSON
CONFIG_CJSON=y

# IPC
CONFIG_ARCS_HAL_LSF=y
CONFIG_IPC_LSF=y
CONFIG_DISK_MEM=n
# CONFIG_ARCS_HAL_IC_MUTEX=n

# GPDMA
CONFIG_ARCS_GPDMA_FULL_INIT=y

# Audio
CONFIG_LISA_DEVICE=y
CONFIG_LISA_AUDIO_DEVICE=y
CONFIG_LISA_AUDIO_PLAY_ECHO_ENABLE=y

# USB UAC microphone for CAE processed PCM output
CONFIG_CHERRYUSB=y
CONFIG_CHERRYUSB_DEVICE=y
CONFIG_CHERRYUSB_DEVICE_SPEED_HS=y
CONFIG_CHERRYUSB_DEVICE_MUSB_LISA=y
CONFIG_CHERRYUSB_DEVICE_AUDIO=y

# acomp cae
CONFIG_ACOMP=y
CONFIG_ACOMP_WAKEUP=n
CONFIG_ACOMP_CAE=y
CONFIG_ACOMP_CAE_ALGORITHM_TYPE_SINGLE_MIC=y
CONFIG_ACOMP_CAE_RES_CAE_AES_ADDRESS=0x30200000
CONFIG_ACOMP_CAE_RES_CAE_AES_LENGTH=200000
CONFIG_ACOMP_CAE_RES_CAE_JSON_ADDRESS=0x304D0000
CONFIG_ACOMP_CAE_RES_CAE_JSON_LENGTH=141

# watchdog
CONFIG_BOOT_WITH_WATCHDOG=y
CONFIG_WATCHDOG_ENABLE=n
CONFIG_WORK_QUEUE=y
```

## src/main.c
```c
#include "stdio.h"
#include <string.h>
#include <stdbool.h>

#include "FreeRTOS.h"
#include "task.h"
#include "semphr.h"

#include "ic_message.h"

#include "acomp.h"
#include "app_cae.h"

#define TAG "main"
#include "lisa_log.h"

int main(int argc, char **argv)
{
    LISA_LOGI(TAG, "CP=======! Hard ID: %d", CONFIG_HARTID);

    ic_message_init();
    LISA_LOGI(TAG, "ic_message_init done!");

    vTaskDelay(pdMS_TO_TICKS(2000));

    acomp_init();
    app_cae_init();

    return 0;
}
```
