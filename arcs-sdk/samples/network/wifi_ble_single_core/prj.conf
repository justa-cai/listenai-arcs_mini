## CMakeLists.txt
```
cmake_minimum_required(VERSION 3.13)

set(LISTENAI_MODULES_DIR_LIST
    $ENV{ARCS_BASE}
    $ENV{ARCS_BASE}/../modules
    $ENV{ARCS_BASE}/../components
    ${CMAKE_CURRENT_SOURCE_DIR}/src
)

set(CMAKE_EXPORT_COMPILE_COMMANDS ON)

find_package(listenai-cmake REQUIRED HINTS $ENV{ARCS_BASE})

project(arcs)

listenai_include_directories(
    ./
)

listenai_add_executable(${PROJECT_NAME})
listenai_link_libraries(mbedtls)
```

## sample.yaml
```
tests:
  samples.wifi_ble_single_core:
    programmer: arcs
    runner: uart
    log_analyzer:
      type: "regex"
      pattern: "EVENT_WIFI_INIT_DONE"
```

## prj.conf
```kconfig
CONFIG_BACKTRACE=y

CONFIG_HEAP_SIZE=0xC000
CONFIG_PSRAM_HEAP_SIZE=0x200000

CONFIG_SDK_MODULE_LETTER_SHELL_ENHANCE=y
CONFIG_RTOS_AL=y

CONFIG_ARCS_CP_CORE=y
CONFIG_ARCS_HAL_WCND=y
CONFIG_ARCS_HAL_AT_CMD=y
CONFIG_ARCS_HAL_FLASH_IF=y
CONFIG_ARCS_HAL_NVS=y

CONFIG_LISA_PORTING=y
CONFIG_LISA_OS=y
CONFIG_LISA_DEVICE=y
CONFIG_LISA_SHELL=y
CONFIG_LISA_WIFI=y
CONFIG_LISA_SDMMC_DEVICE=y

CONFIG_WIFI_MANAGER=y
CONFIG_WIFI_LWIP_SAME_CORE=y

CONFIG_MAC_MANAGER=y
CONFIG_MAC_MANAGER_MAC_BY_CHIP_ID=y

CONFIG_FILE_SYSTEM=y
CONFIG_FATFS_FILESYSTEM=y

CONFIG_DISK_DRIVER=y
CONFIG_DISK_DRIVER_SDMMC=y

CONFIG_LSFS=y
CONFIG_LSFS_FAT=y
CONFIG_LSFS_REGISTER_VFS=y

CONFIG_LVFS=y

# CONFIG_MODULE_EASYFLASH=y

# Lisa Bluetooth
CONFIG_BLE=y
CONFIG_LISA_BLUETOOTH=y
CONFIG_BLE_PROFILE_HOGPD=y
CONFIG_BLE_PROFILE_NETCFG_BLES=y
CONFIG_BLE_PROFILE_BASS=y
```

## src/main.c
```c
#include <string.h>
#include <stdbool.h>
#include <assert.h>
#include <stdio.h>
#include <stdlib.h>

#include "arcs_ap_base.h"
#include "cli_main.h"
#include "spiflash.h"

#include "lisa_bluetooth.h"
#include "bt_app_if.h"
#include "bt_stack_if.h"

#include "hogpd_msg.h"
#include "hogpd.h"
#include "bass.h"
#include "diss.h"
#include "netcfg_bles.h"

#include "FreeRTOS.h"
#include "task.h"
#include "nvs.h"
#include "shell.h"

#define TAG "app-wifi"
#include "lisa_log.h"

#include "lisa_shell.h"
#include "mac_manager.h"
#include "mac_manager_ops.h"
#include "wifi_manager/wifi_manager.h"
#if CONFIG_LISA_WIFI
#include "lisa_wifi.h"
#endif
#include "ls_event.h"
#include "ls_wifi_type.h"
#include "net_al.h"
#include "net_def.h"

#define TARGET_WIFI_SSID "listenai"
#define TARGET_WIFI_PWD "listenai"

#define WIFI_MGR_SEARCH_AP_BUFFER_SIZE 10
#define WIFI_MGR_AUTO_CONNECT_INTERVAL_MS 2000

static mac_manager_t *m_mac_manager;
static wifi_mgr_sta_config_t list[WIFI_MGR_SEARCH_AP_BUFFER_SIZE] = { 0 };

#if CFG_NVS
#define NVDS_FLASH_ADDRESS_OFFSET   (0xFF8000) //The last 32KB of 16B flash
#define NVDS_FLASH_SIZE      (0x8000) //32KB

struct nvs_fs arcs_nvs_fs;
FLASH_DEV arcs_flash_dev  = {
    .base_addr = CMN_FLASHC_BASE,
    .d_width = 4,
    .sclk_div = 0xFF, //divider is 1
    .run_mod = RUN_WITHOUT_INT,
    .timeout = 0x180000
};

int arcs_nvs_init(void)
{
    struct flash_pages_info info;

    flash_if_init(&arcs_flash_dev, 0, 0);

    //init nvs module
    arcs_nvs_fs.offset = NVDS_FLASH_ADDRESS_OFFSET;
    arcs_nvs_fs.flash_device = &arcs_flash_dev;
    flash_get_page_info_by_offs(&arcs_flash_dev, arcs_nvs_fs.offset, &info);
    arcs_nvs_fs.sector_size = info.size;
    arcs_nvs_fs.sector_count = NVDS_FLASH_SIZE/info.size;

    nvds_init(&arcs_nvs_fs);

    return 0;
}
#endif

static mac_manager_t *m_mac_manager;

static void user_wifi_manager_init(void);

static void cb_lisa_wifi_init_done(void)
{
    LOGI("lisa_wifi_init_done");

    user_fs_init();
    lisa_kv_init();
    user_wifi_manager_init();
}

static int8_t custom_get_wifi_mac(uint8_t mac_addr[6])
{
    int8_t ret = 0;

    if (!mac_addr)
        return -1;

    ret = mac_manager_get(m_mac_manager, mac_addr, 6);
    LOGI("custom_get_wifi_mac: %d, %02X:%02X:%02X:%02X:%02X:%02X", ret, mac_addr[0], mac_addr[1], mac_addr[2], mac_addr[3], mac_addr[4], mac_addr[5]);
    return ret;
}

static void dhcp_status_callback(int vif_idx, bool success, uint32_t ip_addr, uint32_t netmask, uint32_t gateway, void *arg)
{
    if (success) {
        LOGI("DHCP Success on VIF-%d: IP=%d.%d.%d.%d, Mask=%d.%d.%d.%d, GW=%d.%d.%d.%d",
             vif_idx,
             ip_addr & 0xff, (ip_addr >> 8) & 0xff, (ip_addr >> 16) & 0xff, (ip_addr >> 24) & 0xff,
             netmask & 0xff, (netmask >> 8) & 0xff, (netmask >> 16) & 0xff, (netmask >> 24) & 0xff,
             gateway & 0xff, (gateway >> 8) & 0xff, (gateway >> 16) & 0xff, (gateway >> 24) & 0xff);
    } else {
        LOGI("DHCP Failed on VIF-%d", vif_idx);
    }
}

static void wifi_mgr_connection_cb(wifi_mgr_connection_info_t *connection_info, void *arg)
{
    net_if_t *net_if;

    LOGI("mgr connection: %d", connection_info->status);

    switch (connection_info->status)
    {
        case WIFI_MGR_STA_CONNECTED:
            LOGI("WiFi connected, starting network interface");
            net_if = net_if_get(WIFI_VIF_STA_IDX);
            net_if_up(net_if);
            if (!net_if->static_ip) {
                ls_dhcpc_start(WIFI_VIF_STA_IDX);
            }
            break;

        case WIFI_MGR_STA_DISCONNECTED:
            LOGI("WiFi disconnected, stopping network interface");
            ls_dhcpc_stop(WIFI_VIF_STA_IDX);
            net_if_down(net_if_get(WIFI_VIF_STA_IDX));
            break;

        case WIFI_MGR_STA_CONNECTING:
            LOGI("WiFi connecting...");
            break;

        default:
            break;
    }
}

static void user_mac_manager_init(void)
{
    mac_manager_config_t config = {
        .random_mac_if_mac_invalid = false,
    };

    m_mac_manager = mac_manager_init(mac_manager_ops_get()->mem_ops, mac_manager_ops_get()->content_ops, &config);
    if (m_mac_manager == NULL) {
        LOGI("[user_wifi]mac_manager_init failed\n");
        assert(0);
    }
}

static void user_wifi_manager_init(void)
{
    wifi_mgr_sta_config_t cfg = {
        .ssid = TARGET_WIFI_SSID,
        .pwd = TARGET_WIFI_PWD,
    };

    wifi_mgr_autoconn_config_t autoconn_cfg = {
        .interval_ms = WIFI_MGR_AUTO_CONNECT_INTERVAL_MS,
    };
    
    wifi_mgr_init(wifi_mgr_ops_get());
    wifi_mgr_sta_enable();

    wifi_mgr_sta_add_connection_cb(wifi_mgr_connection_cb, NULL);

    /* Search and delete all saved APs */
    int count = wifi_mgr_storage_search_ap(list, 10, SEARCH_ALL, NULL);
    for (int i = 0; i < count; i++) {
        LOGI("Deleting saved AP: ssid=%s", list[i].ssid);
        wifi_mgr_storage_delete_ap(&list[i]);
    }

    // wifi_mgr_storage_save_ap(&cfg);
    // wifi_mgr_auto_connect_start(&autoconn_cfg);
}

uint8_t manufacturer_data[18] = {
    0xab, 0x0a, 0xa1, 0xdc, 0xa8, 0x76, 0x83, 0x65, 0x73, 0x83, 0x72, 0x65, 0x82, 0x67, 0x83, 0x68, 0x00, 0x78,
};

ble_gap_cfg_t user_bt_stack_dev_cfg = {
    .addr = {{0x44, 0x55, 0x66, 0x03, 0x23, 0x20}, 0},
    .name_len = sizeof(DEVICE_NAME),
    .name = DEVICE_NAME,
    .appearance = GAP_APP_GENERIC_MEDIA_PLAYER, // hid_keyboard
    .iocap = GAP_IO_CAP_NO_INPUT_NO_OUTPUT,
    .auth = GAP_SEC_NOT_ENC,
    .pairing_mode = GAPM_PAIRING_LEGACY,
};

#if (ADV_USER_DATA)

uint8_t lisa_ble_gen_user_adv_data(uint8_t *p_data)
{
    uint8_t nb_uuid = 1;

    uint16_t uuids[1] = {HID_UUID};

    // Remaining Length
    uint8_t rem_len = LEGA_ADV_DATA_LEN - 3;

    uint8_t *p_buf = p_data;
    uint8_t length = 0;

    /// add Manufacturer specific
    *p_buf++ = sizeof(manufacturer_data) + 1;
    *p_buf++ = 0xff; // GAP_AD_TYPE_MANU_SPECIFIC_DATA;
    memcpy(p_buf, manufacturer_data, 18);
    p_buf += sizeof(manufacturer_data);
    length += (sizeof(manufacturer_data) + 2);

    // Sanity check
    ASSERT_ERR(rem_len >= LEGA_ADV_DATA_LEN - 3);

    // Get remaining space in the Advertising Data - 2 bytes are used for name length/flag
    rem_len -= length;

    // Check if additional data can be added to the Advertising data - 2 bytes needed for type and length
    if (rem_len > 2) {
        uint8_t dev_name_length = MIN(user_bt_stack_dev_cfg.name_len, (rem_len - 2));

        // Device name length
        *p_buf = dev_name_length + 1;
        // Device name flag (check if device name is complete or not)
        *(p_buf + 1) = (dev_name_length == user_bt_stack_dev_cfg.name_len)
                           ? 0x09
                           : 0x08; // GAP_AD_TYPE_COMPLETE_NAME : GAP_AD_TYPE_SHORTENED_NAME;
        // Copy device name
        memcpy(p_buf + 2, user_bt_stack_dev_cfg.name, dev_name_length);

        // Update advertising data length
        length += (dev_name_length + 2);
    }
    return length;
}
#endif

uint8_t adv_user_data[LEGA_ADV_DATA_LEN];
const uint8_t *lisa_bt_get_adv_data(uint8_t *len)
{
    *len = lisa_ble_gen_user_adv_data(adv_user_data);
    return adv_user_data;
}
extern uint16_t netcfg_bles_profile_set_cb(uint8_t conidx, uint8_t att_idx, uint16_t op, uint8_t *p_value);

/// Message callback handle from APP
static const netcfg_bles_cb_t netcfg_app_cb = {
    .cb_value_set = netcfg_bles_profile_set_cb,
};
const diss_cb_t user_bt_stack_ble_diss_msg_cb = {
    .cb_value_get = NULL, // dis_profile_get_cb,
};

/**
 * @brief 初始化自定义服务
 *
 * 注册 GATT 用户回调并添加服务到数据库。
 * 此函数应在协议栈初始化完成后调用。
 */
void app_ble_init_cmp(void)
{
    // enable bass service
    ble_bass_init();
    ble_bass_enable(0, bt_stack_vbat_percent_get());
    // enable net config.
    ble_netcfg_bles_init((netcfg_bles_cb_t *)&netcfg_app_cb);

    // enable diss.
    ble_diss_init((diss_cb_t *)&user_bt_stack_ble_diss_msg_cb);

#if BLE_VOICE_SIMULATOR
    // enable hid service
    uint8_t svc_features = HOGPD_CFG_KEYBOARD | HOGPD_CFG_MOUSE | HOGPD_CFG_PROTO_MODE | HOGPD_CFG_REPORT_NTF_EN;
    uint8_t report_char_cfg = HOGPD_CFG_REPORT_IN;
    hogpd_report_map_t report_map = {sizeof(hid_report_map), 0, (uint8_t *)hid_report_map};
    ble_hogpd_init(svc_features, report_char_cfg, (hogpd_cb_t *)&bt_stack_ble_hogpd_msg_cb, &report_map);
    ble_hogpd_enable(0);
#endif
}

int main(int argc, char **argv)
{
    int ret = 0;

    atcmd_init();

    arcs_nvs_init();

    ret = lisa_shell_init();
    if (ret != 0) {
        LOGI("Failed to initialize shell (error: %d)\n", ret);
    }

    user_mac_manager_init();

    // 注册 DHCP 状态回调
    net_dhcp_register_status_callback(dhcp_status_callback, NULL);

    lisa_wifi_ops_t ops = {
        .init_done = cb_lisa_wifi_init_done,
        .custom_mac = custom_get_wifi_mac,
    };
    lisa_wifi_init(&ops);

    // BLE 初始化
    lisa_bluetooth_init();

    // Start Advertising
    app_ble_adv_start(0, BLE_ADV_GEN);

    // 初始化AT命令处理系统
    at_cmd_init();

    while (1) {
        vTaskDelay(pdMS_TO_TICKS(1000));
    }

    return 0;
}

static int user_wifi_command(int argc, char *argv[])
{
    char cmd_str[256] = {0};

    for (int i = 1; i < argc; i++) {
        strncat(cmd_str, argv[i], sizeof(cmd_str) - strlen(cmd_str) - 1);
        if (i < argc - 1) {
            strncat(cmd_str, " ", sizeof(cmd_str) - strlen(cmd_str) - 1);
        }
    }

    if (cmd_str[0]) {
        wifi_cmd_handler(cmd_str, strlen(cmd_str) + 1);
    }

    return 0;
}

SHELL_EXPORT_CMD(SHELL_CMD_PERMISSION(0) | SHELL_CMD_TYPE(SHELL_TYPE_CMD_MAIN) | SHELL_CMD_DISABLE_RETURN, wifi,
                 user_wifi_command, wifi commands);

                 
```

## src/app_at_cmd.c
```c
#include "shell.h"
#include "shell_passthrough.h"


// 透传模式处理函数(在shell_task中运行,快速返回)
static int at_passthrough_handler(char *data, unsigned short len)
{
    atcmd_handler(data, len);

    return 0;  // 立即返回,不阻塞shell_task
}

// 初始化AT命令处理系统
void at_cmd_init(void)
{
    // shell任务同步执行AT命令,无需额外队列
}

// 注册透传模式命令
// 使用方式:
//   交互模式: AT (进入后可输入AT+?,不需要空格)
//   单行模式: AT AT+? (一次性执行)
SHELL_EXPORT_PASSTROUGH(SHELL_CMD_PERMISSION(0), AT, AT>>, at_passthrough_handler, AT command passthrough mode);
```

## src/app_net_cfg.c
```c
/**
****************************************************************************************
*
* @file netcfg.c
*
* @brief net config
*
* Copyright (C) ListenAI 2020-2099
*
*
****************************************************************************************
*/

/*
 * MACROS
 ****************************************************************************************
 */
#include <stdint.h>
#include <stdbool.h>
#include <string.h>
#include <stdio.h>
#include "netcfg_ble.h"
#include "netcfg_bles.h"

#include "ble_gap.h"

#include "ble_gatt.h"
#include "ble_prf.h"

#include "ls_wifi_type.h"
#include "nvds_tag_def.h"
#include "wifi_api.h"

#include "btos_al.h"

#define BLE_AUTO_SEND_NET_CFG_SUCESS    (1)

extern void HAL_PMU_Chip_Software_Reset_Enable(void);


/// netcfg_ble service environment
static void netcfg_ble_wifi_cfg_store(const int8_t *ssid, const int8_t *pwd, const uint8_t *auto_conn)
{
#if CFG_NVS
    nvds_put(NVDS_TAG_WIFI_STA_SSID, NVDS_LEN_WIFI_STA_SSID, ssid);
    if (strlen(pwd)) {
        nvds_put(NVDS_TAG_WIFI_STA_PWD, NVDS_LEN_WIFI_STA_PWD, pwd);
    } else {
        nvds_del(NVDS_TAG_WIFI_STA_PWD);
    }
    nvds_put(NVDS_TAG_WIFI_STA_AUTOCONN, NVDS_LEN_WIFI_STA_AUTOCONN, auto_conn);
#endif
}

static int netcfg_ble_wifi_connect(const int8_t *ssid, const int8_t *pwd)
{
    wifi_connect_cfg_t sta_config = {
        .dhcp_mode = DHCP_CLIENT,
    };

    if (!ssid || !pwd)
        return -1;
    strcpy(sta_config.ssid, ssid);
    strcpy(sta_config.key, pwd);
    wifi_sta_connect(&sta_config);

    return 0;
}

void netcfg_bles_con_cleanup(uint8_t conidx, uint16_t reason)
{
    void (*pReset)(void);

    if(netcfg_bles_get_state() == NETCFG_BLE_REBOOTING)
        HAL_PMU_Chip_Software_Reset_Enable();
    else
        netcfg_bles_set_state(NETCFG_BLE_IDLE);
}

uint16_t netcfg_ble_notify_wifi(struct netcfg_ble_data *data)
{
    int status = 0;
    uint8_t auto_conn = 1;

#if NETCFG_BLE_DBG
    NETCFG_BLE_LOGD("[%s]: Get ssid = %s, pwd = %s\n", __func__, data->ssid, data->pwd);
#endif

    /*
     * Fix me: Instead of directly call wifi connect, we need to create a task handling
     * the messages and wifi/ble status exchange here.
     * Will implement this later.
     */
    status = netcfg_ble_wifi_connect((const int8_t *)data->ssid, (const int8_t *)data->pwd);
    if (status)
        return NETCFG_BLE_ERR;

    netcfg_ble_wifi_cfg_store((const int8_t *)data->ssid, (const int8_t *)data->pwd, &auto_conn);

    return NETCFG_BLE_SUCCESS;
}


#if (BLE_AUTO_SEND_NET_CFG_SUCESS == 1)
/// dummy to send 
void netcfg_bles_send_connect_status_cb(TimerHandle_t time_id)
{
    app_ble_netcfg_bles_send_notify(0, 0, 0, 0, 0);
    btos_timer_cancel(time_id);
}

void netcfg_bles_send_connect_status_dummy(uint32_t milli_seconds)
{
    TimerHandle_t update_id = btos_timer_creat(TIMER_TYPE_SINGLE, milli_seconds, netcfg_bles_send_connect_status_cb);
}
#endif


uint16_t netcfg_bles_profile_set_cb(uint8_t conidx, uint8_t att_idx, uint16_t op, uint8_t *p_value)
{
    uint16_t sta = NETCFG_BLE_ERR;

    switch(op)
    {
        case NETCFG_BLE_OP_DONE:
        {
            sta = netcfg_ble_notify_wifi((struct netcfg_ble_data *)p_value);
            ///dummy to send connect status.
#if (BLE_AUTO_SEND_NET_CFG_SUCESS == 1)
            netcfg_bles_send_connect_status_dummy(1000);
#endif
        }
        break;
        case NETCFG_BLE_OP_REBOOT:
        {
            ble_gap_disconnect(conidx, 0x13);
        }
        break;
        default:break;
    }
    return sta;
}
```

## src/listen_ble.c
```c
#include "listen_ble.h"
#include "bt_os_task.h"
#include "rom_uart.h"
#include "ble_drv.h"
#include "bt_stack_if.h"

const struct ble_eif_api uart_api =
{
    uart_read,
    uart_write,
    uart_flow_on,
    uart_flow_off,
};

const struct lsip_eif_api* lsip_eif_get(uint8_t idx)
{
    const struct lsip_eif_api* ret = NULL;
    switch(idx)
    {
        case 0:
        {
            ret = (const struct lsip_eif_api*)&uart_api;
        }
        break;
        #if PLF_UART2
        case 1:
        {
            ret = &uart2_api;
        }
        break;
        #endif // PLF_UART2
        default:
        {
            //ASSERT_INFO(0, idx, 0);
        }
        break;
    }
    return ret;
}

int ls_ble_init(void)
{
    extern os_task_cb_t *bt_stack_if_get_cb(void);
    bt_os_init((os_task_cb_t *)bt_stack_if_get_cb());
    os_task_init(NULL);
    
    // bt_uart_comm();
    return 0;
}
```

## src/listen_wifi.c
```c
#include <string.h>
#include <stdbool.h>
#include "wlif.h"
#include "net_ip.h"
#include "net_al.h"
#include "cli_main.h"

#include "sysheap.h"
#include "lisa_log.h"
#include "lisa_mem.h"
#include "listen_wifi.h"
#include "ls_event.h"
#include "ls_wifi_type.h"
#include "wifi_api.h"
#include "vrtc.h"
#include "rf_cali.h"
#include "ls_misc.h"

#if CONFIG_ARCS_HAL_MODULE_SHELL
#include "shell_def.h"
#endif

#define TAG "app-wifi"

static int _handle_wifi_got_ip(void *arg)
{
    net_if_t *net_if = net_if_get(WIFI_VIF_STA_IDX);
    if (net_if) {
        uint32_t ip, mask, gw;
        net_if_get_ip(net_if, &ip, &mask, &gw);

        char addr_str[16 + 1];
        ip4_addr_t addr;

        addr.addr = ip;
        if (ip4addr_ntoa_r(&addr, addr_str, 16) != NULL) {
            LISA_LOGI(TAG, "IP: %s", addr_str);
        }

        addr.addr = mask;
        if (ip4addr_ntoa_r(&addr, addr_str, 16) != NULL) {
            LISA_LOGI(TAG, "Mask: %s", addr_str);
        }

        addr.addr = gw;
        if (ip4addr_ntoa_r(&addr, addr_str, 16) != NULL) {
            LISA_LOGI(TAG, "Gateway: %s", addr_str);
        }
    }

    return 0;
}

static int _app_wifi_event_cb(void *arg, event_module_t event_module, int event_id, void *event_data)
{
    event_ap_sta_add_param_t *sta_add_param;
    event_ap_sta_del_param_t *sta_del_param;
    event_connect_fail_param_t *conn_fail_evt;
    event_disconnect_param_t *disc_evt;

    switch (event_id) 
    {
        case EVENT_WIFI_INIT_DONE:
        LISA_LOGI(TAG, "EVENT_WIFI_INIT_DONE");
        break;
        case EVENT_WIFI_CONNECTED:
        LISA_LOGI(TAG, "EVENT_WIFI_CONNECTED");
        net_if_t *net_if;
        net_if = net_if_get(WIFI_VIF_STA_IDX);
        net_if_up(net_if);
        if (!net_if->static_ip)
            ls_dhcpc_start(WIFI_VIF_STA_IDX);
        break;
        case EVENT_WIFI_GOT_IP:
        LISA_LOGI(TAG, "EVENT_WIFI_GOT_IP");
        break;
        case EVENT_WIFI_STA_DHCP_FAIL:
        LISA_LOGI(TAG, "EVENT_WIFI_STA_DHCP_FAIL");
        ls_dhcpc_stop(WIFI_VIF_STA_IDX);
        break;
        case EVENT_WIFI_DISCONNECT:
        disc_evt = (event_disconnect_param_t *)event_data;
        LISA_LOGI(TAG, "EVENT_WIFI_DISCONNECT");
        ls_dhcpc_stop(WIFI_VIF_STA_IDX);
        net_if_down(net_if_get(WIFI_VIF_STA_IDX));
        break;
        case EVENT_WIFI_SCAN_DONE:
        LISA_LOGI(TAG, "EVENT_WIFI_SCAN_DONE");
        break;
        case EVENT_WIFI_STA_CONNECT_FAIL:
        conn_fail_evt = (event_connect_fail_param_t *)event_data;
        LISA_LOGI(TAG, "EVENT_WIFI_STA_CONNECT_FAIL, reason: %d", conn_fail_evt->reason_code);
        break;
        case EVENT_WIFI_AP_STARTED:
        LISA_LOGI(TAG, "EVENT_WIFI_AP_STARTED");
        net_if_up(net_if_get(WIFI_VIF_AP_IDX));
        // start DHCPS
        ls_dhcps_start(WIFI_VIF_AP_IDX);
        break;
        case EVENT_WIFI_AP_STA_ADD:
        sta_add_param = (event_ap_sta_add_param_t *)event_data;
        LISA_LOGI(TAG, "EVENT_WIFI_AP_STA_ADD, sta_idx: %d", sta_add_param->sta_idx);
        break;
        case EVENT_WIFI_AP_STA_DEL:
        sta_del_param = (event_ap_sta_del_param_t *)event_data;
        LISA_LOGI(TAG, "EVENT_WIFI_AP_STA_DEL, sta_idx: %d", sta_del_param->sta_idx);
        break;
        case EVENT_WIFI_AP_STOPPED:
        LISA_LOGI(TAG, "EVENT_WIFI_AP_STOPPED");
        ls_dhcps_stop();
        net_if_down(net_if_get(WIFI_VIF_AP_IDX));
        break;
        default:
        LISA_LOGI(TAG, "rx event <%d %d>", event_module, event_id);
        break;
    }
}

extern void ls_crypto_init(void);
extern uint8_t _sshram[], _eshram[];

struct wifi_ops ops = {
    .get_mac = ls_get_wifi_mac,
    .temp_update = ls_temp_por_update,
};


void ls_wifi_init(void)
{
    memset(_sshram, 0, (_eshram - _sshram));
    int ret = 0;

    ls_crypto_init();

    ls_event_init();

    ls_event_register_cb(EVENT_WIFI, EVENT_ID_ALL, _app_wifi_event_cb, NULL);

    wifi_ops_register(&ops);
    wifi_init();
    
    vrtc_init();

}
```

## src/listen_wifi.h
```c
/**
 * Copyright (c) 2025, LISTENAI
 *
 * SPDX-License-Identifier: Apache-2.0
 */

#ifndef __LISTENAI_WIFI_MANAGER_H__
#define __LISTENAI_WIFI_MANAGER_H__

#include <stdint.h>
#include <stdbool.h>

/**
 * Wifi初始化
 */
void ls_wifi_init(void);

#endif
```

## src/rom_uart.c
```c
/*
 * hci_uart.c
 *
 *  Created on: 2021������4������25������
 *      Author: USER
 */
#include "chip.h"
#include "IOMuxManager.h"
#include "Driver_UART.h"
#include "log_print.h"
#include <string.h>
#include <assert.h>
#include <string.h>
#include <stdbool.h>
// #include "rom_main.h"
#include "rom_uart.h"

/*
 * GLOBAL VARIABLE DEFINITIONS
 ****************************************************************************************
 */
/// uart environment structure
static volatile struct uart_env_tag uart1_env, uart2_env;

static void UART_EventCallback(uint32_t event, void* workspace){
    void (*callback) (void*, uint8_t) = NULL;
    void* data =NULL;

    volatile struct uart_env_tag *uart = (struct uart_env_tag*)workspace;

    uart->uart_event |= event;

    if(event & CSK_UART_EVENT_RECEIVE_COMPLETE)
    {
        // Retrieve callback pointer
        callback = uart->rx.callback;
        data     = uart->rx.dummy;

        if(callback != NULL)
        {
            // Clear callback pointer
            uart->rx.callback = NULL;
            uart->rx.dummy    = NULL;

            // Call handler
            callback(data, LSIP_EIF_STATUS_OK);
        }
        else
        {
            ASSERT_ERR(0);
        }
    }
    if(event & CSK_UART_EVENT_SEND_COMPLETE)
    {
        // Retrieve callback pointer
        callback = uart->tx.callback;
        data     = uart->tx.dummy;

        if(callback != NULL)
        {
            // Clear callback pointer
            uart->tx.callback = NULL;
            uart->tx.dummy    = NULL;
            // Call handler
            callback(data, LSIP_EIF_STATUS_OK);
        }
        else
        {
            ASSERT_ERR(0);
        }
    }

}


void uart_init(void){
	void *UART_Handler = NULL;

    IOMuxManager_PinConfigure(UART0_IO_TX_PAD, UART0_IO_TX_PIN, UART0_IO_TX_SEL);
    IOMuxManager_PinConfigure(UART0_IO_RX_PAD, UART0_IO_RX_PIN, UART0_IO_RX_SEL);
    IOMuxManager_PinConfigure(UART0_IO_CTS_PAD, UART0_IO_CTS_PIN, UART0_IO_CTS_SEL);
    IOMuxManager_PinConfigure(UART0_IO_RTS_PAD, UART0_IO_RTS_PIN, UART0_IO_RTS_SEL);

    UART_Handler = UART0();
    uart1_env.uart_event = 0;

    UART_Uninitialize(UART_Handler);
    UART_Initialize(UART_Handler, UART_EventCallback, (void *)&uart1_env);

    UART_PowerControl(UART_Handler, CSK_POWER_FULL);

    UART_Control(UART_Handler, CSK_UART_MODE_ASYNCHRONOUS_TIMEOUT |
                        CSK_UART_DATA_BITS_8 |
                        CSK_UART_PARITY_NONE |
                        CSK_UART_STOP_BITS_1 |
						CSK_UART_FLOW_CONTROL_NONE |
                        CSK_UART_Function_CONTROL_Int |
                        CSK_UART_GPIO_CONTROL_DEFAULT, BAUD_RATE_UART0);

    UART_Control(UART_Handler, CSK_UART_CONTROL_TX, 1);
    UART_Control(UART_Handler, CSK_UART_CONTROL_RX, 1);

    uart1_env.UART_Handler = UART_Handler;
}

void uart2_init(void){
	void *UART_Handler = NULL;

    IOMuxManager_PinConfigure(UART1_IO_TX_PAD, UART1_IO_TX_PIN, UART1_IO_TX_SEL);
    IOMuxManager_PinConfigure(UART1_IO_RX_PAD, UART1_IO_RX_PIN, UART1_IO_RX_SEL);
    IOMuxManager_PinConfigure(UART1_IO_CTS_PAD, UART1_IO_CTS_PIN, UART1_IO_CTS_SEL);
    IOMuxManager_PinConfigure(UART1_IO_RTS_PAD, UART1_IO_RTS_PIN, UART1_IO_RTS_SEL);

    UART_Handler = UART1();
    uart1_env.uart_event = 0;

    UART_Initialize(UART_Handler, UART_EventCallback, (void *)&uart1_env);

    UART_PowerControl(UART_Handler, CSK_POWER_FULL);

    UART_Control(UART_Handler, CSK_UART_MODE_ASYNCHRONOUS |
                        CSK_UART_DATA_BITS_8 |
                        CSK_UART_PARITY_NONE |
                        CSK_UART_STOP_BITS_1 |
                        CSK_UART_FLOW_CONTROL_NONE |
                        CSK_UART_Function_CONTROL_Int |
                        CSK_UART_GPIO_CONTROL_DEFAULT, BAUD_RATE_UART1);

    UART_Control(UART_Handler, CSK_UART_CONTROL_TX, 1);
    UART_Control(UART_Handler, CSK_UART_CONTROL_RX, 1);

    uart1_env.UART_Handler = UART_Handler;
}

void uart_flow_on(void)
{
    // Configure modem (HW flow control enable)
    //uart_force_rts_setf(0);
}

bool uart_flow_off(void)
{
	return true;
}

void uart_finish_transfers(void)
{
	while(!(uart1_env.uart_event & CSK_UART_EVENT_SEND_COMPLETE));
}

void uart2_flow_on(void)
{
    // Configure modem (HW flow control enable)
    //uart_force_rts_setf(0);
}

bool uart2_flow_off(void)
{
	return true;
}

void uart2_finish_transfers(void)
{
	while(!(uart2_env.uart_event & CSK_UART_EVENT_SEND_COMPLETE));
}

void uart_read(uint8_t *bufptr, uint32_t size, void (*callback) (void*, uint8_t), void* dummy)
{
    // Sanity check
    ASSERT_ERR(bufptr != NULL);
    ASSERT_ERR(size != 0);
    ASSERT_ERR(callback != NULL);
    uart1_env.rx.callback = callback;
    uart1_env.rx.dummy    = dummy;

    uart1_env.uart_event &= ~CSK_UART_EVENT_RECEIVE_COMPLETE;
	UART_Receive(uart1_env.UART_Handler, bufptr, size);

}

void uart_write(uint8_t *bufptr, uint32_t size, void (*callback) (void*, uint8_t), void* dummy)
{
    // Sanity check
    ASSERT_ERR(bufptr != NULL);
    ASSERT_ERR(size != 0);
    ASSERT_ERR(callback != NULL);
    uart1_env.tx.callback = callback;
    uart1_env.tx.dummy    = dummy;

    uart1_env.uart_event &= ~CSK_UART_EVENT_SEND_COMPLETE;
    UART_Send(uart1_env.UART_Handler, bufptr, size);
}

void uart2_read(uint8_t *bufptr, uint32_t size, void (*callback) (void*, uint8_t), void* dummy)
{
    // Sanity check
    ASSERT_ERR(bufptr != NULL);
    ASSERT_ERR(size != 0);
    ASSERT_ERR(callback != NULL);
    uart2_env.rx.callback = callback;
    uart2_env.rx.dummy    = dummy;

    uart2_env.uart_event &= ~CSK_UART_EVENT_RECEIVE_COMPLETE;
	UART_Receive(uart2_env.UART_Handler, bufptr, size);

}

void uart2_write(uint8_t *bufptr, uint32_t size, void (*callback) (void*, uint8_t), void* dummy)
{
    // Sanity check
    ASSERT_ERR(bufptr != NULL);
    ASSERT_ERR(size != 0);
    ASSERT_ERR(callback != NULL);
    uart2_env.tx.callback = callback;
    uart2_env.tx.dummy    = dummy;

    uart2_env.uart_event &= ~CSK_UART_EVENT_SEND_COMPLETE;
    UART_Send(uart2_env.UART_Handler, bufptr, size);
}
```
