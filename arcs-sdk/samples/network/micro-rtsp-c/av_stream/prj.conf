## CMakeLists.txt
```
cmake_minimum_required(VERSION 3.19)

set(CMAKE_EXPORT_COMPILE_COMMANDS ON)

find_package(listenai-cmake REQUIRED HINTS $ENV{ARCS_BASE})

project(arcs)

listenai_include_directories(
    ./
)

add_subdirectory(src)

listenai_add_executable(${PROJECT_NAME})
```

## sample.yaml
```
tests:
  samples.micro-rtsp-c-av_stream:
    build_only: true
```

## prj.conf
```kconfig
CONFIG_LISA_DEVICE=y

CONFIG_LISA_GPIO_DEVICE=y
CONFIG_LISA_GPIOA=y
CONFIG_LISA_GPIOB=y

CONFIG_LISA_I2C=y
CONFIG_LISA_I2C0=y

CONFIG_LISA_CAMERA_DEVICE=y
CONFIG_LISA_CAMERA_BUS_DVP=y
CONFIG_LISA_CAMERA_SENSOR_GC032A=y
CONFIG_LISA_CAMERA_SENSOR_GC0328=y

# LISA Audio Driver
CONFIG_LISA_AUDIO_DEVICE=y

CONFIG_SDK_MODULE_LIBJPEG_TURBO=y

# Heap configuration
CONFIG_HEAP_SIZE=0x3000
CONFIG_PSRAM_HEAP_SIZE=0x5b0000

# DISK驱动使能
CONFIG_DISK_DRIVER=y

# 文件系统配置
CONFIG_FILE_SYSTEM=y
CONFIG_FATFS_FILESYSTEM=y
CONFIG_LSFS=y
CONFIG_LSFS_FAT=y
CONFIG_LSFS_REGISTER_VFS=y
CONFIG_LVFS_POSIX_API_ALIAS=y
CONFIG_LVFS=y
CONFIG_LVFS_POSIX_API=y
CONFIG_FS_ENV_MEMORY_MANAGEMENT_USE_PSRAM=y

# SD Card drivers
CONFIG_DISK_DRIVER_SDMMC=y
CONFIG_LISA_SDMMC_DEVICE=y

# Micro RTSP-C Module
CONFIG_SDK_MODULE_MICRO_RTSP_C=y

# Logging
CONFIG_EASYLOGGER_ASYNC_BUF_SIZE=0x1000

# LISA Porting
CONFIG_LISA_PORTING=y
CONFIG_LISA_OS=y
CONFIG_LISA_KV=y
CONFIG_LISA_NETWORK=y

# LISA WIFI
CONFIG_LISA_WIFI=y

# MAC Manager
CONFIG_MAC_MANAGER=y
CONFIG_MAC_MANAGER_MAC_BY_CHIP_ID=y

# Network Configuration
CONFIG_LWIP=y
CONFIG_WIFI=y
CONFIG_WIFI_TX_BUF_COPY=y
CONFIG_WIFI_LWIP_SAME_CORE=y
CONFIG_LWIP_TX_BUF_COPY=y
CONFIG_LWIP_OPTION_LWIP_DNS=y
CONFIG_LWIP_OPTION_SO_REUSE=y

# WiFi RAM: 192KB (0x30000) - 彻底解决NET_TX_BUF_CNT=45时的溢出
# 通过 CONFIG_MEM_CONFIG 启用自定义内存配置，调整 SRAM 基地址避免重叠
CONFIG_MEM_WFRAM_SIZE=0x30000

# 启用自定义内存配置
CONFIG_MEM_CONFIG=y
# SRAM从192KB WiFi RAM之后开始
CONFIG_MEM_SRAM_BASE=0x20030000
# SRAM结束地址必须小于 0x20040000 (IPC RAM)
# WFRAM 160KB: 0x20000000 - 0x20028000
# SRAM Start: 0x20028000, Max End: 0x20040000
# SRAM Size = 0x18000 (96KB)

CONFIG_MEM_WFRAM_SIZE=0x28000
CONFIG_MEM_SRAM_BASE=0x20028000
CONFIG_MEM_SRAM_SIZE=0x18000

CONFIG_DCACHE_ENABLE=y

# WIFI MANAGER
CONFIG_WIFI_MANAGER=y

# LISA Shell
CONFIG_LISA_SHELL=y

CONFIG_CJSON=y
CONFIG_BACK_TRACE=y

CONFIG_ARCS_HAL_LS_JPEG=y
CONFIG_LISA_UART_DEVICE=y
CONFIG_LISA_UART_ASYNC_API=y
CONFIG_LISA_UART1=y
```

## src/main.c
```c
#include <stdbool.h>
#include <assert.h>
#include <FreeRTOS.h>
#include <stdint.h>
#include <task.h>
#include <arpa/inet.h>
#include <sys/socket.h>
#include <unistd.h>

#define TAG "rtsp-test"
#include <lisa_log.h>
#include <lisa_kv.h>
#include <mac_manager.h>
#include <mac_manager_ops.h>
#include <wifi_manager/wifi_manager.h>
#include <lisa_wifi.h>
#include <ls_wifi_type.h>
#include <net_al.h>
#include <net_def.h>

#include "rtsp.h"
#include "session.h"
#include "streamer.h"

/* 模块化头文件 */
#include "audio.h"
#include "camera.h"

#define TARGET_WIFI_SSID   "Your_SSID"
#define TARGET_WIFI_PWD     "Your_Password"
#define WIFI_MGR_AUTO_CONNECT_INTERVAL_MS 2000
#define WIFI_MGR_SEARCH_AP_BUFFER_SIZE 10

static mac_manager_t *m_mac_manager;
static wifi_mgr_sta_config_t list[WIFI_MGR_SEARCH_AP_BUFFER_SIZE] = { 0 };
static volatile bool g_wifi_connected = false;
static volatile bool g_get_ip_success = false;

static int8_t custom_get_wifi_mac(uint8_t mac_addr[6])
{
    if (!mac_addr) return -1;
    int8_t ret = mac_manager_get(m_mac_manager, mac_addr, 6);
    LOGI("custom_get_wifi_mac: %d, %02X:%02X:%02X:%02X:%02X:%02X", ret,
         mac_addr[0], mac_addr[1], mac_addr[2], mac_addr[3], mac_addr[4], mac_addr[5]);
    return ret;
}

static void dhcp_status_callback(int vif_idx, bool success, uint32_t ip_addr, uint32_t netmask, uint32_t gateway, void *arg)
{
    if (success) {
        LOGI("DHCP Success on VIF-%d: IP=%d.%d.%d.%d", vif_idx,
             ip_addr & 0xff, (ip_addr >> 8) & 0xff, (ip_addr >> 16) & 0xff, (ip_addr >> 24) & 0xff);
        g_get_ip_success = true;
    } else {
        LOGI("DHCP Failed on VIF-%d", vif_idx);
    }
}

static void wifi_mgr_connection_status_cb(wifi_mgr_connection_info_t *connection_info, void *arg)
{
    net_if_t *net_if;
    LOGI("WiFi connection status: %d", connection_info->status);

    switch (connection_info->status) {
    case WIFI_MGR_STA_CONNECTED:
        LOGI("WiFi connected to AP");
        g_wifi_connected = true;
        net_if = net_if_get(WIFI_VIF_STA_IDX);
        net_if_up(net_if);
        if (!net_if->static_ip) {
            ls_dhcpc_start(WIFI_VIF_STA_IDX);
        }
        break;
    case WIFI_MGR_STA_DISCONNECTED:
        LOGI("WiFi disconnected from AP");
        g_wifi_connected = false;
        ls_dhcpc_stop(WIFI_VIF_STA_IDX);
        net_if_down(net_if_get(WIFI_VIF_STA_IDX));
        break;
    default:
        break;
    }
}

static void user_mac_manager_init(void)
{
    mac_manager_config_t config = { .random_mac_if_mac_invalid = false };
    m_mac_manager = mac_manager_init(mac_manager_ops_get()->mem_ops, mac_manager_ops_get()->content_ops, &config);
    if (m_mac_manager == NULL) {
        LOGI("mac_manager_init failed\n");
        assert(0);
    }
}

static void user_wifi_manager_init(void)
{
    wifi_mgr_sta_config_t cfg = {
        .ssid = TARGET_WIFI_SSID,
        .pwd = TARGET_WIFI_PWD,
    };

    wifi_mgr_autoconn_config_t autoconn_cfg = {
        .interval_ms = WIFI_MGR_AUTO_CONNECT_INTERVAL_MS,
    };

    wifi_mgr_init(wifi_mgr_ops_get());
    wifi_mgr_sta_enable();
    wifi_mgr_sta_add_connection_cb(wifi_mgr_connection_status_cb, NULL);

    int count = wifi_mgr_storage_search_ap(list, WIFI_MGR_SEARCH_AP_BUFFER_SIZE, SEARCH_ALL, NULL);
    for (int i = 0; i < count; i++) {
        LOGI("Deleting saved AP: ssid=%s", list[i].ssid);
        wifi_mgr_storage_delete_ap(&list[i]);
    }

    wifi_mgr_storage_save_ap(&cfg);
    wifi_mgr_auto_connect_start(&autoconn_cfg);
    LOGI("WiFi auto-connect started");
}

static int wait_for_wifi_connection(void)
{
    int timeout = 30;
    LOGI("Waiting for WiFi connection and IP address...");

    while (timeout > 0) {
        if (g_wifi_connected && g_get_ip_success) {
            LOGI("WiFi connected and IP obtained");
            vTaskDelay(pdMS_TO_TICKS(500));
            return 0;
        }
        vTaskDelay(pdMS_TO_TICKS(1000));
        timeout--;
        if (timeout % 5 == 0) {
            LOGI("Waiting... (WiFi:%d, IP:%d, timeout:%d)", g_wifi_connected, g_get_ip_success, timeout);
        }
    }

    LOGI("WiFi connection timeout");
    return -1;
}

/* 流媒体任务上下文 */
typedef struct {
    rtsp_streamer_t *streamer;
    rtsp_session_t *session;
    volatile bool should_exit;
    TaskHandle_t task_handle;
} streaming_task_ctx_t;

/* 流媒体推送任务 - 独立处理音视频采集和发送 */
static void streaming_task(void *arg)
{
    streaming_task_ctx_t *ctx = (streaming_task_ctx_t *)arg;
    rtsp_streamer_t *streamer = ctx->streamer;
    rtsp_session_t *session = ctx->session;

    uint32_t last_video_ms = 0;
    uint32_t video_interval_ms = 30;  // 匹配摄像头实际帧率 ~12.5 FPS

    /* FPS 统计变量 */
    uint32_t frame_count = 0;
    uint32_t last_fps_print_ms = 0;

    /* 性能统计变量 */
    uint32_t total_capture_time = 0;
    uint32_t total_send_time = 0;
    uint32_t total_bytes_sent = 0;
    uint32_t total_loop_time = 0;
    uint32_t loop_count = 0;

    LOGI("Streaming task started");

    while (!ctx->should_exit && !session->is_stopped) {
        uint32_t loop_start_ms = xTaskGetTickCount() * portTICK_PERIOD_MS;
        uint32_t current_ms = loop_start_ms;

        /* 等待客户端开始推流 */
        if (!session->is_streaming) {
            vTaskDelay(pdMS_TO_TICKS(10));
            continue;
        }

        /* 从摄像头捕获实时图像并转换为 JPEG */
        if (current_ms - last_video_ms >= video_interval_ms) {
            uint8_t *frame_buffer = NULL;
            uint32_t frame_len = 0;
            uint32_t capture_start = xTaskGetTickCount() * portTICK_PERIOD_MS;

            if (camera_capture_frame(&frame_buffer, &frame_len) == 0) {
                uint32_t capture_end = xTaskGetTickCount() * portTICK_PERIOD_MS;
                uint32_t capture_time = capture_end - capture_start;
                total_capture_time += capture_time;

                /* 使用实时捕获并编码的 JPEG 数据 */
                uint32_t send_start = xTaskGetTickCount() * portTICK_PERIOD_MS;
                rtsp_streamer_stream_frame(streamer, frame_buffer, frame_len, current_ms);
                uint32_t send_end = xTaskGetTickCount() * portTICK_PERIOD_MS;
                uint32_t send_time = send_end - send_start;
                total_send_time += send_time;
                total_bytes_sent += frame_len;

                frame_count++;
            }
            last_video_ms = current_ms;
        }

        /* 音频流推送 - 每次循环都尝试清空队列中的所有音频帧 */
        {
            uint8_t *audio_frame = NULL;
            uint32_t audio_len = 0;

            while (audio_capture_frame(&audio_frame, &audio_len) == 0) {
                rtsp_streamer_stream_audio_frame(streamer, audio_frame,
                                                 audio_len, current_ms);
            }
        }

        /* 每5秒打印一次FPS和性能统计 */
        if (current_ms - last_fps_print_ms >= 5000) {
            if (last_fps_print_ms > 0) {
                uint32_t elapsed_ms = current_ms - last_fps_print_ms;
                float fps = (float)frame_count * 1000.0F / (float)elapsed_ms;
                float kbytes_per_sec = (float)total_bytes_sent * 1000.0F / (float)elapsed_ms / 1024.0F;

                uint32_t avg_capture = frame_count > 0 ? total_capture_time / frame_count : 0;
                uint32_t avg_send = frame_count > 0 ? total_send_time / frame_count : 0;
                uint32_t avg_loop = loop_count > 0 ? total_loop_time / loop_count : 0;

                LOGI("=== Performance Report ===");
                LOGI("Video FPS: %.2f (frames: %u, elapsed: %u ms)",
                     fps, frame_count, elapsed_ms);
                LOGI("Throughput: %.2f KB/s", kbytes_per_sec);
                LOGI("Avg Capture+Encode: %u ms/frame", avg_capture);
                LOGI("Avg Network Send: %u ms/frame", avg_send);
                LOGI("Avg Loop Time: %u ms", avg_loop);
                LOGI("=========================");
            }
            /* 重置统计 */
            frame_count = 0;
            total_bytes_sent = 0;
            total_capture_time = 0;
            total_send_time = 0;
            total_loop_time = 0;
            loop_count = 0;
            last_fps_print_ms = current_ms;
        }

        /* 统计循环耗时 */
        uint32_t loop_end_ms = xTaskGetTickCount() * portTICK_PERIOD_MS;
        total_loop_time += (loop_end_ms - loop_start_ms);
        loop_count++;

        /* 短暂让出 CPU */
        taskYIELD();
    }

    LOGI("Streaming task exiting");
    vTaskDelete(NULL);
}

void handle_client(int client)
{
    rtsp_streamer_t streamer;
    rtsp_session_t session;
    streaming_task_ctx_t streaming_ctx;
    uint32_t camera_width = 0;
    uint32_t camera_height = 0;

    /* 获取摄像头分辨率 */
    camera_get_resolution(&camera_width, &camera_height);

    /* 使用摄像头实际宽高初始化 RTSP streamer */
    rtsp_streamer_init(&streamer, camera_width, camera_height);

    /* 初始化音频流 */
    rtsp_audio_config_t audio_config = {
        .payload_type = 0,
        .sample_rate = AUDIO_SAMPLE_RATE,
        .channels = AUDIO_CHANNELS,
        .codec_name = "PCMU"
    };
    rtsp_streamer_init_audio(&streamer, &audio_config);

    rtsp_session_init(&session, client, &streamer);
    rtsp_streamer_set_uri(&streamer, "0.0.0.0:8554", "mjpeg", "1");

    streamer.is_debug = false;
    session.is_debug = false;

    rtsp_streamer_add_session(&streamer, &session);

    /* 初始化流媒体任务上下文 */
    streaming_ctx.streamer = &streamer;
    streaming_ctx.session = &session;
    streaming_ctx.should_exit = false;
    streaming_ctx.task_handle = NULL;

    /* 设置推流状态为 true，开始采集音频 */
    audio_start_streaming();
    LOGI("Streaming started, audio capture enabled");

    /* 创建流媒体推送任务 */
    BaseType_t ret = xTaskCreate(
        streaming_task,
        "streaming",
        4096,
        &streaming_ctx,
        tskIDLE_PRIORITY + 2,  // 较高优先级确保实时性
        &streaming_ctx.task_handle
    );
    if (ret != pdPASS) {
        LOGE("Failed to create streaming task");
        goto cleanup;
    }
    LOGI("Streaming task created");

    /* 主循环：专注于 RTSP 信令处理 */
    while (!session.is_stopped) {
        /* rtsp_streamer_start 处理 RTSP 信令（DESCRIBE/SETUP/PLAY/TEARDOWN） */
        rtsp_streamer_start(&streamer, 500);  // 可以使用更长的超时
    }

    /* 通知流媒体任务退出 */
    streaming_ctx.should_exit = true;
    LOGI("Waiting for streaming task to exit...");

    /* 等待任务退出（最多等待1秒） */
    for (int i = 0; i < 100 && streaming_ctx.task_handle != NULL; i++) {
        vTaskDelay(pdMS_TO_TICKS(10));
        /* 检查任务是否已删除 - eTaskGetState 返回 eDeleted 或检查句柄 */
        if (eTaskGetState(streaming_ctx.task_handle) == eDeleted) {
            break;
        }
    }

cleanup:
    /* 推流结束，停止音频采集 */
    audio_stop_streaming();
    LOGI("Streaming stopped, audio capture disabled");

    /* 清空音频队列中的残留数据 */
    audio_clear_queue();

    /* 清理 RTSP 资源 */
    rtsp_streamer_deinit(&streamer);
    LOGI("RTSP resources cleaned up");
}

int main(int argc, char **argv)
{
    int sockfd;
    struct sockaddr_in serv_addr, client_addr;
    socklen_t client_addr_len = sizeof(client_addr);

    LOGI("RTSP Server Starting...");

    user_mac_manager_init();
    net_dhcp_register_status_callback(dhcp_status_callback, NULL);

    lisa_wifi_ops_t ops = { .custom_mac = custom_get_wifi_mac };
    lisa_wifi_init(&ops);

    user_fs_init();
    lisa_kv_init();

    user_wifi_manager_init();

    if (wait_for_wifi_connection() != 0) {
        LOGI("Failed to connect to WiFi");
        return -1;
    }

    /* 初始化摄像头 */
    if (camera_init() != 0) {
        LOGE("Failed to initialize camera");
        return -1;
    }

    /* 初始化音频 */
    if (audio_init() != 0) {
        LOGE("Failed to initialize audio");
        return -1;
    }

    LOGI("Starting RTSP server on port 8554");

    serv_addr.sin_family = AF_INET;
    serv_addr.sin_addr.s_addr = INADDR_ANY;
    serv_addr.sin_port = htons(8554);

    sockfd = socket(AF_INET, SOCK_STREAM, 0);
    int enable = 1;
    if (setsockopt(sockfd, SOL_SOCKET, SO_REUSEADDR, &enable, sizeof(int)) < 0) {
        LOGI("failed to reuse addr");
        return 0;
    }

    if (bind(sockfd, (struct sockaddr*)&serv_addr, sizeof(serv_addr)) != 0) {
        LOGI("failed to bind port errno=%d", errno);
        return 0;
    }

    if (listen(sockfd, 5) != 0) return 0;

    for (;;) {
        int clientfd = accept(sockfd, (struct sockaddr*)&client_addr, &client_addr_len);
        LOGI("client connected: %s", inet_ntoa(client_addr.sin_addr));
        // Only handle one client at a time, if we want to handle multiple clients, use threads
        handle_client(clientfd);
    }

    close(sockfd);
    return 0;
}
```

## src/audio.c
```c
#include "audio.h"
#include <string.h>
#include <FreeRTOS.h>
#include <task.h>
#include <queue.h>
#include "lisa_audio.h"

#define TAG "audio"
#include <lisa_log.h>

/* 音频全局变量 */
static lisa_device_t *g_audio_dev = NULL;
static uint8_t g_audio_buffer[AUDIO_FRAME_SIZE];      // μ-law 编码后的缓冲区

/* 音频队列相关 */
static QueueHandle_t g_audio_queue = NULL;            // 音频数据队列
static volatile bool g_is_streaming = false;          // 推流状态标志

/**
 * @brief PCM 16-bit 转 μ-law 编码
 */
static uint8_t pcm16_to_ulaw(int16_t pcm_val)
{
    const int16_t CLIP = 32635;
    const int16_t BIAS = 0x84;

    uint8_t sign = (pcm_val < 0) ? 0x80 : 0;
    if (sign) pcm_val = (int16_t)(-pcm_val);
    if (pcm_val > CLIP) pcm_val = CLIP;

    pcm_val = (int16_t)(pcm_val + BIAS);
    int exponent = 7;
    for (int exp_mask = 0x4000; (pcm_val & exp_mask) == 0 && exponent > 0;
         exp_mask >>= 1, exponent--);

    int mantissa = (pcm_val >> (exponent + 3)) & 0x0F;
    uint8_t ulaw = (uint8_t)(~(sign | (exponent << 4) | mantissa));

    return ulaw;
}

/**
 * @brief 音频回调函数 - 从麦克风接收原始PCM数据并放入队列
 */
static void audio_callback(const lisa_audio_event_t *event, void *user_data)
{
    BaseType_t xHigherPriorityTaskWoken = pdFALSE;

    /* 只有在推流状态下才处理录音数据 */
    if (!g_is_streaming) {
        return;
    }

    /* 处理录音数据 */
    if (event->record_buffer && event->record_samples > 0 && g_audio_queue != NULL) {
        uint32_t samples = event->record_samples;

        /* 限制最大样本数 */
        if (samples > AUDIO_FRAME_SIZE) {
            samples = AUDIO_FRAME_SIZE;
        }

        /* 准备音频帧数据 - 只存储原始PCM数据 */
        audio_frame_t frame;
        frame.samples = samples;
        frame.timestamp = xTaskGetTickCount() * portTICK_PERIOD_MS;

        /* 复制原始PCM数据 */
        memcpy(frame.pcm_data, event->record_buffer, samples * sizeof(int16_t));

        /* 尝试将数据放入队列(非阻塞) */
        if (xQueueSendFromISR(g_audio_queue, &frame, &xHigherPriorityTaskWoken) != pdTRUE) {
            LOGI("Audio queue full, dropping oldest frame");
            /* 队列满,丢弃最旧的数据 */
            audio_frame_t dummy;
            xQueueReceiveFromISR(g_audio_queue, &dummy, &xHigherPriorityTaskWoken);
            xQueueSendFromISR(g_audio_queue, &frame, &xHigherPriorityTaskWoken);
        }

        portYIELD_FROM_ISR(xHigherPriorityTaskWoken);
    }
}

/**
 * @brief 初始化音频模块
 * @return 0:成功, -1:失败
 */
int audio_init(void)
{
    int ret;

    LOGI("=== Initializing Audio Module ===");

    /* 创建音频队列 */
    g_audio_queue = xQueueCreate(AUDIO_QUEUE_LENGTH, sizeof(audio_frame_t));
    if (g_audio_queue == NULL) {
        LOGE("Failed to create audio queue");
        return -1;
    }
    LOGI("Audio queue created successfully");

    /* 初始化音频设备 */
    g_audio_dev = lisa_device_get(AUDIO_DEVICE_NAME);
    if (!g_audio_dev) {
        LOGE("Failed to get audio device");
        return -1;
    }
    LOGI("Audio device acquired successfully");

    /* 注册音频回调 */
    ret = lisa_audio_register_callback(g_audio_dev, audio_callback, NULL);
    if (ret != 0) {
        LOGE("Failed to register audio callback: %d", ret);
        return -1;
    }
    LOGI("Audio callback registered successfully");

    /* 配置录音参数 */
    lisa_audio_record_config_t record_config = {
        .format = {
            .sample_rate = LISA_AUDIO_RATE_8K,   /* 8kHz 采样率 */
            .channels = LISA_AUDIO_CH_LEFT,      /* 单声道 */
            .sample_bits = LISA_AUDIO_BIT_16,    /* 16位采样 */
        },
        .gain = {
            .analog_gain = 16,   /* 模拟增益 (参考值) */
            .digital_gain = 8,   /* 数字增益 (参考值) */
        },
        .differential_input = true,
        .enable_hpf = true,      /* 启用高通滤波器 */
    };

    ret = lisa_audio_record_config(g_audio_dev, &record_config);
    if (ret != 0) {
        LOGE("Failed to configure audio recording: %d", ret);
        return -1;
    }
    LOGI("Audio recording configured successfully");

    /* 启动录音 */
    ret = lisa_audio_record_start(g_audio_dev);
    if (ret != 0) {
        LOGE("Failed to start audio recording: %d", ret);
        return -1;
    }
    LOGI("Audio recording started successfully");

    return 0;
}

/**
 * @brief 启动音频推流
 */
void audio_start_streaming(void)
{
    g_is_streaming = true;
    LOGI("Audio streaming started");
}

/**
 * @brief 停止音频推流
 */
void audio_stop_streaming(void)
{
    g_is_streaming = false;
    LOGI("Audio streaming stopped");
}

/**
 * @brief 从队列获取PCM音频数据并编码为 μ-law
 * @param buffer 输出缓冲区指针
 * @param len 输出数据长度
 * @return 0:成功, -1:失败
 */
int audio_capture_frame(uint8_t **buffer, uint32_t *len)
{
    static audio_frame_t frame;

    /* 从队列中读取音频帧(非阻塞) */
    if (g_audio_queue == NULL || xQueueReceive(g_audio_queue, &frame, 0) != pdTRUE) {
        return -1;  /* 队列为空或未初始化 */
    }

    /* 将 PCM 数据转换为 μ-law */
    for (uint32_t i = 0; i < frame.samples; i++) {
        g_audio_buffer[i] = pcm16_to_ulaw(frame.pcm_data[i]);
    }

    *buffer = g_audio_buffer;
    *len = frame.samples;

    return 0;
}

/**
 * @brief 清空音频队列
 */
void audio_clear_queue(void)
{
    if (g_audio_queue != NULL) {
        audio_frame_t dummy;
        while (xQueueReceive(g_audio_queue, &dummy, 0) == pdTRUE) {
            /* 清空队列 */
        }
        LOGI("Audio queue cleared");
    }
}
```

## src/audio.h
```c
#ifndef AUDIO_H
#define AUDIO_H

#include <stdint.h>
#include <stdbool.h>

/* 音频相关配置 */
#define AUDIO_SAMPLE_RATE   8000
#define AUDIO_CHANNELS      1
#define AUDIO_FRAME_SIZE    320  // 40ms @ 8kHz (8000 * 0.04 = 320)
#define AUDIO_DEVICE_NAME   "audio0"
#define AUDIO_QUEUE_LENGTH  25   // 音频队列长度,可缓存25帧数据

/* 音频队列数据结构 */
typedef struct {
    int16_t pcm_data[AUDIO_FRAME_SIZE];  // 原始PCM数据
    uint32_t samples;                     // 样本数
    uint32_t timestamp;                   // 时间戳
} audio_frame_t;

/**
 * @brief 初始化音频模块
 * @return 0:成功, -1:失败
 */
int audio_init(void);

/**
 * @brief 启动音频推流
 */
void audio_start_streaming(void);

/**
 * @brief 停止音频推流
 */
void audio_stop_streaming(void);

/**
 * @brief 从队列获取PCM音频数据并编码为 μ-law
 * @param buffer 输出缓冲区指针
 * @param len 输出数据长度
 * @return 0:成功, -1:失败
 */
int audio_capture_frame(uint8_t **buffer, uint32_t *len);

/**
 * @brief 清空音频队列
 */
void audio_clear_queue(void);

#endif /* AUDIO_H */
```

## src/camera.c
```c
#include "camera.h"
#include <stdlib.h>
#include <FreeRTOS.h>
#include <task.h>
#include "lisa_device.h"
#include "lisa_camera.h"
#include "lisa_gpio.h"
#include "IOMuxManager.h"
#include "turbojpeg.h"

/* 硬件JPEG编码配置 */
#define USE_HARDWARE_JPEG_ENCODER  1  // 1:使用硬件编码  0:使用软件编码(TurboJPEG)

/* 调试开关 - 控制性能统计日志输出 */
#define RTSP_DEBUG_TIMING          0  // 1:开启耗时打印  0:关闭

#if USE_HARDWARE_JPEG_ENCODER
/* 硬件JPEG编码头文件 */
#include "jpeg_encoder_ext.h"

/* 硬件JPEG编码全局变量 */
static jpeg_enc_ctx_t g_jpeg_encoder_ctx;
static uint8_t *g_hw_jpeg_output_buffer = NULL;
static uint32_t g_hw_jpeg_output_size = 0;
#endif

#define TAG "camera"
#include <lisa_log.h>

/* 摄像头设备配置 */
#define CAMERA_DEVICE    "camera"
#define DVP_DEVICE       "dvp0"
#define DMA_CHANNEL      2

/* 摄像头引脚定义 (ARCS_EVB) */
#ifdef CONFIG_BOARD_ARCS_EVB
#define CAM_PWDN_PIN    7
#define CAM_HSYNC_PIN   10
#define CAM_VSYNC_PIN   11
#define CAM_PCLK_PIN    12
#define CAM_MCLK_PIN    26
#define CAM_D0_PIN      13
#define CAM_D1_PIN      14
#define CAM_D2_PIN      15
#define CAM_D3_PIN      16
#define CAM_D4_PIN      17
#define CAM_D5_PIN      18
#define CAM_D6_PIN      19
#define CAM_D7_PIN      20
#endif

/* 摄像头全局变量 */
static lisa_device_t *g_camera_dev = NULL;
static uint32_t g_camera_width = 0;   /* 摄像头实际宽度 */
static uint32_t g_camera_height = 0;  /* 摄像头实际高度 */

/* JPEG 编码全局变量 */
static tjhandle g_jpeg_compressor = NULL;
static unsigned char *g_jpeg_buffer = NULL;
static unsigned long g_jpeg_buffer_size = 0;

#ifdef CONFIG_BOARD_ARCS_EVB
/**
 * @brief GPIOB 引脚配置
 */
static void lisa_gpiob_pinmux(void)
{
    IOMuxManager_PinConfigure(CSK_IOMUX_PAD_B, CAM_PWDN_PIN, CSK_IOMUX_FUNC_DEFAULT);
}

/**
 * @brief UART1 引脚配置
 */
static void lisa_uart1_pinmux(void)
{
    IOMuxManager_PinConfigure(CSK_IOMUX_PAD_A, 21, CSK_IOMUX_FUNC_ALTER3);
}

/**
 * @brief I2C0 引脚配置
 */
static void lisa_i2c0_pinmux(void)
{
    IOMuxManager_PinConfigure(CSK_IOMUX_PAD_A, 22, 8);
    IOMuxManager_PinConfigure(CSK_IOMUX_PAD_A, 23, 8);
}

/**
 * @brief DVP 引脚配置
 */
static void lisa_dvp_pinmux(void)
{
    IOMuxManager_PinConfigure(CSK_IOMUX_PAD_A, CAM_HSYNC_PIN, CSK_IOMUX_FUNC_ALTER16);
    IOMuxManager_PinConfigure(CSK_IOMUX_PAD_A, CAM_VSYNC_PIN, CSK_IOMUX_FUNC_ALTER16);
    IOMuxManager_PinConfigure(CSK_IOMUX_PAD_A, CAM_PCLK_PIN, CSK_IOMUX_FUNC_ALTER16);
    IOMuxManager_PinConfigure(CSK_IOMUX_PAD_A, CAM_D0_PIN, CSK_IOMUX_FUNC_ALTER16);
    IOMuxManager_PinConfigure(CSK_IOMUX_PAD_A, CAM_D1_PIN, CSK_IOMUX_FUNC_ALTER16);
    IOMuxManager_PinConfigure(CSK_IOMUX_PAD_A, CAM_D2_PIN, CSK_IOMUX_FUNC_ALTER16);
    IOMuxManager_PinConfigure(CSK_IOMUX_PAD_A, CAM_D3_PIN, CSK_IOMUX_FUNC_ALTER16);
    IOMuxManager_PinConfigure(CSK_IOMUX_PAD_A, CAM_D4_PIN, CSK_IOMUX_FUNC_ALTER16);
    IOMuxManager_PinConfigure(CSK_IOMUX_PAD_A, CAM_D5_PIN, CSK_IOMUX_FUNC_ALTER16);
    IOMuxManager_PinConfigure(CSK_IOMUX_PAD_A, CAM_D6_PIN, CSK_IOMUX_FUNC_ALTER16);
    IOMuxManager_PinConfigure(CSK_IOMUX_PAD_A, CAM_D7_PIN, CSK_IOMUX_FUNC_ALTER16);
}
#endif

/**
 * @brief 将 YUV422 打包格式(YUYV)转换为平面格式
 * @param yuyv_data YUYV 打包数据
 * @param width 图像宽度
 * @param height 图像高度
 * @param y_plane 输出的 Y 平面
 * @param u_plane 输出的 U 平面
 * @param v_plane 输出的 V 平面
 */
static void yuyv_to_yuv_planes(const uint8_t *yuyv_data, int width, int height,
                               uint8_t *y_plane, uint8_t *u_plane, uint8_t *v_plane)
{
    const uint8_t *src = yuyv_data;
    int y_index = 0;
    int uv_index = 0;

    /* YUYV 格式: Y0 U0 Y1 V0 | Y2 U1 Y3 V1 | ... */
    /* 每4个字节包含2个像素的完整信息 */
    for (int i = 0; i < height; i++) {
        for (int j = 0; j < width; j += 2) {
            /* 提取 Y0, U0, Y1, V0 */
            y_plane[y_index++] = src[0];  /* Y0 */
            u_plane[uv_index] = src[1];   /* U0 */
            y_plane[y_index++] = src[2];  /* Y1 */
            v_plane[uv_index] = src[3];   /* V0 */

            uv_index++;
            src += 4;
        }
    }
}

#if USE_HARDWARE_JPEG_ENCODER
/**
 * @brief 硬件JPEG编码 - 使用YUV422进行硬件编码
 * @param raw_data 原始图像数据（YUV422 YUYV格式）
 * @param width 图像宽度
 * @param height 图像高度
 * @param jpeg_data 输出的 JPEG 数据指针
 * @param jpeg_size 输出的 JPEG 数据大小
 * @return 0:成功, -1:失败
 */
static int encode_to_jpeg_hardware(const uint8_t *raw_data, int width, int height,
                                   unsigned char **jpeg_data, unsigned long *jpeg_size)
{
    int32_t ret = -1;
#if RTSP_DEBUG_TIMING
    uint32_t start_time, end_time;
#endif

    if (g_hw_jpeg_output_buffer == NULL) {
        LOGE("Hardware JPEG output buffer not initialized");
        return -1;
    }

#if RTSP_DEBUG_TIMING
    start_time = xTaskGetTickCount() * portTICK_PERIOD_MS;
#endif

    /* 调用新的硬件编码接口 */
    ret = jpeg_encoder_encode(&g_jpeg_encoder_ctx,
                              (void *)raw_data,
                              (void *)g_hw_jpeg_output_buffer,
                              &g_hw_jpeg_output_size);

#if RTSP_DEBUG_TIMING
    end_time = xTaskGetTickCount() * portTICK_PERIOD_MS;
#endif

    if (ret == 0) {
        *jpeg_data = g_hw_jpeg_output_buffer;
        *jpeg_size = g_hw_jpeg_output_size;

#if RTSP_DEBUG_TIMING
        LOGI("硬件JPEG编码耗时: %u ms, 输出大小: %u bytes",
             end_time - start_time, g_hw_jpeg_output_size);
#endif
    } else {
        LOGE("硬件JPEG编码失败, 错误码: %d", ret);
    }

    return ret;
}
#endif

/**
 * @brief 软件JPEG编码 - 使用TurboJPEG库
 * @param raw_data 原始图像数据（YUV422 YUYV格式）
 * @param width 图像宽度
 * @param height 图像高度
 * @param jpeg_data 输出的 JPEG 数据指针
 * @param jpeg_size 输出的 JPEG 数据大小
 * @return 0:成功, -1:失败
 */
static int encode_to_jpeg_software(const uint8_t *raw_data, int width, int height,
                                   unsigned char **jpeg_data, unsigned long *jpeg_size)
{
    int ret;
    uint8_t *y_plane = NULL;
    uint8_t *u_plane = NULL;
    uint8_t *v_plane = NULL;
    const unsigned char *srcPlanes[3];
    int strides[3];
#if RTSP_DEBUG_TIMING
    uint32_t start_time, end_time;
#endif

    if (!g_jpeg_compressor) {
        LOGE("JPEG compressor not initialized");
        return -1;
    }

#if RTSP_DEBUG_TIMING
    start_time = xTaskGetTickCount() * portTICK_PERIOD_MS;
#endif

    /* 分配 YUV 平面缓冲区 */
    y_plane = (uint8_t *)malloc(width * height);
    u_plane = (uint8_t *)malloc(width * height / 2);  /* 422格式: U/V是Y的一半 */
    v_plane = (uint8_t *)malloc(width * height / 2);

    if (!y_plane || !u_plane || !v_plane) {
        LOGE("Failed to allocate YUV plane buffers");
        free(y_plane);
        free(u_plane);
        free(v_plane);
        return -1;
    }

    /* 将 YUYV 打包格式转换为 YUV 平面格式 */
    yuyv_to_yuv_planes(raw_data, width, height, y_plane, u_plane, v_plane);

    /* 设置平面指针和步长 */
    srcPlanes[0] = y_plane;
    srcPlanes[1] = u_plane;
    srcPlanes[2] = v_plane;
    strides[0] = width;      /* Y 平面步长 */
    strides[1] = width / 2;  /* U 平面步长 (422格式) */
    strides[2] = width / 2;  /* V 平面步长 (422格式) */

    /* 使用 TurboJPEG 直接从 YUV 平面压缩为 JPEG */
    ret = tjCompressFromYUVPlanes(g_jpeg_compressor, srcPlanes, width, strides, height,
                                  TJSAMP_422, jpeg_data, jpeg_size, 85, 0);

    /* 释放临时缓冲区 */
    free(y_plane);
    free(u_plane);
    free(v_plane);

    if (ret < 0) {
        LOGE("Failed to compress image: %s", tjGetErrorStr2(g_jpeg_compressor));
        return -1;
    }

#if RTSP_DEBUG_TIMING
    end_time = xTaskGetTickCount() * portTICK_PERIOD_MS;
    LOGI("软件JPEG编码耗时: %u ms, 输出大小: %lu bytes", end_time - start_time, *jpeg_size);
#endif

    return 0;
}

/**
 * @brief 将摄像头原始数据编码为 JPEG (支持硬件和软件编码)
 * @param raw_data 原始图像数据（YUV422 YUYV格式）
 * @param width 图像宽度
 * @param height 图像高度
 * @param pixel_format 像素格式
 * @param jpeg_data 输出的 JPEG 数据指针
 * @param jpeg_size 输出的 JPEG 数据大小
 * @return 0:成功, -1:失败
 */
static int encode_to_jpeg(const uint8_t *raw_data, int width, int height,
                         int pixel_format, unsigned char **jpeg_data, unsigned long *jpeg_size)
{
#if USE_HARDWARE_JPEG_ENCODER
    /* 使用硬件JPEG编码 */
    return encode_to_jpeg_hardware(raw_data, width, height, jpeg_data, jpeg_size);
#else
    /* 使用软件JPEG编码 */
    return encode_to_jpeg_software(raw_data, width, height, jpeg_data, jpeg_size);
#endif
}

/**
 * @brief 初始化 JPEG 编码器
 */
static int jpeg_init(void)
{
#if USE_HARDWARE_JPEG_ENCODER
    /* 硬件JPEG编码器初始化 */
    LOGI("初始化硬件JPEG编码器");

    /* 预分配输出缓冲区 - 根据摄像头分辨率预估 */
    uint32_t estimated_size = g_camera_width * g_camera_height;
    g_hw_jpeg_output_buffer = (uint8_t *)malloc(estimated_size);
    if (g_hw_jpeg_output_buffer == NULL) {
        LOGE("Failed to allocate hardware JPEG output buffer (size: %u)", estimated_size);
        return -1;
    }
    g_hw_jpeg_output_size = 0;

    /* 初始化硬件JPEG编码器上下文 */
    jpeg_enc_cfg_t enc_cfg = {
        .width = g_camera_width,
        .height = g_camera_height,
        .input_format = 0x00,  /* YUV422格式 */
    };
    g_jpeg_encoder_ctx.in_ch = dma_2d_ch6;
    g_jpeg_encoder_ctx.out_ch = dma_2d_ch8;
    g_jpeg_encoder_ctx.transfer_ch = dma_2d_ch7;
    int32_t ret = jpeg_encoder_init(&g_jpeg_encoder_ctx, &enc_cfg);
    if (ret != 0) {
        LOGE("Failed to initialize JPEG encoder: %d", ret);
        free(g_hw_jpeg_output_buffer);
        g_hw_jpeg_output_buffer = NULL;
        return -1;
    }

    LOGI("硬件JPEG编码器初始化成功, 输出缓冲区: %u bytes", estimated_size);
    return 0;
#else
    /* 软件JPEG编码器初始化 */
    LOGI("初始化软件JPEG编码器(TurboJPEG)");

    g_jpeg_compressor = tjInitCompress();
    if (!g_jpeg_compressor) {
        LOGE("Failed to create JPEG compressor: %s", tjGetErrorStr());
        return -1;
    }

    LOGI("软件JPEG编码器初始化成功");
    return 0;
#endif
}

/**
 * @brief 初始化摄像头和JPEG编码器
 */
int camera_init(void)
{
    int ret;

    LOGI("=== Initializing Camera ===");

    /* 获取摄像头设备 */
    g_camera_dev = lisa_device_get(CAMERA_DEVICE);
    if (!lisa_device_ready(g_camera_dev)) {
        LOGE("Error: %s device not ready", CAMERA_DEVICE);
        return -1;
    }
    LOGI("%s device ready", CAMERA_DEVICE);

    /* 配置 GPIO */
    lisa_device_t *gpioa = lisa_device_get("gpioa");
    lisa_gpio_configure(gpioa, 23, LISA_GPIO_CONFIG_OUTPUT_HIGH);

    /* 获取 I2C 设备 */
    lisa_device_t *i2c_dev = lisa_device_get("i2c0");
    if (!lisa_device_ready(i2c_dev)) {
        LOGE("Error: %s device not ready", "i2c0");
        return -1;
    }

#ifdef CONFIG_BOARD_ARCS_EVB
    /* 配置摄像头参数 */
    lisa_camera_config_t config = {
        .hw_config = {
            .mclk_pad = CSK_IOMUX_PAD_A,
            .mclk_pin = CAM_MCLK_PIN,
            .pwdn_gpio_dev = lisa_device_get("gpiob"),
            .pwdn_pin = CAM_PWDN_PIN,
            .pwdn_delay_us = 0,
            .xclk_delay_us = 0,
            .i2c_dev = i2c_dev,
        },
        .xclk_freq_hz = 25000000,
        .fb_count = 3,
        .enable_hmirror = false,
        .enable_vflip = false,
        .enable_colorbar = false,
    };
#else
    /* 其他板型的默认配置 */
    lisa_camera_config_t config = {
        .hw_config = {
            .i2c_dev = i2c_dev,
        },
        .xclk_freq_hz = 12000000,
        .fb_count = 3,
        .enable_hmirror = false,
        .enable_vflip = false,
        .enable_colorbar = false,
    };
#endif

    LOGI("Setting up camera...");
    ret = lisa_camera_setup(g_camera_dev, &config);
    if (ret != LISA_DEVICE_OK) {
        LOGE("Failed to setup camera: %d", ret);
        return -1;
    }

    /* 获取摄像头能力 */
    lisa_camera_capabilities_t caps;
    ret = lisa_camera_get_capabilities(g_camera_dev, &caps);
    if (ret != LISA_DEVICE_OK) {
        LOGE("Failed to get capabilities: %d", ret);
        return -1;
    }
    LOGI("Camera capabilities: max_width=%u, max_height=%u, supported_formats=0x%08X",
         caps.max_width, caps.max_height, caps.supported_formats);

    /* 配置 DVP 总线接口 */
    lisa_camera_bus_config_t bus_config = {
        .dma_channel = DMA_CHANNEL,
        .bus_type = LISA_CAMERA_BUS_DVP,
        .config.dvp = {
            .dvp_dev        = lisa_device_get(DVP_DEVICE),
            .dvp_freq       = config.xclk_freq_hz,
            .data_align     = 1,
            .line_offset    = 0,
            .pixel_offset   = 0,
            .pclk_polarity  = 0,
            .vsync_polarity = 1,
            .hsync_polarity = 1,
        }
    };
    lisa_camera_get_framesize(g_camera_dev, &bus_config.width, &bus_config.height);
    bus_config.pixel_format = lisa_camera_get_pixformat(g_camera_dev);

    /* 保存摄像头实际宽高到全局变量 */
    g_camera_width = bus_config.width;
    g_camera_height = bus_config.height;
    LOGI("Camera resolution: %ux%u", g_camera_width, g_camera_height);

    ret = lisa_camera_attach_bus(g_camera_dev, &bus_config);
    if (ret != LISA_DEVICE_OK) {
        LOGE("Failed to attach bus: %d", ret);
        return -1;
    }

    /* 启动摄像头 */
    LOGI("Starting camera...");
    ret = lisa_camera_start(g_camera_dev);
    if (ret != LISA_DEVICE_OK) {
        LOGE("Failed to start camera: %d", ret);
        return -1;
    }

    LOGI("Camera initialized successfully");

    /* 初始化 JPEG 编码器 */
    if (jpeg_init() != 0) {
        LOGE("Failed to initialize JPEG encoder");
        return -1;
    }

    return 0;
}

/**
 * @brief 捕获一帧图像并转换为 JPEG
 */
int camera_capture_frame(uint8_t **buffer, uint32_t *len)
{
    lisa_camera_fb_t *fb = NULL;
    int ret;

    /* 捕获一帧图像 */
    ret = lisa_camera_capture(g_camera_dev, &fb);
    if (ret != LISA_DEVICE_OK || fb == NULL) {
        LOGE("Capture failed: %d", ret);
        return -1;
    }

    /* 获取像素格式 */
    int pixel_format = lisa_camera_get_pixformat(g_camera_dev);

#if !USE_HARDWARE_JPEG_ENCODER
    /* 软件编码模式: 释放之前的 JPEG 缓冲区 */
    if (g_jpeg_buffer) {
        tjFree(g_jpeg_buffer);
        g_jpeg_buffer = NULL;
    }
#endif

    /* 将原始数据编码为 JPEG */
    ret = encode_to_jpeg(fb->buf, fb->width, fb->height, pixel_format,
                        &g_jpeg_buffer, &g_jpeg_buffer_size);
    if (ret != 0) {
        LOGE("Failed to encode to JPEG");
        lisa_camera_release_fb(g_camera_dev, fb);
        return -1;
    }

    /* 返回 JPEG 数据 */
    *buffer = g_jpeg_buffer;
    *len = g_jpeg_buffer_size;

    /* 释放摄像头帧缓冲区 */
    lisa_camera_release_fb(g_camera_dev, fb);

    return 0;
}

/**
 * @brief 获取摄像头实际分辨率
 */
void camera_get_resolution(uint32_t *width, uint32_t *height)
{
    if (width) *width = g_camera_width;
    if (height) *height = g_camera_height;
}
```

## src/camera.h
```c
#ifndef CAMERA_H
#define CAMERA_H

#include <stdint.h>
#include <stdbool.h>

/**
 * @brief 初始化摄像头和JPEG编码器
 * @return 0:成功, -1:失败
 */
int camera_init(void);

/**
 * @brief 捕获一帧图像并转换为 JPEG
 * @param buffer 输出JPEG缓冲区指针
 * @param len 输出JPEG数据长度
 * @return 0:成功, -1:失败
 */
int camera_capture_frame(uint8_t **buffer, uint32_t *len);

/**
 * @brief 获取摄像头实际分辨率
 * @param width 输出宽度
 * @param height 输出高度
 */
void camera_get_resolution(uint32_t *width, uint32_t *height);

#endif /* CAMERA_H */
```

## src/jpeg_encoder_example.c
```c
/* JPEG编码器使用示例
 *
 * 这个示例展示了如何使用JPEG编码接口
 * 相比原来的jpeg_encoder_ext函数，这个接口避免了每次编码都重复初始化硬件
 */

#include "jpeg_encoder_ext.h"
#include <stdlib.h>
#include "IOMuxManager.h"
#include "lisa_device.h"
#include "lisa_uart.h"
#include "FreeRTOS.h"
#include "projdefs.h"
#include <lisa_log.h>

/* 全局编码器上下文 */
static jpeg_enc_ctx_t g_jpeg_encoder_ctx;
static uint8_t g_encoder_initialized = 0;

/* ========================================================================
 * 串口配置
 * ======================================================================== */

void lisa_uart1_pinmux()
{
    IOMuxManager_PinConfigure(CSK_IOMUX_PAD_A, 21, CSK_IOMUX_FUNC_ALTER3);
}

static lisa_device_t *uart_dev = NULL;
static volatile bool uart_tx_done = true;  /* 发送完成标志 */

/**
 * @brief UART 事件回调函数
 */
static void uart_event_callback(lisa_uart_event_t event, void *user_data)
{
    if (event == LISA_UART_EVENT_TX_DONE) {
        uart_tx_done = true;
    }
}

/**
 * @brief 初始化串口
 */
static int serial_init(void)
{
    /* 获取 UART 设备 */
    uart_dev = lisa_device_get("uart1");
    if (!lisa_device_ready(uart_dev)) {
        LOGE("UART1 device not ready");
        return -1;
    }

    /* 配置 UART: 3Mbps, 8N1, DMA 模式 */
    lisa_uart_config_t uart_cfg = {
        .baudrate = 3000000,
        .data_bits = LISA_UART_DATA_BITS_8,
        .stop_bits = LISA_UART_STOP_BITS_1,
        .parity = LISA_UART_PARITY_NONE,
        .flow_ctrl = LISA_UART_FLOW_CONTROL_NONE,
        .transfer_mode = LISA_UART_TRANSFER_MODE_DMA,
        .dma_tx_channel = 0xFF,  /* 自动分配 */
        .dma_rx_channel = 0xFF,
    };

    int ret = lisa_uart_configure(uart_dev, &uart_cfg);
    if (ret != LISA_DEVICE_OK) {
        LOGE("UART configure failed: %d", ret);
        return ret;
    }

    /* 设置事件回调 */
    lisa_uart_set_callback(uart_dev, uart_event_callback, NULL);

    return 0;
}

/**
 * @brief 异步发送数据
 */
static void serial_send(const uint8_t *data, uint32_t len)
{
    LOGI("Send JPEG: %02x %02x %02x ... %02x %02x %02x, len=%u",
         data[0], data[1], data[2],
         data[len - 3], data[len - 2], data[len - 1], len);

    /* 标记为发送中 */
    uart_tx_done = false;

    /* 异步发送 */
    int ret = lisa_uart_write_async(uart_dev, data, len);
    if (ret < 0) {
        LOGE("UART send failed: %d", ret);
        uart_tx_done = true;  /* 发送失败，恢复标志 */
    }
}

/**
 * @brief 初始化JPEG编码器（应用启动时调用一次）
 *
 * @param width 图像宽度
 * @param height 图像高度
 * @param format 输入格式 (0x00=YUV422, 0x01=YUV420, 0x05=RGB888等)
 * @return int32_t 0表示成功
 */
int32_t app_jpeg_encoder_init(uint16_t width, uint16_t height, uint8_t format)
{
    jpeg_enc_cfg_t cfg = {
        .width = width,
        .height = height,
        .input_format = format,
    };

    int32_t ret = jpeg_encoder_init(&g_jpeg_encoder_ctx, &cfg);
    if (ret == 0) {
        g_encoder_initialized = 1;
    }

    return ret;
}

/**
 * @brief 编码一帧图像（每次需要编码时调用）
 *
 * @param in_buf 输入图像数据
 * @param out_buf 输出JPEG数据缓冲区
 * @param out_size 输出JPEG数据大小
 * @return int32_t 0表示成功
 */
int32_t app_jpeg_encode_frame(void *in_buf, void *out_buf, uint32_t *out_size)
{
    if (!g_encoder_initialized) {
        return -1;
    }

    return jpeg_encoder_encode(&g_jpeg_encoder_ctx, in_buf, out_buf, out_size);
}

/**
 * @brief 停止JPEG编码器（应用退出时调用）
 *
 * @return int32_t 0表示成功
 */
int32_t app_jpeg_encoder_stop(void)
{
    if (!g_encoder_initialized) {
        return -1;
    }

    int32_t ret = jpeg_encoder_stop(&g_jpeg_encoder_ctx);
    if (ret == 0) {
        // g_encoder_initialized = 0;
    }

    return ret;
}

/**
 * @brief 生成纯色YUV422图像用于测试
 *
 * @param width 图像宽度
 * @param height 图像高度
 * @param y Y分量值 (亮度, 0-255)
 * @param u U分量值 (色度, 0-255)
 * @param v V分量值 (色度, 0-255)
 * @return uint8_t* 返回分配的图像缓冲区,需要调用者释放
 */
uint8_t* generate_solid_yuv422_image(uint16_t width, uint16_t height,
                                     uint8_t y, uint8_t u, uint8_t v)
{
    /* YUV422格式: Y0 U0 Y1 V0 (每2个像素4字节) */
    uint32_t image_size = width * height * 2;
    uint8_t *image = (uint8_t*)malloc(image_size);

    if (!image) {
        return NULL;
    }

    /* 填充YUV422数据 */
    for (uint32_t i = 0; i < image_size; i += 4) {
        image[i + 0] = y;  /* Y0 */
        image[i + 1] = u;  /* U0 */
        image[i + 2] = y;  /* Y1 */
        image[i + 3] = v;  /* V0 */
    }

    return image;
}

/**
 * @brief 测试160x160纯色YUV422图像编码
 *
 * @return int32_t 0表示成功
 */
// int32_t test_160x160_solid_color_encode(void)
int main(int argc, char *argv[])
{
    (void)argc;
    (void)argv;
    int32_t ret = 0;
    uint8_t *input_image = NULL;
    uint8_t *output_jpeg = NULL;
    uint32_t jpeg_size = 0;

    /* 初始化串口 */
    if (serial_init() != 0) {
        LOGE("Serial init failed");
        return -1;
    }
    LOGI("Serial initialized (3Mbps)");

    /* 1. 初始化编码器 */
    ret = app_jpeg_encoder_init(160, 160, 0x00); /* YUV422格式 */
    if (ret != 0) {
        return ret;
    }

    /* 2. 生成纯色图像 */
    /* 红色: Y=76, U=84, V=255 */
    input_image = generate_solid_yuv422_image(160, 160, 76, 84, 255);
    if (!input_image) {
        app_jpeg_encoder_stop();
        return -1;
    }

    /* 3. 分配输出缓冲区 */
    output_jpeg = (uint8_t*)malloc((size_t)160 * 160 * 2);
    if (!output_jpeg) {
        free(input_image);
        app_jpeg_encoder_stop();
        return -1;
    }

    while (1) {
        /* 4. 执行编码 */
        ret = app_jpeg_encode_frame(input_image, output_jpeg, &jpeg_size);
        if (ret != 0) {
            free(output_jpeg);
            free(input_image);
            app_jpeg_encoder_stop();
            return ret;
        }

        vTaskDelay(pdMS_TO_TICKS(2000));
    }

    LOGI("JPEG encode success, size=%u bytes", jpeg_size);

    /* 5. 通过串口发送JPEG图像 (只发送一张) */
    serial_send(output_jpeg, jpeg_size);

    /* 6. 等待发送完成 */
    while (!uart_tx_done) {
        /* 等待发送完成 */
    }
    LOGI("JPEG send completed");

    while (1);
    /* 7. 清理资源 */
    free(output_jpeg);
    free(input_image);
    app_jpeg_encoder_stop();

    return 0;
}

/* 使用示例 */
#if 0
void example_usage(void)
{
    /* 1. 应用启动时初始化编码器（只调用一次） */
    app_jpeg_encoder_init(640, 480, 0x00); /* YUV422格式 */

    /* 2. 每次需要编码时调用（可以连续调用多次） */
    uint8_t *input_image = ...; /* 摄像头图像数据 */
    uint8_t *output_jpeg = malloc(640 * 480 * 2); /* JPEG输出缓冲区 */
    uint32_t jpeg_size = 0;

    for (int i = 0; i < 100; i++) {
        /* 快速编码，无重复初始化 */
        app_jpeg_encode_frame(input_image, output_jpeg, &jpeg_size);

        /* 发送JPEG数据... */
        send_jpeg_data(output_jpeg, jpeg_size);
    }

    /* 3. 应用退出时停止编码器 */
    app_jpeg_encoder_stop();
    free(output_jpeg);
}
#endif
```

## src/jpeg_encoder_ext.h
```c
/* JPEG硬件编码接口
 * 将初始化、编码和停止分离，避免每次编码都重复初始化硬件
 */

#ifndef __JPEG_ENCODER_EXT_H__
#define __JPEG_ENCODER_EXT_H__

#ifdef __cplusplus
extern "C" {
#endif

#include <stdio.h>
#include <stdint.h>
#include <string.h>
#include "Driver_JPEG.h"
#include "Driver_DMA2D.h"
#include "Driver_GPDMA.h"

/* JPEG编码器配置 */
typedef struct {
    uint16_t width;
    uint16_t height;
    uint8_t input_format;  /* JPEG_PIXEL_FORMAT_YUV422, JPEG_PIXEL_FORMAT_RGB888等 */
} jpeg_enc_cfg_t;

/* JPEG编码器上下文 */
typedef struct {
    Jpeg_InitTypeDef jpeg_cfg;
    csk_dma2d_ch_t in_ch;
    csk_dma2d_ch_t transfer_ch;
    csk_dma2d_ch_t out_ch;
    uint8_t *pipo_buf[2];
    uint8_t *pipo_buf_ori[2];
    uint8_t *ecs_output_buffer;
    uint8_t *ecs_output_buffer_ori;
    uint8_t *mcu_buffer;            /* 软件MCU块转换缓冲区 */
    uint8_t *mcu_buffer_ori;        /* 软件MCU块转换缓冲区（原始指针）*/
    uint8_t *planar_buffer;         /* 硬件平面格式转换缓冲区 */
    uint8_t *planar_buffer_ori;     /* 硬件平面格式转换缓冲区（原始指针）*/
    uint32_t pipo_buf_len;
    uint32_t ecs_len;
    uint8_t initialized;
} jpeg_enc_ctx_t;

/**
 * @brief 初始化JPEG编码器（仅调用一次）
 *
 * @param ctx 编码器上下文
 * @param cfg 编码器配置
 * @return int32_t 0表示成功，其他表示失败
 */
int32_t jpeg_encoder_init(jpeg_enc_ctx_t *ctx, jpeg_enc_cfg_t *cfg);

/**
 * @brief 编码一帧图像（快速编码，无重复初始化）
 *
 * @param ctx 编码器上下文
 * @param in_buf 输入图像数据
 * @param out_buf 输出JPEG数据缓冲区
 * @param out_size 输出JPEG数据大小
 * @return int32_t 0表示成功，其他表示失败
 */
int32_t jpeg_encoder_encode(jpeg_enc_ctx_t *ctx, void *in_buf, void *out_buf, uint32_t *out_size);

/**
 * @brief 停止并释放JPEG编码器资源
 *
 * @param ctx 编码器上下文
 * @return int32_t 0表示成功，其他表示失败
 */
int32_t jpeg_encoder_stop(jpeg_enc_ctx_t *ctx);

#ifdef __cplusplus
}
#endif

#endif /* __JPEG_ENCODER_EXT_H__ */
```
