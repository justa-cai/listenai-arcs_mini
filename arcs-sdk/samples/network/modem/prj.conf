## CMakeLists.txt
```
cmake_minimum_required(VERSION 3.19)

set(CMAKE_EXPORT_COMPILE_COMMANDS ON)

find_package(listenai-cmake REQUIRED HINTS $ENV{ARCS_BASE})

project(arcs)

listenai_include_directories(
    ./
)

add_subdirectory(src)

listenai_add_executable(${PROJECT_NAME})
listenai_code_relocate(LIBRARY chryusb LOCATION PSRAM)
```

## Kconfig
```
# Copyright (c) 2025, LISTENAI
# SPDX-License-Identifier: Apache-2.0

choice SAMPLE_MODEM_BACKEND
	prompt "Modem sample backend"
	default SAMPLE_MODEM_BACKEND_UART

config SAMPLE_MODEM_BACKEND_UART
	bool "UART modem backend"
	help
		Use a UART-connected modem as the AT transport backend.

config SAMPLE_MODEM_BACKEND_USB_AT
	bool "EC801E USB AT backend"
	depends on CHERRYUSB
	depends on CHERRYUSB_HOST
	depends on CHERRYUSB_HOST_GSM
	help
		Use CherryUSB host serial to scan the EC801E USB ECM AT interface
		(vendor specific AT port, interface 3) and bind it to lisa_modem.

endchoice

osource "$ARCS_BASE/Kconfig"
```

## sample.yaml
```
tests:
  samples.modem:
    build_only: true
```

## prj.conf
```kconfig
# 项目可根据需要在此文件中设置对应的配置
CONFIG_ARCS_HAL_WARNING_DISABLE=y
CONFIG_SDK_MODULE_EASYLOGGER=n

CONFIG_MODULE_FREERTOS=y
CONFIG_MODULE_HEAP=y
CONFIG_LINK_OPTION_NOSYS_SPECS=y

CONFIG_EASYLOGGER_ASYNC_BUF_SIZE=4096

# DISK 驱动使能
CONFIG_DISK_DRIVER=y

# 日志配置
CONFIG_LOG=y

# FreeRTOS 配置
CONFIG_FREERTOS_STATIC_ALLOCATION_ENABLE=y

# 缓存配置
CONFIG_DCACHE_ENABLE=y

# 堆内存配置
CONFIG_PSRAM_INIT=y
CONFIG_HEAP_SIZE=0xC000
CONFIG_PSRAM_HEAP_SIZE=0x200000

# 文件系统配置
CONFIG_FILE_SYSTEM=y
CONFIG_FATFS_FILESYSTEM=y
CONFIG_LSFS=y
CONFIG_LSFS_FAT=y
CONFIG_LSFS_REGISTER_VFS=y
CONFIG_LVFS_POSIX_API_ALIAS=y
CONFIG_LVFS=y
CONFIG_LVFS_POSIX_API=y
CONFIG_FS_ENV_MEMORY_MANAGEMENT_USE_PSRAM=y

# SD Card 驱动
CONFIG_DISK_DRIVER_SDMMC=y
CONFIG_LISA_SDMMC_DEVICE=y

# LISA 组件
CONFIG_LISA_OS=y
CONFIG_LISA_KV=y
CONFIG_WORK_QUEUE=y

# 调试配置
CONFIG_BACK_TRACE=y

# LISA Shell
CONFIG_LISA_SHELL=y

# UART 驱动（4G 模块通信必需）
CONFIG_LISA_UART_DEVICE=y
CONFIG_LISA_UART2=y
CONFIG_LISA_UART_ASYNC_API=y

# 4G Modem 配置（重要）
CONFIG_LISA_MODEM=y
CONFIG_LISA_MODEM_DRIVER_EC801E=y
CONFIG_SAMPLE_MODEM_BACKEND_UART=y

# SAL 网络抽象层
CONFIG_SAL_USING_POSIX=y
CONFIG_LISA_NET=y


# LWIP 网络栈（Modem 使用 SAL 抽象层）
CONFIG_LWIP=y
CONFIG_LWIP_OPTION_LWIP_DNS=y
CONFIG_LWIP_OPTION_SO_REUSE=y

# 禁用不需要的模块
CONFIG_SDK_MODULE_LISA_PLAYER=n
```

## prj_usb_at.conf
```kconfig
# USB AT backend overlay for samples/network/modem

# Single-core memory layout for CherryUSB host modem sample.
CONFIG_MEM_IPC_ISOLATED=n
CONFIG_MEM_LUNA_SHARED_SIZE=0x0

CONFIG_SAMPLE_MODEM_BACKEND_UART=n
CONFIG_SAMPLE_MODEM_BACKEND_USB_AT=y

CONFIG_CHERRYUSB=y
CONFIG_CHERRYUSB_HOST=y
CONFIG_CHERRYUSB_HOST_MUSB_LISA=y
CONFIG_CHERRYUSB_HOST_CDC_ECM=y
CONFIG_CHERRYUSB_HOST_GSM=y
# Keep ECM interface support enabled, but do not bind it into lwIP.
CONFIG_CHERRYUSB_HOST_CDC_ECM_NETIF=n
```

## src/main.c
```c
/*
 * Copyright (c) 2025, LISTENAI
 *
 * SPDX-License-Identifier: Apache-2.0
 */

/**
 * @file main.c
 * @brief 4G Modem 模块示例
 *
 * 本示例演示如何使用 LISA Modem 模块实现以下功能：
 * 1. 初始化 4G 模块（ML307）
 * 2. 通过 4G 模块建立 TCP 连接
 * 3. 发送和接收 TCP 数据
 * 4. UDP 数据收发
 * 5. DNS 域名解析
 * 6. 关闭连接和资源清理
 */

#define LOG_TAG "modem"
#include <lisa_log.h>

#include <stdio.h>
#include <string.h>
#include <stdlib.h>
#include <stdbool.h>

#include "FreeRTOS.h"
#include "task.h"

#include <lwip/sockets.h>
#include <lwip/inet.h>

#include "lisa_modem_module.h"
#include "user_fs.h"
#include "lisa_kv.h"
#include "modem_backend.h"

// ============================================================
// 重要：使用前请修改以下配置！
// ============================================================
#define MODEM_UART_DEVICE   "uart2"

#define TEST_SERVER_HOST    "httpbin.org"
#define TEST_SERVER_PORT    80

// UDP 测试服务器配置（可以使用公共 NTP 服务器或 echo 服务器测试）
#define UDP_TEST_HOST       "ntp.aliyun.com"
#define UDP_TEST_PORT       123  // NTP 端口

// HTTP GET 请求示例
#define HTTP_GET_REQUEST    "GET /get HTTP/1.1\r\n" \
                            "Host: httpbin.org\r\n" \
                            "Connection: close\r\n" \
                            "\r\n"

// 接收缓冲区大小
#define RECV_BUFFER_SIZE    1024

// 接收超时时间（毫秒）
#define RECV_TIMEOUT_MS     10000

/**
 * @brief 演示 DNS 解析功能
 */
static int demo_dns_resolve(lisa_modem_t *modem, const char *domain, char *ip_addr, size_t ip_len)
{
    LISA_LOGI(LOG_TAG, "=== DNS Resolve Test ===");
    LISA_LOGI(LOG_TAG, "Resolving domain: %s", domain);

    if (!lisa_modem_dns_resolve_on(modem, domain, ip_addr, ip_len)) {
        LISA_LOGE(LOG_TAG, "Error: DNS resolve failed for %s", domain);
        return -1;
    }

    LISA_LOGI(LOG_TAG, "Resolved IP: %s", ip_addr);
    return 0;
}

static bool resolve_ipv4_sockaddr(lisa_modem_t *modem, const char *host, int port, struct sockaddr_in *addr)
{
    char ip_addr[64] = {0};

    if (!host || !addr) {
        return false;
    }

    memset(addr, 0, sizeof(*addr));
    addr->sin_family = AF_INET;
    addr->sin_port = htons((uint16_t)port);

    if (inet_pton(AF_INET, host, &addr->sin_addr) == 1) {
        return true;
    }

    if (!lisa_modem_dns_resolve_on(modem, host, ip_addr, sizeof(ip_addr))) {
        return false;
    }

    return inet_pton(AF_INET, ip_addr, &addr->sin_addr) == 1;
}

/**
 * @brief 演示 TCP 连接和数据传输
 */
static int demo_tcp_communication(lisa_modem_t *modem, const char *host, int port)
{
    int sockfd = -1;
    int ret = -1;
    char *recv_buf = NULL;
    int recv_len;
    struct sockaddr_in dest_addr;

    LISA_LOGI(LOG_TAG, "=== TCP Communication Test ===");

    /* 分配接收缓冲区 */
    recv_buf = (char *)pvPortMalloc(RECV_BUFFER_SIZE);
    if (!recv_buf) {
        LISA_LOGE(LOG_TAG, "Error: Failed to allocate receive buffer");
        return -1;
    }

    /* 1. 创建 TCP socket */
    LISA_LOGI(LOG_TAG, "Step 1: Creating TCP socket...");
    sockfd = lisa_modem_socket_open_on(modem, AF_INET, SOCK_STREAM, 0);
    if (sockfd < 0) {
        LISA_LOGE(LOG_TAG, "Error: Failed to create TCP socket");
        goto cleanup;
    }
    LISA_LOGI(LOG_TAG, "TCP socket created: id=%d", sockfd);

    /* 2. 连接到服务器 */
    LISA_LOGI(LOG_TAG, "Step 2: Connecting to %s:%d...", host, port);
    if (!resolve_ipv4_sockaddr(modem, host, port, &dest_addr) ||
        !lisa_modem_socket_connect_on(modem, sockfd, (const struct sockaddr *)&dest_addr, (int)sizeof(dest_addr))) {
        LISA_LOGE(LOG_TAG, "Error: Failed to connect to server");
        goto cleanup;
    }
    LISA_LOGI(LOG_TAG, "Connected to server successfully");

    /* 3. 发送 HTTP 请求 */
    LISA_LOGI(LOG_TAG, "Step 3: Sending HTTP request...");
    ret = lisa_modem_socket_send_on(modem, sockfd, HTTP_GET_REQUEST, strlen(HTTP_GET_REQUEST), 5000);
    if (ret < 0) {
        LISA_LOGE(LOG_TAG, "Error: Failed to send data (ret=%d)", ret);
        goto cleanup;
    }
    LISA_LOGI(LOG_TAG, "Sent %d bytes", ret);

    /* 4. 接收响应 */
    LISA_LOGI(LOG_TAG, "Step 4: Receiving response...");
    memset(recv_buf, 0, RECV_BUFFER_SIZE);
    recv_len = lisa_modem_socket_recv_on(modem, sockfd, recv_buf, RECV_BUFFER_SIZE - 1, RECV_TIMEOUT_MS);
    if (recv_len > 0) {
        LISA_LOGI(LOG_TAG, "Received %d bytes:", recv_len);
        /* 打印前 512 字节的响应内容 */
        if (recv_len > 512) {
            recv_buf[512] = '\0';
            LISA_LOGI(LOG_TAG, "%s...(truncated)", recv_buf);
        } else {
            LISA_LOGI(LOG_TAG, "%s", recv_buf);
        }
    } else if (recv_len == 0) {
        LISA_LOGI(LOG_TAG, "Connection closed by server");
    } else {
        LISA_LOGE(LOG_TAG, "Error: Receive failed (ret=%d)", recv_len);
    }

    ret = 0;

cleanup:
    /* 5. 关闭连接 */
    if (sockfd >= 0) {
        LISA_LOGI(LOG_TAG, "Step 5: Closing connection...");
        lisa_modem_socket_close_on(modem, sockfd);
        LISA_LOGI(LOG_TAG, "Connection closed");
    }

    if (recv_buf) {
        vPortFree(recv_buf);
    }

    return ret;
}

/**
 * @brief 构建 NTP 请求包
 * @param buffer 缓冲区，至少 48 字节
 */
static void build_ntp_request(uint8_t *buffer)
{
    memset(buffer, 0, 48);
    /* NTP 版本 3，客户端模式 */
    buffer[0] = 0x1B;  // LI=0, VN=3, Mode=3 (client)
}

/**
 * @brief 演示 UDP 通信（使用 NTP 协议测试）
 */
static int demo_udp_communication(lisa_modem_t *modem, const char *host, int port)
{
    int sockfd = -1;
    int ret = -1;
    uint8_t ntp_request[48];
    uint8_t ntp_response[48];
    struct sockaddr_in dest_addr;
    struct sockaddr_in src_addr;
    int addr_len = sizeof(src_addr);
    char dest_ip[INET_ADDRSTRLEN] = {0};

    LISA_LOGI(LOG_TAG, "=== UDP Communication Test (NTP) ===");

    /* 1. 创建 UDP socket */
    LISA_LOGI(LOG_TAG, "Step 1: Creating UDP socket...");
    sockfd = lisa_modem_socket_open_on(modem, AF_INET, SOCK_DGRAM, 0);
    if (sockfd < 0) {
        LISA_LOGE(LOG_TAG, "Error: Failed to create UDP socket");
        return -1;
    }
    LISA_LOGI(LOG_TAG, "UDP socket created: id=%d", sockfd);

    /* 2. 准备目标地址 */
    LISA_LOGI(LOG_TAG, "Step 2: Resolving %s...", host);
    if (!resolve_ipv4_sockaddr(modem, host, port, &dest_addr)) {
        LISA_LOGE(LOG_TAG, "Error: Failed to resolve %s", host);
        goto cleanup;
    }
    inet_ntop(AF_INET, &dest_addr.sin_addr, dest_ip, sizeof(dest_ip));

    /* 3. 构建并发送 NTP 请求 */
    LISA_LOGI(LOG_TAG, "Step 3: Sending NTP request to %s:%d...", dest_ip, port);
    build_ntp_request(ntp_request);
    ret = lisa_modem_socket_sendto_on(modem, sockfd, ntp_request, sizeof(ntp_request), 0,
                                      (const struct sockaddr *)&dest_addr, (int)sizeof(dest_addr), 5000);
    if (ret < 0) {
        LISA_LOGE(LOG_TAG, "Error: Failed to send UDP data (ret=%d)", ret);
        goto cleanup;
    }
    LISA_LOGI(LOG_TAG, "Sent %d bytes", ret);

    /* 4. 接收 NTP 响应 */
    LISA_LOGI(LOG_TAG, "Step 4: Receiving NTP response...");
    memset(ntp_response, 0, sizeof(ntp_response));
    memset(&src_addr, 0, sizeof(src_addr));
    ret = lisa_modem_socket_recvfrom_on(modem, sockfd, ntp_response, sizeof(ntp_response), 0,
                                        (struct sockaddr *)&src_addr, &addr_len, RECV_TIMEOUT_MS);
    if (ret > 0) {
        char src_ip[INET_ADDRSTRLEN] = {0};

        inet_ntop(AF_INET, &src_addr.sin_addr, src_ip, sizeof(src_ip));
        LISA_LOGI(LOG_TAG, "Received %d bytes from NTP server", ret);
        LISA_LOGI(LOG_TAG, "recvfrom src=%s:%u", src_ip, ntohs(src_addr.sin_port));

        /* 解析 NTP 响应中的时间戳（简化版） */
        if (ret >= 48) {
            /* NTP 时间戳在偏移量 40-43（秒）*/
            uint32_t ntp_time = (ntp_response[40] << 24) | (ntp_response[41] << 16) |
                                (ntp_response[42] << 8) | ntp_response[43];
            /* NTP 时间从 1900 年开始，Unix 时间从 1970 年开始 */
            uint32_t unix_time = ntp_time - 2208988800UL;
            LISA_LOGI(LOG_TAG, "NTP timestamp: %u (Unix: %u)", ntp_time, unix_time);
        }
    } else if (ret == 0) {
        LISA_LOGI(LOG_TAG, "No data received");
    } else {
        LISA_LOGE(LOG_TAG, "Error: Receive failed (ret=%d)", ret);
    }

    ret = 0;

cleanup:
    /* 5. 关闭 UDP socket */
    if (sockfd >= 0) {
        LISA_LOGI(LOG_TAG, "Step 5: Closing UDP socket...");
        lisa_modem_socket_close_on(modem, sockfd);
        LISA_LOGI(LOG_TAG, "UDP socket closed");
    }

    return ret;
}

/**
 * @brief 主函数
 */
int main(int argc, char **argv)
{
    char ip_addr[64] = {0};
    lisa_modem_t *modem = NULL;

    (void)argc;
    (void)argv;

    LISA_LOGI(LOG_TAG, "=== 4G Modem Example ===");

    /* 初始化文件系统和 KV 存储 */
    user_fs_init();
    lisa_kv_init();

    /* 初始化 4G 模块 */
    LISA_LOGI(LOG_TAG, "Initializing 4G modem module via backend=%s...", sample_modem_backend_name());
    modem = sample_modem_open(MODEM_UART_DEVICE);
    if (!modem) {
        LISA_LOGE(LOG_TAG, "Error: Failed to initialize 4G modem");
        goto exit;
    }
    LISA_LOGI(LOG_TAG, "4G modem initialized successfully");

    /* 等待网络注册完成 */
    LISA_LOGI(LOG_TAG, "Waiting for network registration...");
    vTaskDelay(pdMS_TO_TICKS(3000));

    /* 演示 DNS 解析 */
    if (demo_dns_resolve(modem, TEST_SERVER_HOST, ip_addr, sizeof(ip_addr)) != 0) {
        LISA_LOGW(LOG_TAG, "DNS resolve failed, using hostname directly");
    }

    /* 演示 TCP 通信 */
    demo_tcp_communication(modem, TEST_SERVER_HOST, TEST_SERVER_PORT);

    /* 演示 UDP 通信（NTP 时间同步） */
    demo_udp_communication(modem, UDP_TEST_HOST, UDP_TEST_PORT);

    LISA_LOGI(LOG_TAG, "=== Example completed ===");

exit:
    if (modem) {
        sample_modem_close(modem);
    }

    /* 主循环 */
    while (1) {
        vTaskDelay(pdMS_TO_TICKS(1000));
    }

    return 0;
}
```

## src/modem_backend.h
```c
/*
 * Copyright (c) 2026, LISTENAI
 *
 * SPDX-License-Identifier: Apache-2.0
 */

#pragma once

#include "lisa_modem_module.h"

#ifdef __cplusplus
extern "C" {
#endif

lisa_modem_t *sample_modem_open(const char *uart_dev);
void sample_modem_close(lisa_modem_t *modem);
const char *sample_modem_backend_name(void);

#ifdef __cplusplus
}
#endif
```

## src/modem_backend_uart.c
```c
/*
 * Copyright (c) 2026, LISTENAI
 *
 * SPDX-License-Identifier: Apache-2.0
 */

#include "IOMuxManager.h"
#include "modem_backend.h"

#define SAMPLE_MODEM_UART2_TX_PAD   CSK_IOMUX_PAD_A
#define SAMPLE_MODEM_UART2_TX_PIN   15
#define SAMPLE_MODEM_UART2_RX_PAD   CSK_IOMUX_PAD_A
#define SAMPLE_MODEM_UART2_RX_PIN   16
#define SAMPLE_MODEM_UART2_FUNC     CSK_IOMUX_FUNC_ALTER4

/*
 * Override the weak board default so this sample owns the UART2 pin choice
 * instead of the AT transport layer.
 */
void lisa_uart2_pinmux(void)
{
    IOMuxManager_PinConfigure(SAMPLE_MODEM_UART2_TX_PAD, SAMPLE_MODEM_UART2_TX_PIN,
                              SAMPLE_MODEM_UART2_FUNC);
    IOMuxManager_PinConfigure(SAMPLE_MODEM_UART2_RX_PAD, SAMPLE_MODEM_UART2_RX_PIN,
                              SAMPLE_MODEM_UART2_FUNC);
}

const char *sample_modem_backend_name(void)
{
    return "uart";
}

lisa_modem_t *sample_modem_open(const char *uart_dev)
{
    return lisa_modem_create_uart(uart_dev, 0);
}

void sample_modem_close(lisa_modem_t *modem)
{
    lisa_modem_destroy(modem);
}
```

## src/modem_backend_usb_at.c
```c
/*
 * Copyright (c) 2026, LISTENAI
 *
 * SPDX-License-Identifier: Apache-2.0
 */

#define LOG_TAG "modem_usb"
#include <lisa_log.h>

#include <stdbool.h>
#include <stdio.h>

#include "ClockManager.h"
#include "arcs_ap.h"

#include "FreeRTOS.h"
#include "task.h"

#include "sys_init.h"
#include "usbh_core.h"
#include "usbh_serial.h"

#include "modem_backend.h"
#include "transport/at_transport_usbh_serial.h"

#define EC801E_USB_VID                  0x2c7c
#define EC801E_USB_PID_ECM              0x0903
#define EC801E_USB_AT_INTF_NUM          3
#define EC801E_USB_AT_MAX_TTYS          4
#define EC801E_USB_AT_SCAN_DELAY_MS     500
#define EC801E_USB_AT_POLL_INTERVAL_MS  20
#define EC801E_USB_HOST_BUSID           0
#define EC801E_USB_HOST_BASE            0x41000000UL

static bool s_usb_host_initialized;

static const char *usb_event_name(uint8_t event)
{
    switch (event) {
    case 1:
        return "CONNECTED";
    case 2:
        return "DISCONNECTED";
    case 3:
        return "REMOVED";
    default:
        return "OTHER";
    }
}

static void usbh_event_handler(uint8_t busid, uint8_t hub_index, uint8_t hub_port,
                               uint8_t intf, uint8_t event)
{
    LISA_LOGI(LOG_TAG, "USB bus=%u hub=%u port=%u intf=%u event=%u (%s)",
              busid, hub_index, hub_port, intf, event, usb_event_name(event));
}

static void sample_modem_usb_host_ensure_initialized(void)
{
    if (s_usb_host_initialized) {
        return;
    }

    LISA_LOGI(LOG_TAG, "Initializing USB host for modem AT backend");
    usbh_initialize(EC801E_USB_HOST_BUSID, EC801E_USB_HOST_BASE, usbh_event_handler);
    s_usb_host_initialized = true;
}

static bool sample_modem_usb_matches_ec801e_at(const struct usbh_serial *serial)
{
    if (!serial || !serial->hport) {
        return false;
    }

    return serial->hport->device_desc.idVendor == EC801E_USB_VID &&
           serial->hport->device_desc.idProduct == EC801E_USB_PID_ECM &&
           serial->intf == EC801E_USB_AT_INTF_NUM;
}

static lisa_modem_t *sample_modem_usb_try_open(void)
{
    char devname[16];

    for (int i = 0; i < EC801E_USB_AT_MAX_TTYS; ++i) {
        struct usbh_serial *serial;
        at_transport_t *transport;
        at_transport_usbh_serial_config_t transport_cfg = AT_TRANSPORT_USBH_SERIAL_CONFIG_DEFAULT();
        lisa_modem_t *modem;

        (void)snprintf(devname, sizeof(devname), "/dev/ttyUSB%d", i);
        serial = usbh_serial_open(devname, USBH_SERIAL_O_RDWR | USBH_SERIAL_O_NONBLOCK);
        if (!serial) {
            continue;
        }

        if (!sample_modem_usb_matches_ec801e_at(serial)) {
            usbh_serial_close(serial);
            continue;
        }

        transport_cfg.rx_timeout_ms = EC801E_USB_AT_POLL_INTERVAL_MS;
        transport = at_transport_usbh_serial_create(serial, true, &transport_cfg);
        if (!transport) {
            usbh_serial_close(serial);
            continue;
        }

        LISA_LOGI(LOG_TAG, "Using EC801E USB AT interface %u via %s", serial->intf, devname);
        modem = lisa_modem_create_with_transport(transport, true);
        if (modem) {
            return modem;
        }
    }

    return NULL;
}

const char *sample_modem_backend_name(void)
{
    return "usb-at";
}

lisa_modem_t *sample_modem_open(const char *uart_dev)
{
    bool announced = false;

    (void)uart_dev;
    sample_modem_usb_host_ensure_initialized();

    while (1) {
        lisa_modem_t *modem = sample_modem_usb_try_open();

        if (modem) {
            return modem;
        }

        if (!announced) {
            LISA_LOGI(LOG_TAG, "Waiting for EC801E USB AT interface (intf=%u)",
                      EC801E_USB_AT_INTF_NUM);
            announced = true;
        }
        vTaskDelay(pdMS_TO_TICKS(EC801E_USB_AT_SCAN_DELAY_MS));
    }
}

void sample_modem_close(lisa_modem_t *modem)
{
    lisa_modem_destroy(modem);
}

static int usb_host_init(void)
{
    IP_CMN_SYS->REG_USB_CTRL1.bit.USBPHY_OUTCLKSEL = 0x1;
    IP_SYSCTRL->REG_PERI_CLK_CFG6.bit.ENA_USB_CLK = 0x1;
    IP_CMN_SYS->REG_USB_CTRL1.bit.USBC_CFG_IDDIG = 0x0;
    IP_CMN_SYS->REG_USB_CTRL1.bit.UTMI_DATABUS16_8 = 0x1;
    return 0;
}

SYS_INIT(usb_host_init, SYS_INIT_LEVEL_PRE_DEVICES_INIT, 0);
```

## src/usb_config.h
```c
/*
 * Copyright (c) 2026, LISTENAI
 *
 * SPDX-License-Identifier: Apache-2.0
 */

#ifndef CHERRYUSB_CONFIG_H
#define CHERRYUSB_CONFIG_H

/* ================ USB common Configuration ================ */

#define CONFIG_USB_PRINTF(...) printf(__VA_ARGS__)

#ifndef CONFIG_USB_DBG_LEVEL
#define CONFIG_USB_DBG_LEVEL USB_DBG_INFO
#endif

#define CONFIG_USBHOST_DEBUG
#define CONFIG_USB_PRINTF_COLOR_ENABLE
#define CONFIG_USB_DCACHE_ENABLE

#ifdef CONFIG_USB_DCACHE_ENABLE
#define CONFIG_USB_ALIGN_SIZE 32
#else
#define CONFIG_USB_ALIGN_SIZE 4
#endif

#define USB_NOCACHE_RAM_SECTION

/* ================ USB HOST Stack Configuration ================== */

#define CONFIG_USBHOST_MAX_RHPORTS          1
#define CONFIG_USBHOST_MAX_EXTHUBS          8
#define CONFIG_USBHOST_MAX_EHPORTS          10
#define CONFIG_USBHOST_MAX_INTERFACES       8
#define CONFIG_USBHOST_MAX_INTF_ALTSETTINGS 2
#define CONFIG_USBHOST_MAX_ENDPOINTS        6

#define CONFIG_USBHOST_MAX_SERIAL_CLASS  4
#define CONFIG_USBHOST_MAX_HID_CLASS     1
#define CONFIG_USBHOST_MAX_MSC_CLASS     1
#define CONFIG_USBHOST_MAX_AUDIO_CLASS   1
#define CONFIG_USBHOST_MAX_VIDEO_CLASS   1

#define CONFIG_USBHOST_DEV_NAMELEN 16

#ifndef CONFIG_USBHOST_PSC_PRIO
#define CONFIG_USBHOST_PSC_PRIO 0
#endif

#ifndef CONFIG_USBHOST_PSC_STACKSIZE
#define CONFIG_USBHOST_PSC_STACKSIZE 2048
#endif

#ifndef CONFIG_USBHOST_NET_RX_STACKSIZE
#define CONFIG_USBHOST_NET_RX_STACKSIZE 4096
#endif

#define CONFIG_USBHOST_GET_STRING_DESC

#ifndef CONFIG_USBHOST_REQUEST_BUFFER_LEN
#define CONFIG_USBHOST_REQUEST_BUFFER_LEN 512
#endif

#ifndef CONFIG_USBHOST_CONTROL_TRANSFER_TIMEOUT
#define CONFIG_USBHOST_CONTROL_TRANSFER_TIMEOUT 500
#endif

/* ================ USB Host Port Configuration ================== */

#ifndef CONFIG_USBHOST_MAX_BUS
#define CONFIG_USBHOST_MAX_BUS 1
#endif

/* ---------------- MUSB Configuration ---------------- */

#define CONFIG_USB_MUSB_PIPE_NUM 8

#endif
```
