## CMakeLists.txt
```
cmake_minimum_required(VERSION 3.13)

set(CMAKE_EXPORT_COMPILE_COMMANDS ON)

find_package(listenai-cmake REQUIRED HINTS $ENV{ARCS_BASE})

project(arcs)

listenai_include_directories(
    ./
)

add_subdirectory(src)

listenai_add_executable(${PROJECT_NAME})
listenai_link_libraries(mbedtls)
```

## sample.yaml
```
tests:
  samples.http:
    build_only: true
```

## prj.conf
```kconfig
# 项目可根据需要在此文件中设置对应的配置
CONFIG_ARCS_HAL_WARNING_DISABLE=y
CONFIG_SDK_MODULE_EASYLOGGER=n

# CONFIG_ARCS_HAL_DEBUG=y
CONFIG_MODULE_FREERTOS=y
CONFIG_MODULE_HEAP=y
CONFIG_LINK_OPTION_NOSYS_SPECS=y


CONFIG_EASYLOGGER_ASYNC_BUF_SIZE=0x1000

# DISK驱动使能
CONFIG_DISK_DRIVER=y

#using mbedtls for hardware decoding(IF CONFIG_WX_SQLITE3_HARD_CODEC)
CONFIG_SDK_MODULE_MBEDTLS=y
CONFIG_CUSTOM_MBEDTLS_CFG_FILE=y
CONFIG_MBEDTLS_CFG_FILE="config-tls-generic.h"
CONFIG_MBEDTLS_HARDWARE_ENTROPY=y
# CONFIG_MBEDTLS_HARDWARE_AES=y
# CONFIG_MBEDTLS_HARDWARE_SHA1=y
# CONFIG_MBEDTLS_HARDWARE_SHA256=y
# CONFIG_MBEDTLS_HARDWARE_SHA512=y
# CONFIG_MBEDTLS_HARDWARE_AES_CCM=y
# CONFIG_MBEDTLS_HARDWARE_AES_GCM=y
# CONFIG_MBEDTLS_HARDWARE_ECC=y

# System support
CONFIG_MBEDTLS_HAVE_ASM=y
CONFIG_MBEDTLS_HAVE_TIME_DATE=y
CONFIG_MBEDTLS_SSL_ALPN=y

# Save RAM at the expense of ROM
CONFIG_MBEDTLS_AES_ROM_TABLES=y
# mbed TLS feature support
CONFIG_MBEDTLS_CIPHER_MODE_CBC_ENABLED=y
CONFIG_MBEDTLS_KEY_EXCHANGE_RSA_ENABLED=y
CONFIG_MBEDTLS_KEY_EXCHANGE_ECDHE_RSA_ENABLED=y
# Supported TLS versions
CONFIG_MBEDTLS_TLS_VERSION_1_0=y
CONFIG_MBEDTLS_TLS_VERSION_1_1=y
CONFIG_MBEDTLS_TLS_VERSION_1_2=y
# mbed TLS modules
CONFIG_MBEDTLS_CIPHER_AES_ENABLED=y
CONFIG_MBEDTLS_CIPHER=y
CONFIG_MBEDTLS_CTR_DRBG_ENABLED=y
CONFIG_MBEDTLS_ENTROPY_ENABLED=y
CONFIG_MBEDTLS_MD=y
CONFIG_MBEDTLS_MAC_MD5_ENABLED=y
CONFIG_MBEDTLS_HASH_MD5_ENABLED=y
CONFIG_MBEDTLS_MAC_SHA1_ENABLED=y
CONFIG_MBEDTLS_HASH_SHA1_ENABLED=y
CONFIG_MBEDTLS_MAC_SHA256_ENABLED=y
CONFIG_MBEDTLS_SHA256_SMALLER=y
CONFIG_MBEDTLS_HASH_SHA256_ENABLED=y
CONFIG_MBEDTLS_DTLS=y
CONFIG_MBEDTLS_SERVER_NAME_INDICATION=y
CONFIG_MBEDTLS_ECDH_C=y
CONFIG_MBEDTLS_ECP_C=y
CONFIG_MBEDTLS_CIPHER_GCM_ENABLED=y
CONFIG_MBEDTLS_ECP_DP_SECP256R1_ENABLED=y
CONFIG_MBEDTLS_MAC_SHA512_ENABLED=y
CONFIG_MBEDTLS_HASH_SHA512_ENABLED=y
CONFIG_MBEDTLS_PEM_CERTIFICATE_FORMAT=y
CONFIG_MBEDTLS_SSL_MAX_CONTENT_LEN=16384
CONFIG_MBEDTLS_CTR_DRBG_ENABLED=y

# CONFIG_MBEDTLS_DEBUG=y

CONFIG_MBEDTLS_INTERNAL_MEM_ALLOC=n
CONFIG_MBEDTLS_EXTERNAL_MEM_ALLOC=y

# CONFIG_ARCS_HAL_DEBUG=y
CONFIG_MODULE_HEAP=y

CONFIG_LOG=y


CONFIG_LWIP=y
CONFIG_WIFI=y
CONFIG_WIFI_TX_BUF_COPY=y
CONFIG_WIFI_LWIP_SAME_CORE=y
CONFIG_LWIP_TX_BUF_COPY=y
CONFIG_LWIP_OPTION_LWIP_DNS=y
CONFIG_LWIP_OPTION_SO_REUSE=y

CONFIG_FREERTOS_STATIC_ALLOCATION_ENABLE=y

CONFIG_DCACHE_ENABLE=y


CONFIG_MODULE_ZE_TLS=y
CONFIG_MODULE_HTTPCLIENT=y
CONFIG_MODULE_NOPOLL=y
CONFIG_MODULE_CORESNTP=y
CONFIG_LWIP_OPTION_SO_REUSE=y
CONFIG_LWIP_OPTION_LWIP_DNS=y

CONFIG_HEAP_SIZE=0x3C00


CONFIG_PSRAM_HEAP_SIZE=0x5b0000

# 文件系统配置
CONFIG_FILE_SYSTEM=y
CONFIG_FATFS_FILESYSTEM=y
# 抽象文件系统
CONFIG_LSFS=y
CONFIG_LSFS_FAT=y
CONFIG_LSFS_REGISTER_VFS=y
CONFIG_LVFS_POSIX_API_ALIAS=y
CONFIG_LVFS=y
CONFIG_LVFS_POSIX_API=y
CONFIG_FS_ENV_MEMORY_MANAGEMENT_USE_PSRAM=y

# LISA WIFI
CONFIG_LISA_WIFI=y

# MAC Manager
CONFIG_MAC_MANAGER=y
CONFIG_MAC_MANAGER_MAC_BY_CHIP_ID=y

#WIFI MANAGER
CONFIG_WIFI_MANAGER=y

# LISA Shell
CONFIG_LISA_SHELL=y

# LISA Porting
CONFIG_LISA_PORTING=y

# SD Card drivers
CONFIG_DISK_DRIVER_SDMMC=y
CONFIG_LISA_SDMMC_DEVICE=y

CONFIG_CJSON=y

CONFIG_LISA_OS=y
CONFIG_LISA_KV=y
CONFIG_LISA_NETWORK=y
CONFIG_SDK_MODULE_ICO=y
CONFIG_LISA_HTTP=y
```

## src/main.c
```c
#include "stdio.h"
#include "stdlib.h"
#include "string.h"
#include "stdbool.h"
#include "assert.h"
#include "FreeRTOS.h"
#include "task.h"

#define TAG "http-test"
#include "lisa_log.h"
#include "lisa_kv.h"
#include "mac_manager.h"
#include "mac_manager_ops.h"
#include "wifi_manager/wifi_manager.h"
#include "user_fs.h"
#include "lisa_wifi.h"
#include "ls_wifi_type.h"
#include "net_al.h"
#include "net_def.h"
#include "lisa_http.h"

// ============================================================
// 重要：使用前请修改以下配置！
// ============================================================
#define SERVER_URL     "http://192.168.1.100:8080"

#define TARGET_WIFI_SSID   "your_wifi_ssid"
#define TARGET_WIFI_PWD     "your_wifi_pwd"

// 编译时检查：确保用户已修改默认配置
#ifndef SERVER_URL
#error "请修改 SERVER_URL 为实际的测试服务器 URL（例如：http://192.168.1.100:8080）"
#endif

#ifndef TARGET_WIFI_SSID
#error "请修改 TARGET_WIFI_SSID 为实际的 WiFi SSID"
#endif

#ifndef TARGET_WIFI_PWD
#error "请修改 TARGET_WIFI_PWD 为实际的 WiFi 密码"
#endif

#define WIFI_MGR_AUTO_CONNECT_INTERVAL_MS 2000

#define WIFI_MGR_SEARCH_AP_BUFFER_SIZE 10

#define HTTP_TEST_HEAD "Transfer-Encoding: chunked\r\n"

static mac_manager_t *m_mac_manager;
static wifi_mgr_sta_config_t list[WIFI_MGR_SEARCH_AP_BUFFER_SIZE] = { 0 };

static int8_t custom_get_wifi_mac(uint8_t mac_addr[6])
{
    int8_t ret = 0;

    if (!mac_addr)
        return -1;

    ret = mac_manager_get(m_mac_manager, mac_addr, 6);
    LOGI("custom_get_wifi_mac: %d, %02X:%02X:%02X:%02X:%02X:%02X", ret, mac_addr[0], mac_addr[1], mac_addr[2],
         mac_addr[3], mac_addr[4], mac_addr[5]);
    return ret;
}

static volatile bool g_wifi_connected = false;
static volatile bool g_get_ip_success = false;

static void dhcp_status_callback(int vif_idx, bool success, uint32_t ip_addr, uint32_t netmask, uint32_t gateway, void *arg)
{
    if (success) {
        LOGI("DHCP Success on VIF-%d: IP=%d.%d.%d.%d, Mask=%d.%d.%d.%d, GW=%d.%d.%d.%d",
             vif_idx,
             ip_addr & 0xff, (ip_addr >> 8) & 0xff, (ip_addr >> 16) & 0xff, (ip_addr >> 24) & 0xff,
             netmask & 0xff, (netmask >> 8) & 0xff, (netmask >> 16) & 0xff, (netmask >> 24) & 0xff,
             gateway & 0xff, (gateway >> 8) & 0xff, (gateway >> 16) & 0xff, (gateway >> 24) & 0xff);
        g_get_ip_success = true;
    } else {
        LOGI("DHCP Failed on VIF-%d", vif_idx);
    }
}

static void wifi_mgr_connection_status_cb(wifi_mgr_connection_info_t *connection_info, void *arg)
{
    net_if_t *net_if;

    LOGI("WiFi connection status: %d", connection_info->status);

    switch (connection_info->status) {
    case WIFI_MGR_STA_CONNECTED:
        LOGI("WiFi connected to AP");
        g_wifi_connected = true;
        net_if = net_if_get(WIFI_VIF_STA_IDX);
        net_if_up(net_if);
        if (!net_if->static_ip) {
            ls_dhcpc_start(WIFI_VIF_STA_IDX);
        }
        break;

    case WIFI_MGR_STA_DISCONNECTED:
        LOGI("WiFi disconnected from AP");
        g_wifi_connected = false;
        ls_dhcpc_stop(WIFI_VIF_STA_IDX);
        net_if_down(net_if_get(WIFI_VIF_STA_IDX));
        break;

    default:
        break;
    }
}

static void user_mac_manager_init(void)
{
    mac_manager_config_t config = {
        .random_mac_if_mac_invalid = false,
    };

    m_mac_manager = mac_manager_init(mac_manager_ops_get()->mem_ops, mac_manager_ops_get()->content_ops, &config);
    if (m_mac_manager == NULL) {
        LOGI("mac_manager_init failed\n");
        assert(0);
    }
}

static void user_wifi_manager_init(void)
{
    wifi_mgr_sta_config_t cfg = {
        .ssid = TARGET_WIFI_SSID,
        .pwd = TARGET_WIFI_PWD,
    };

    wifi_mgr_autoconn_config_t autoconn_cfg = {
        .interval_ms = WIFI_MGR_AUTO_CONNECT_INTERVAL_MS,
    };

    wifi_mgr_init(wifi_mgr_ops_get());
    wifi_mgr_sta_enable();

    // 注册 WiFi 连接状态回调
    wifi_mgr_sta_add_connection_cb(wifi_mgr_connection_status_cb, NULL);

    /* 搜索并删除所有已保存的 AP */
    int count = wifi_mgr_storage_search_ap(list, WIFI_MGR_SEARCH_AP_BUFFER_SIZE, SEARCH_ALL, NULL);
    for (int i = 0; i < count; i++) {
        LOGI("Deleting saved AP: ssid=%s", list[i].ssid);
        wifi_mgr_storage_delete_ap(&list[i]);
    }

    // 保存 AP 配置并启动自动连接
    wifi_mgr_storage_save_ap(&cfg);
    wifi_mgr_auto_connect_start(&autoconn_cfg);

    LOGI("WiFi auto-connect started");
}

static int wait_for_wifi_connection(void)
{
    int timeout = 30; // 30 秒超时

    LOGI("Waiting for WiFi connection and IP address...");

    // 等待 WiFi 连接和 IP 获取
    while (timeout > 0) {
        if (g_wifi_connected && g_get_ip_success) {
            LOGI("WiFi connected and IP obtained, starting HTTP tests...");
            vTaskDelay(pdMS_TO_TICKS(500)); // 短暂延迟确保网络稳定
            return 0;
        }

        vTaskDelay(pdMS_TO_TICKS(1000));
        timeout--;

        if (timeout % 5 == 0) {
            LOGI("Waiting... (WiFi:%d, IP:%d, timeout:%d)", g_wifi_connected, g_get_ip_success, timeout);
        }
    }

    LOGI("WiFi connection or IP acquisition timeout (WiFi:%d, IP:%d)", g_wifi_connected, g_get_ip_success);
    return -1;
}

static void http_data_cb(lisa_http_data_t *data)
{
    if (!data || !data->buf) {
        LOGE("http data is null");
        return;
    } else if (data->len <= 0) {
        LOGE("http data len is 0");
        return;
    } else {
        LOGI("\nhttp response : %s\n", data->buf);
    }
}

static void *http_request_heads(void)
{
    return HTTP_TEST_HEAD;
}

int main(int argc, char **argv)
{
    int ret;
    lisa_http_t *http = NULL;

    LOGI("HTTP Test Starting...");

    // 初始化 MAC 管理器
    user_mac_manager_init();

    // 注册 DHCP 状态回调
    net_dhcp_register_status_callback(dhcp_status_callback, NULL);

    // 初始化 LISA WiFi
    lisa_wifi_ops_t ops = {
        .custom_mac = custom_get_wifi_mac,
    };
    lisa_wifi_init(&ops);

    // 初始化文件系统和 KV 存储
    user_fs_init();
    lisa_kv_init();

    // 初始化 WiFi 管理器并启动自动连接
    user_wifi_manager_init();

    // 等待 WiFi 连接成功
    ret = wait_for_wifi_connection();
    if (ret != 0) {
        LOGI("Failed to connect to WiFi");
        return -1;
    }

    LOGI("\n========================================");
    LOGI("HTTP 功能测试");
    LOGI("========================================\n");

    // 测试 1: HTTP GET 请求
    LOGI("=== 测试 1: HTTP GET 请求 ===");
    lisa_http_request_t req;

    memset(&req, 0, sizeof(lisa_http_request_t));
    req.method = LISA_HTTP_GET;
    req.url = SERVER_URL;
    req.timeout = 10;
    req.on_data = http_data_cb;
    req.body = NULL;
    req.body_len = 0;
    req.headers = NULL;

    http = lisa_http_init(&req);
    if (!http) {
        LOGE("[http] init err\n");
        goto ERR;
    }

    if (lisa_http_perform(http) != 0) {
        LOGE("http get request info err..\n");
        goto ERR;
    }

    if (http) {
        lisa_http_cleanup(http);
        http = NULL;
    }

    vTaskDelay(pdMS_TO_TICKS(1000));

    // 测试 2: HTTP POST 请求
    LOGI("\n=== 测试 2: HTTP POST 请求 ===");
    memset(&req, 0, sizeof(lisa_http_request_t));
    req.method = LISA_HTTP_POST;
    req.url = SERVER_URL "/foobar";
    req.timeout = 10;
    req.on_data = http_data_cb;
    req.body = "foobar";
    req.body_len = strlen(req.body);
    req.headers = NULL;

    http = lisa_http_init(&req);
    if (!http) {
        LOGE("[http] init err\n");
        goto ERR;
    }

    if (lisa_http_perform(http) != 0) {
        LOGE("http post request info err..\n");
        goto ERR;
    }

    if (http) {
        lisa_http_cleanup(http);
        http = NULL;
    }

    LOGI("\n========================================");
    LOGI("所有 HTTP 测试完成");
    LOGI("========================================\n");

ERR:
    if (http) {
        lisa_http_cleanup(http);
        http = NULL;
    }

    return 0;
}
```

## src/listen_wifi.c
```c
#include <string.h>
#include <stdbool.h>
#include "wlif.h"
#include "net_ip.h"
#include "net_al.h"
#include "cli_main.h"
#include "ipc_master.h"
#include "ipc_master_utils.h"
#include "shell_def.h"

#include "sysheap.h"
#include "lisa_log.h"
#include "lisa_mem.h"
#include "evs_utils.h"
#include "listen_wifi.h"
#include "ls_event.h"
#include "wifi_api.h"
#include "ls_wifi_type.h"

#if CONFIG_WIFI_MANAGER
#include "wifi_manager/wifi_manager.h"
#endif

#include "lwip/dns.h"

#define TAG "app-wifi"

static bool s_wifi_statck_init_done = false;
static ls_wifi_stack_init_done_cb s_pre_init_done_cb = NULL;
bool g_get_ip_success = false;

static int _handle_wifi_got_ip(void *arg)
{
    net_if_t *net_if = net_if_get(WIFI_VIF_STA_IDX);
    if (net_if) {
        uint32_t ip, mask, gw;
        net_if_get_ip(net_if, &ip, &mask, &gw);

        char addr_str[16 + 1];
        ip4_addr_t addr;

        addr.addr = ip;
        if (ip4addr_ntoa_r(&addr, addr_str, 16) != NULL) {
            LISA_LOGI(TAG, "IP: %s", addr_str);
        }

        addr.addr = mask;
        if (ip4addr_ntoa_r(&addr, addr_str, 16) != NULL) {
            LISA_LOGI(TAG, "Mask: %s", addr_str);
        }

        addr.addr = gw;
        if (ip4addr_ntoa_r(&addr, addr_str, 16) != NULL) {
            LISA_LOGI(TAG, "Gateway: %s", addr_str);
        }
    }
    // add new dns server
    ls_wifi_refresh_dnsserver("114.114.114.114");

    return 0;
}

static int _app_wifi_event_cb(void *arg, event_module_t event_module, int event_id, void *event_data)
{
    LISA_LOGI(TAG, "_app_wifi_event_cb event_id:%d",event_id);
    switch (event_id) {
    case EVENT_WIFI_INIT_DONE: {
        LISA_LOGD(TAG, "wifi init done");
        s_wifi_statck_init_done = true;
        // next can connect wifi
        if (s_pre_init_done_cb) {
            s_pre_init_done_cb();
            s_pre_init_done_cb = NULL;
        }
    } break;
    case EVENT_WIFI_CONNECTED: {
        LISA_LOGD(TAG, "wifi connected");
        net_if_t *net_if = net_if_get(WIFI_VIF_STA_IDX);
        if (!net_if->static_ip) {
            // start dhcp
            net_if_up(net_if);
            ls_dhcpc_start(WIFI_VIF_STA_IDX);
        }
    } break;
    case EVENT_WIFI_GOT_IP: {
        LISA_LOGD(TAG, "Got IP");
        evs_handler_post_runnable(_handle_wifi_got_ip, NULL);
        g_get_ip_success = true;
    } break;
    case EVENT_WIFI_STA_DHCP_FAIL: {
        LISA_LOGE(TAG, "wifi dhcp fail");
        ls_dhcpc_stop(WIFI_VIF_STA_IDX);
    } break;
    case EVENT_WIFI_DISCONNECT: {
        g_get_ip_success = true;
        LISA_LOGD(TAG, "wifi disconnected");
    } break;
    case EVENT_WIFI_STA_CONNECT_FAIL: {
        LISA_LOGE(TAG, "wifi connect fail");
    } break;
    case EVENT_WIFI_AP_STARTED: {
        LISA_LOGD(TAG, "wifi ap started");
        // start DHCPS
        ls_dhcps_start(WIFI_VIF_AP_IDX);
    } break;
    case EVENT_WIFI_AP_STA_ADD: {
        LISA_LOGD(TAG, "wifi ap sta add");
    } break;
    case EVENT_WIFI_AP_STA_DEL: {
        LISA_LOGD(TAG, "wifi ap sta delete");
    } break;
    case EVENT_WIFI_AP_STOPPED: {
        LISA_LOGD(TAG, "wifi ap stoped");
        ls_dhcps_stop();
    } break;
    default: {
        LISA_LOGW(TAG, "[%s %d]unknow wifi event %d", __FUNCTION__,__LINE__,event_id);
    } break;
    }

    return LS_OK;
}

void ls_wifi_pre_init(ls_wifi_stack_init_done_cb pre_init_done)
{
    s_pre_init_done_cb = pre_init_done;
    int ret = 0;

    struct ipc_master_cb_tag ipc_cb = {.wifi_tx_data_cfm = wlif_tx_cfm,
                                       .wifi_rx_data_ind = wlif_rx_buf_forward,
                                       .indication_handler = ipc_indication_handler};

    ipc_master_init(&ipc_cb);
    // ipc wifi init
    ipc_wifi_init();

    // register event
    ls_event_init();

    // register wifi event
    ls_event_register_cb(EVENT_WIFI, EVENT_ID_ALL, _app_wifi_event_cb, NULL);

    // init shell
    // shell_init(cli_shell_process);

    // init wifi manager
#if CONFIG_WIFI_MANAGER
    do{
        vTaskDelay(pdMS_TO_TICKS(10));
    }while(!s_wifi_statck_init_done);
    /*TODO: remove this delay*/
    vTaskDelay(pdMS_TO_TICKS(1000));
#endif
}

void ls_wifi_refresh_dnsserver(const char *const dns_srv)
{
    if (DNS_MAX_SERVERS >= 2) {
        ip_addr_t dns_ip_addr;
        if (ipaddr_aton(dns_srv, &dns_ip_addr)) {
            const ip_addr_t *dns_srv = dns_getserver(DNS_MAX_SERVERS - 1);
            if (dns_srv->addr != dns_ip_addr.addr) {
                LISA_LOGD(TAG, "%dth old dns server: %s", DNS_MAX_SERVERS, ipaddr_ntoa(dns_srv));

                // set new dns server
                dns_setserver(DNS_MAX_SERVERS - 1, &dns_ip_addr);

                dns_srv = dns_getserver(DNS_MAX_SERVERS - 1);
                LISA_LOGD(TAG, "%dth new dns server: %s", DNS_MAX_SERVERS, ipaddr_ntoa(dns_srv));
            }
        }
    }
}
```

## src/listen_wifi.h
```c
/**
 * @brief   Wifi状态管理
 * @version 0.1
 * @date 2022-08-18
 * 
 * Copyright (C) 2022 ANHUI LISTENAI Co., LTD All Rights Reserved
 */
#ifndef __LISTENAI_WIFI_MANAGER_H__
#define __LISTENAI_WIFI_MANAGER_H__

#include <stdint.h>
#include <stdbool.h>

typedef void (*ls_wifi_stack_init_done_cb)(void);

/**
 * Wifi预初始化
 */
void ls_wifi_pre_init(ls_wifi_stack_init_done_cb pre_init_done);

/**
 * @brief 	刷新 DNS Server, Ex.114.114.114.114
 */
void ls_wifi_refresh_dnsserver(const char *const dns_srv);
#endif
```
