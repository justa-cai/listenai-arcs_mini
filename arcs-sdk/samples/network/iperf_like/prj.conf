## Kconfig
```
# Copyright (c) 2025, LISTENAI
# SPDX-License-Identifier: Apache-2.0

osource "$ARCS_BASE/Kconfig"

menu "Iperf-Like 测试配置"

choice IPERF_DEFAULT_MODE
	prompt "默认测试模式"
	default IPERF_MODE_UPLINK
	help
	  选择上电后的默认 iperf3 测试模式。

config IPERF_MODE_UPLINK
	bool "上行测试"

config IPERF_MODE_DOWNLINK
	bool "下行测试"

config IPERF_MODE_BIDIRECTIONAL
	bool "双向同时测试"

endchoice

config IPERF_WIFI_SSID
	string "WiFi SSID"
	default "your_wifi_ssid"
	help
	  目标 WiFi 热点名称

config IPERF_WIFI_PWD
	string "WiFi 密码"
	default "your_wifi_password"
	help
	  目标 WiFi 热点密码

config IPERF_SERVER_IP
	string "测试服务器 IP 地址"
	default "192.168.1.100"
	help
	  运行 iperf3 服务端的主机 IP 地址。
	  请按实际局域网环境填写可访问的主机地址。

config IPERF_SERVER_PORT
	int "测试服务器端口"
	default 5201
	help
	  iperf3 服务端默认监听 5201

config IPERF_ROUND_SECONDS
	int "每轮测试持续时间（秒）"
	default 10
	help
	  每轮 TCP 发流测试的持续时间

config IPERF_SEND_BLOCK_SIZE
	int "发送块大小（字节）"
	default 1460
	help
	  每次 send() 调用的数据块大小，建议与 TCP MSS 对齐

config IPERF_ROUND_INTERVAL_MS
	int "轮次间隔（毫秒）"
	default 1000
	help
	  两轮测试之间的等待时间

config IPERF_CONNECT_TIMEOUT_MS
	int "TCP 连接超时（毫秒）"
	default 5000
	help
	  TCP 连接服务器的超时时间

endmenu
```

## sample.yaml
```
tests:
  samples.network.iperf_like:
    build_only: true
```

## prj.conf
```kconfig
# 基础配置可根据后续功能调整
CONFIG_ARCS_HAL_WARNING_DISABLE=y
CONFIG_SDK_MODULE_EASYLOGGER=n

CONFIG_MODULE_FREERTOS=y
CONFIG_MODULE_HEAP=y
CONFIG_LINK_OPTION_NOSYS_SPECS=y

CONFIG_LOG=y
CONFIG_EASYLOGGER_ASYNC_BUF_SIZE=0x1000

# 内存配置
CONFIG_HEAP_SIZE=0x5000
CONFIG_PSRAM_HEAP_SIZE=0x200000

# LISA 组件
CONFIG_LISA_OS=y
CONFIG_LISA_KV=y
CONFIG_LISA_NETWORK=y
CONFIG_LISA_SHELL=y
CONFIG_LISA_PORTING=y

# 网络栈
CONFIG_WIFI=y
CONFIG_WIFI_LWIP_SAME_CORE=y
CONFIG_LISA_WIFI=y
CONFIG_WIFI_MANAGER=y
CONFIG_LWIP=y
CONFIG_LWIP_TX_BUF_COPY=y
CONFIG_WIFI_TX_BUF_COPY=y
CONFIG_LWIP_OPTION_LWIP_DNS=y
CONFIG_LWIP_OPTION_SO_REUSE=y
CONFIG_SAL_USING_POSIX=y

# 文件系统
CONFIG_FILE_SYSTEM=y
CONFIG_FATFS_FILESYSTEM=y
CONFIG_DISK_DRIVER=y
CONFIG_DISK_DRIVER_SDMMC=y
CONFIG_LISA_SDMMC_DEVICE=y
CONFIG_LSFS=y
CONFIG_LSFS_FAT=y
CONFIG_LSFS_REGISTER_VFS=y
CONFIG_LVFS=y
CONFIG_LVFS_POSIX_API=y

# MAC 管理
CONFIG_MAC_MANAGER=y
CONFIG_MAC_MANAGER_MAC_BY_CHIP_ID=y

# cJSON（iperf3 模式需要）
CONFIG_CJSON=y

# Iperf 测试配置（用户需按实际环境修改）
CONFIG_IPERF_MODE_UPLINK=y
CONFIG_IPERF_WIFI_SSID="ssid"
CONFIG_IPERF_WIFI_PWD="password"
CONFIG_IPERF_SERVER_IP="192.168.1.100"
CONFIG_IPERF_SERVER_PORT=5201
CONFIG_IPERF_ROUND_SECONDS=10
CONFIG_IPERF_SEND_BLOCK_SIZE=1460
CONFIG_IPERF_ROUND_INTERVAL_MS=1000
CONFIG_IPERF_CONNECT_TIMEOUT_MS=5000
```

## src/main.c
```c
/*
 * Copyright (c) 2026, LISTENAI
 *
 * SPDX-License-Identifier: Apache-2.0
 */

#define LOG_TAG "iperf"
#include <lisa_log.h>

#include <stdbool.h>
#include <stdint.h>
#include <string.h>

#include "FreeRTOS.h"
#include "task.h"

#include "lisa_shell.h"

#include "nettest_app.h"
#include "nettest_config.h"
#include "nettest_iperf3.h"
#include "nettest_wifi.h"

static volatile bool g_nettest_enabled = true;
static volatile nettest_app_state_t g_nettest_state = NETTEST_APP_STATE_INIT;
static volatile nettest_mode_t g_nettest_mode = NETTEST_DEFAULT_MODE;
static volatile nettest_mode_t g_pending_nettest_mode = NETTEST_DEFAULT_MODE;
static volatile uint32_t g_round_id;
static nettest_round_result_t g_last_result;
static bool g_stop_hint_logged;

static void nettest_app_set_state_locked(nettest_app_state_t state)
{
    taskENTER_CRITICAL();
    g_nettest_state = state;
    taskEXIT_CRITICAL();
}

static void nettest_app_store_last_result(const nettest_round_result_t *result)
{
    taskENTER_CRITICAL();
    memcpy(&g_last_result, result, sizeof(g_last_result));
    taskEXIT_CRITICAL();
}

static uint32_t nettest_app_next_round_id(void)
{
    uint32_t round_id;

    taskENTER_CRITICAL();
    g_round_id++;
    round_id = g_round_id;
    taskEXIT_CRITICAL();

    return round_id;
}

static void log_placeholder_warning(void)
{
    if (strcmp(TARGET_WIFI_SSID, NETTEST_PLACEHOLDER_WIFI_SSID) == 0 ||
        strcmp(TARGET_WIFI_PWD, NETTEST_PLACEHOLDER_WIFI_PWD) == 0) {
        LOGE("please update TARGET_WIFI_SSID/TARGET_WIFI_PWD in src/nettest_config.h before running");
    }
    if (strcmp(NETTEST_SERVER_IP, NETTEST_PLACEHOLDER_SERVER_IP) == 0) {
        LOGI("NETTEST_SERVER_IP is still the default example value: %s", NETTEST_SERVER_IP);
    }
}

static void log_round_summary(uint32_t round_id, const nettest_round_result_t *result)
{
    uint64_t tx_bps = nettest_result_tx_throughput_bps(result);
    uint64_t rx_bps = nettest_result_rx_throughput_bps(result);

    LOGI("round %u summary: mode=%s duration=%u ms tx_bytes=%llu tx_throughput=%llu bps "
         "rx_bytes=%llu rx_throughput=%llu bps errors=%u reason=%s",
         round_id,
         nettest_mode_str(result->mode),
         result->duration_ms,
         result->bytes_sent,
         tx_bps,
         result->bytes_received,
         rx_bps,
         result->error_count,
         nettest_stop_reason_str(result->stop_reason));
}

void nettest_app_set_enabled(bool enabled)
{
    taskENTER_CRITICAL();
    g_nettest_enabled = enabled;
    g_nettest_state = enabled ? NETTEST_APP_STATE_WAIT_NETWORK : NETTEST_APP_STATE_STOPPED;
    taskEXIT_CRITICAL();

    if (!enabled) {
        nettest_runner_iperf3_abort();
    }
}

bool nettest_app_is_enabled(void)
{
    return g_nettest_enabled;
}

void nettest_app_set_mode(nettest_mode_t mode)
{
    taskENTER_CRITICAL();
    g_pending_nettest_mode = mode;
    taskEXIT_CRITICAL();
}

nettest_mode_t nettest_app_get_mode(void)
{
    return g_pending_nettest_mode;
}

void nettest_app_get_status(nettest_app_status_t *status)
{
    if (status == NULL) {
        return;
    }

    taskENTER_CRITICAL();
    status->enabled = g_nettest_enabled;
    status->state = g_nettest_state;
    status->current_mode = g_nettest_mode;
    status->pending_mode = g_pending_nettest_mode;
    status->round_id = g_round_id;
    memcpy(&status->last_result, &g_last_result, sizeof(g_last_result));
    taskEXIT_CRITICAL();
}

const char *nettest_app_state_str(nettest_app_state_t state)
{
    switch (state) {
    case NETTEST_APP_STATE_INIT:
        return "init";
    case NETTEST_APP_STATE_WAIT_NETWORK:
        return "wait_network";
    case NETTEST_APP_STATE_RUNNING:
        return "running";
    case NETTEST_APP_STATE_STOPPED:
        return "stopped";
    default:
        return "unknown";
    }
}

int main(int argc, char **argv)
{
    int ret;

    (void)argc;
    (void)argv;

    LOGI("ARCS SDK iperf-like sample starting");
    LOGI("mode: iperf3 protocol");
    LOGI("default test mode: %s", nettest_mode_str(NETTEST_DEFAULT_MODE));
    LOGI("target server: %s:%d", NETTEST_SERVER_IP, NETTEST_SERVER_PORT);
    LOGI("round_seconds=%d block_size=%d interval_ms=%d",
         NETTEST_ROUND_SECONDS, NETTEST_SEND_BLOCK_SIZE, NETTEST_ROUND_INTERVAL_MS);
    LOGI("default mode: auto start after wifi is ready");
    LOGI("shell override: use 'iperf stop' to pause, 'iperf start' to resume");

    log_placeholder_warning();

    ret = lisa_shell_init();
    if (ret != 0) {
        LOGI("shell init failed: %d", ret);
    }

    ret = nettest_wifi_init();
    if (ret != 0) {
        LOGE("wifi init failed: %d", ret);
        return ret;
    }

    nettest_app_set_state_locked(NETTEST_APP_STATE_WAIT_NETWORK);

    while (1) {
        if (!g_nettest_enabled) {
            if (g_nettest_state != NETTEST_APP_STATE_STOPPED) {
                LOGI("nettest stopped by shell");
            }
            nettest_app_set_state_locked(NETTEST_APP_STATE_STOPPED);
            if (!g_stop_hint_logged) {
                LOGI("auto test paused, waiting for shell command 'iperf start'");
                g_stop_hint_logged = true;
            }
            if (!nettest_wifi_is_ready()) {
                (void)nettest_wifi_request_connect();
            }
            vTaskDelay(pdMS_TO_TICKS(200));
            continue;
        }

        if (!nettest_wifi_is_ready()) {
            if (g_nettest_state != NETTEST_APP_STATE_WAIT_NETWORK) {
                LOGI("waiting for wifi connection and IP");
            }
            nettest_app_set_state_locked(NETTEST_APP_STATE_WAIT_NETWORK);
            g_stop_hint_logged = false;
            (void)nettest_wifi_request_connect();
            vTaskDelay(pdMS_TO_TICKS(500));
            continue;
        }

        g_stop_hint_logged = false;
        nettest_app_set_state_locked(NETTEST_APP_STATE_RUNNING);
        taskENTER_CRITICAL();
        g_nettest_mode = g_pending_nettest_mode;
        taskEXIT_CRITICAL();
        uint32_t round_id = nettest_app_next_round_id();
        LOGI("round %u start, mode=%s", round_id, nettest_mode_str(g_nettest_mode));

        nettest_round_result_t round_result;
        memset(&round_result, 0, sizeof(round_result));
        round_result.mode = g_nettest_mode;
        ret = nettest_runner_iperf3_run(g_nettest_mode, &g_nettest_enabled, &round_result);
        nettest_app_store_last_result(&round_result);
        if (ret != 0) {
            LOGI("round %u ended with runner return=%d", round_id, ret);
        }
        log_round_summary(round_id, &round_result);

        if (!g_nettest_enabled) {
            nettest_app_set_state_locked(NETTEST_APP_STATE_STOPPED);
            continue;
        }

        if (!nettest_wifi_is_ready()) {
            nettest_app_set_state_locked(NETTEST_APP_STATE_WAIT_NETWORK);
            LOGI("network lost, pause until reconnect");
            continue;
        }

        /* iperf3 服务器单客户端，失败后需等待服务器清理残留连接 */
        if (ret != 0) {
            LOGI("iperf3 failed, waiting 5s before retry...");
            vTaskDelay(pdMS_TO_TICKS(5000));
        } else {
            vTaskDelay(pdMS_TO_TICKS(NETTEST_ROUND_INTERVAL_MS));
        }
    }

    return 0;
}
```

## src/nettest_app.h
```c
/*
 * Copyright (c) 2026, LISTENAI
 *
 * SPDX-License-Identifier: Apache-2.0
 */

#pragma once

#include <stdbool.h>

#include "nettest_result.h"

#ifdef __cplusplus
extern "C" {
#endif

typedef enum {
    NETTEST_APP_STATE_INIT = 0,
    NETTEST_APP_STATE_WAIT_NETWORK,
    NETTEST_APP_STATE_RUNNING,
    NETTEST_APP_STATE_STOPPED,
} nettest_app_state_t;

typedef struct {
    bool enabled;
    nettest_app_state_t state;
    nettest_mode_t current_mode;
    nettest_mode_t pending_mode;
    uint32_t round_id;
    nettest_round_result_t last_result;
} nettest_app_status_t;

void nettest_app_set_enabled(bool enabled);
bool nettest_app_is_enabled(void);
void nettest_app_set_mode(nettest_mode_t mode);
nettest_mode_t nettest_app_get_mode(void);
void nettest_app_get_status(nettest_app_status_t *status);
const char *nettest_app_state_str(nettest_app_state_t state);

#ifdef __cplusplus
}
#endif
```

## src/nettest_config.h
```c
/*
 * Copyright (c) 2026, LISTENAI
 *
 * SPDX-License-Identifier: Apache-2.0
 */

#pragma once

#include "autoconf.h"

/* WiFi 配置（来自 Kconfig） */
#define TARGET_WIFI_SSID CONFIG_IPERF_WIFI_SSID
#define TARGET_WIFI_PWD  CONFIG_IPERF_WIFI_PWD

/* 测试服务器配置（来自 Kconfig） */
#define NETTEST_SERVER_IP          CONFIG_IPERF_SERVER_IP
#define NETTEST_SERVER_PORT        CONFIG_IPERF_SERVER_PORT

/* 测试参数（来自 Kconfig） */
#define NETTEST_ROUND_SECONDS      CONFIG_IPERF_ROUND_SECONDS
#define NETTEST_SEND_BLOCK_SIZE    CONFIG_IPERF_SEND_BLOCK_SIZE
#define NETTEST_ROUND_INTERVAL_MS  CONFIG_IPERF_ROUND_INTERVAL_MS
#define NETTEST_CONNECT_TIMEOUT_MS CONFIG_IPERF_CONNECT_TIMEOUT_MS

#if defined(CONFIG_IPERF_MODE_UPLINK)
#define NETTEST_DEFAULT_MODE NETTEST_MODE_UPLINK
#elif defined(CONFIG_IPERF_MODE_DOWNLINK)
#define NETTEST_DEFAULT_MODE NETTEST_MODE_DOWNLINK
#else
#define NETTEST_DEFAULT_MODE NETTEST_MODE_BIDIRECTIONAL
#endif

/* 占位值检测（用于日志提示用户修改配置） */
#define NETTEST_PLACEHOLDER_WIFI_SSID "your_wifi_ssid"
#define NETTEST_PLACEHOLDER_WIFI_PWD  "your_wifi_password"
#define NETTEST_PLACEHOLDER_SERVER_IP "192.168.1.100"
```

## src/nettest_iperf3.h
```c
/*
 * Copyright (c) 2026, LISTENAI
 *
 * SPDX-License-Identifier: Apache-2.0
 *
 * iperf3 协议客户端实现（支持上行 / 下行 / 双向）
 */

#pragma once

#include <stdbool.h>
#include <stdint.h>

#include "nettest_result.h"

#ifdef __cplusplus
extern "C" {
#endif

/*
 * 使用 iperf3 协议执行一轮 TCP 吞吐测试
 *
 * 协议流程：
 *   1. 建立控制连接到 server:port
 *   2. 发送 37 字节 cookie
 *   3. PARAM_EXCHANGE: 发送 JSON 测试参数
 *   4. CREATE_STREAMS: 建立数据流连接（发送相同 cookie）
 *   5. TEST_START → TEST_RUNNING: 按模式执行发送 / 接收
 *   6. TEST_END → EXCHANGE_RESULTS: JSON 结果交换
 *   7. IPERF_DONE: 清理关闭
 *
 * @param enabled  外部使能标志，设为 false 可中止测试
 * @param result   输出测试结果
 * @return 0 成功，-1 失败
 */
int nettest_runner_iperf3_run(nettest_mode_t mode,
                              volatile bool *enabled,
                              nettest_round_result_t *result);

/* 中止正在进行的 iperf3 测试 */
void nettest_runner_iperf3_abort(void);

#ifdef __cplusplus
}
#endif
```

## src/nettest_result.c
```c
/*
 * Copyright (c) 2026, LISTENAI
 *
 * SPDX-License-Identifier: Apache-2.0
 */

#include "nettest_result.h"

#include <stddef.h>
#include <string.h>

const char *nettest_mode_str(nettest_mode_t mode)
{
    switch (mode) {
    case NETTEST_MODE_UPLINK:
        return "uplink";
    case NETTEST_MODE_DOWNLINK:
        return "downlink";
    case NETTEST_MODE_BIDIRECTIONAL:
        return "bidirectional";
    default:
        return "unknown";
    }
}

int nettest_mode_parse(const char *text, nettest_mode_t *mode)
{
    if (text == NULL || mode == NULL) {
        return -1;
    }

    if (strcmp(text, "uplink") == 0) {
        *mode = NETTEST_MODE_UPLINK;
        return 0;
    }
    if (strcmp(text, "downlink") == 0) {
        *mode = NETTEST_MODE_DOWNLINK;
        return 0;
    }
    if (strcmp(text, "bidirectional") == 0) {
        *mode = NETTEST_MODE_BIDIRECTIONAL;
        return 0;
    }

    return -1;
}

const char *nettest_stop_reason_str(nettest_stop_reason_t reason)
{
    switch (reason) {
    case NETTEST_STOP_REASON_NONE:
        return "none";
    case NETTEST_STOP_REASON_COMPLETE:
        return "complete";
    case NETTEST_STOP_REASON_NETWORK_LOST:
        return "network_lost";
    case NETTEST_STOP_REASON_CONNECT_FAIL:
        return "connect_fail";
    case NETTEST_STOP_REASON_SEND_FAIL:
        return "send_fail";
    case NETTEST_STOP_REASON_RECV_FAIL:
        return "recv_fail";
    case NETTEST_STOP_REASON_USER_STOP:
        return "user_stop";
    default:
        return "unknown";
    }
}

uint64_t nettest_result_throughput_bps(const nettest_round_result_t *result)
{
    return nettest_result_tx_throughput_bps(result);
}

uint64_t nettest_result_tx_throughput_bps(const nettest_round_result_t *result)
{
    if (result == NULL || result->duration_ms == 0) {
        return 0;
    }

    return (result->bytes_sent * 8ULL * 1000ULL) / result->duration_ms;
}

uint64_t nettest_result_rx_throughput_bps(const nettest_round_result_t *result)
{
    if (result == NULL || result->duration_ms == 0) {
        return 0;
    }

    return (result->bytes_received * 8ULL * 1000ULL) / result->duration_ms;
}
```

## src/nettest_result.h
```c
/*
 * Copyright (c) 2026, LISTENAI
 *
 * SPDX-License-Identifier: Apache-2.0
 */

#pragma once

#include <stdint.h>

#ifdef __cplusplus
extern "C" {
#endif

typedef enum {
    NETTEST_MODE_UPLINK = 0,
    NETTEST_MODE_DOWNLINK,
    NETTEST_MODE_BIDIRECTIONAL,
} nettest_mode_t;

typedef enum {
    NETTEST_STOP_REASON_NONE = 0,
    NETTEST_STOP_REASON_COMPLETE,
    NETTEST_STOP_REASON_NETWORK_LOST,
    NETTEST_STOP_REASON_CONNECT_FAIL,
    NETTEST_STOP_REASON_SEND_FAIL,
    NETTEST_STOP_REASON_RECV_FAIL,
    NETTEST_STOP_REASON_USER_STOP,
} nettest_stop_reason_t;

typedef struct {
    nettest_mode_t mode;
    uint64_t bytes_sent;
    uint64_t bytes_received;
    uint32_t duration_ms;
    uint32_t error_count;
    nettest_stop_reason_t stop_reason;
} nettest_round_result_t;

const char *nettest_mode_str(nettest_mode_t mode);
int nettest_mode_parse(const char *text, nettest_mode_t *mode);
const char *nettest_stop_reason_str(nettest_stop_reason_t reason);
uint64_t nettest_result_throughput_bps(const nettest_round_result_t *result);
uint64_t nettest_result_tx_throughput_bps(const nettest_round_result_t *result);
uint64_t nettest_result_rx_throughput_bps(const nettest_round_result_t *result);

#ifdef __cplusplus
}
#endif
```

## src/nettest_shell.c
```c
/*
 * Copyright (c) 2026, LISTENAI
 *
 * SPDX-License-Identifier: Apache-2.0
 */

#include <stdbool.h>
#include <stdint.h>
#include <string.h>

#include "shell.h"

#include "nettest_app.h"
#include "nettest_config.h"

static void shell_print_status(Shell *shell)
{
    nettest_app_status_t status;
    uint64_t tx_bps;
    uint64_t rx_bps;

    nettest_app_get_status(&status);
    tx_bps = nettest_result_tx_throughput_bps(&status.last_result);
    rx_bps = nettest_result_rx_throughput_bps(&status.last_result);

    shellPrint(shell, "enabled: %s\n", status.enabled ? "yes" : "no");
    shellPrint(shell, "state: %s\n", nettest_app_state_str(status.state));
    shellPrint(shell, "mode: iperf3\n");
    shellPrint(shell, "current_test_mode: %s\n", nettest_mode_str(status.current_mode));
    shellPrint(shell, "pending_test_mode: %s\n", nettest_mode_str(status.pending_mode));
    shellPrint(shell, "server: %s:%d\n", NETTEST_SERVER_IP, NETTEST_SERVER_PORT);
    shellPrint(shell, "round_seconds: %d\n", NETTEST_ROUND_SECONDS);
    shellPrint(shell, "send_block_size: %d\n", NETTEST_SEND_BLOCK_SIZE);
    shellPrint(shell, "round_id: %u\n", status.round_id);
    shellPrint(shell, "last_bytes_sent: %llu\n", status.last_result.bytes_sent);
    shellPrint(shell, "last_bytes_received: %llu\n", status.last_result.bytes_received);
    shellPrint(shell, "last_duration_ms: %u\n", status.last_result.duration_ms);
    shellPrint(shell, "last_error_count: %u\n", status.last_result.error_count);
    shellPrint(shell, "last_stop_reason: %s\n", nettest_stop_reason_str(status.last_result.stop_reason));
    shellPrint(shell, "last_tx_throughput_bps: %llu\n", tx_bps);
    shellPrint(shell, "last_rx_throughput_bps: %llu\n", rx_bps);
}

static int cmd_iperf(int argc, char **argv)
{
    Shell *shell = shellGetCurrent();
    const char *subcmd;
    int arg_base = 0;

    if (argc < 1) {
        shellPrint(shell, "Usage: iperf <start|stop|status|mode|help>\n");
        return -1;
    }

    subcmd = argv[0];
    if (strcmp(subcmd, "iperf") == 0) {
        if (argc < 2) {
            shellPrint(shell, "Usage: iperf <start|stop|status|mode|help>\n");
            return -1;
        }
        subcmd = argv[1];
        arg_base = 1;
    }

    if (strcmp(subcmd, "start") == 0) {
        nettest_app_set_enabled(true);
        shellPrint(shell, "iperf loop enabled\n");
        return 0;
    }

    if (strcmp(subcmd, "stop") == 0) {
        nettest_app_set_enabled(false);
        shellPrint(shell, "iperf loop disabled\n");
        return 0;
    }

    if (strcmp(subcmd, "status") == 0) {
        shell_print_status(shell);
        return 0;
    }

    if (strcmp(subcmd, "mode") == 0) {
        nettest_mode_t mode;
        int mode_index = arg_base + 1;

        if (argc <= mode_index) {
            shellPrint(shell, "current mode: %s\n", nettest_mode_str(nettest_app_get_mode()));
            shellPrint(shell, "set mode: iperf mode uplink|downlink|bidirectional\n");
            return 0;
        }

        const char *mode_arg = argv[mode_index];
        if (nettest_mode_parse(mode_arg, &mode) != 0) {
            shellPrint(shell, "Unknown mode: %s\n", mode_arg);
            shellPrint(shell, "Usage: iperf mode uplink|downlink|bidirectional\n");
            return -1;
        }

        nettest_app_set_mode(mode);
        shellPrint(shell, "iperf mode %s will apply on next round\n", nettest_mode_str(mode));
        return 0;
    }

    if (strcmp(subcmd, "help") == 0) {
        shellPrint(shell, "iperf start  - enable auto loop\n");
        shellPrint(shell, "iperf stop   - stop current round and disable auto loop\n");
        shellPrint(shell, "iperf status - show current status\n");
        shellPrint(shell, "iperf mode uplink|downlink|bidirectional - set next round mode\n");
        shellPrint(shell, "iperf help   - show this message\n");
        return 0;
    }

    shellPrint(shell, "Unknown subcommand: %s\n", subcmd);
    shellPrint(shell, "Usage: iperf <start|stop|status|mode|help>\n");
    return -1;
}

SHELL_EXPORT_CMD(
    SHELL_CMD_PERMISSION(0) | SHELL_CMD_TYPE(SHELL_TYPE_CMD_MAIN),
    iperf,
    cmd_iperf,
    iperf-like network throughput controls
);
```

## src/nettest_wifi.c
```c
/*
 * Copyright (c) 2026, LISTENAI
 *
 * SPDX-License-Identifier: Apache-2.0
 */

#include "nettest_wifi.h"

#include <assert.h>
#include <stdbool.h>
#include <stdint.h>
#include <string.h>

#include "FreeRTOS.h"
#include "task.h"

#include "nettest_config.h"
#include "user_fs.h"

#include "lisa_kv.h"
#include "lisa_wifi.h"
#include "mac_manager.h"
#include "mac_manager_ops.h"
#include "net_al.h"
#include "net_def.h"
#include "wifi_manager/wifi_manager.h"

#define LOG_TAG "iperf.wifi"
#include "lisa_log.h"

#define NETTEST_AUTOCONN_INTERVAL_MS 2000
#define NETTEST_WIFI_SEARCH_AP_BUFFER_SIZE 10

static mac_manager_t *g_mac_manager;
static volatile bool g_wifi_connected;
static volatile bool g_wifi_ready;
static volatile bool g_wifi_connecting;
static bool g_wifi_inited;
static volatile bool g_wifi_stack_ready;
static TickType_t g_last_connect_attempt_tick;
static wifi_mgr_sta_config_t g_saved_ap_list[NETTEST_WIFI_SEARCH_AP_BUFFER_SIZE];

static int8_t custom_get_wifi_mac(uint8_t mac_addr[6])
{
    if (mac_addr == NULL) {
        return -1;
    }

    int8_t ret = mac_manager_get(g_mac_manager, mac_addr, 6);
    LOGI("wifi mac: %02X:%02X:%02X:%02X:%02X:%02X",
         mac_addr[0], mac_addr[1], mac_addr[2], mac_addr[3], mac_addr[4], mac_addr[5]);
    return ret;
}

static void dhcp_status_callback(int vif_idx, bool success, uint32_t ip_addr, uint32_t netmask, uint32_t gateway, void *arg)
{
    (void)netmask;
    (void)gateway;
    (void)arg;

    if (success) {
        LOGI("DHCP success on VIF-%d: IP=%u.%u.%u.%u",
             vif_idx,
             ip_addr & 0xff, (ip_addr >> 8) & 0xff, (ip_addr >> 16) & 0xff, (ip_addr >> 24) & 0xff);
        g_wifi_ready = true;
    } else {
        LOGI("DHCP failed on VIF-%d", vif_idx);
        g_wifi_ready = false;
    }
}

static void wifi_mgr_connection_status_cb(wifi_mgr_connection_info_t *connection_info, void *arg)
{
    net_if_t *net_if;

    (void)arg;
    if (connection_info == NULL) {
        return;
    }

    LOGI("wifi connection status: %d", connection_info->status);

    switch (connection_info->status) {
    case WIFI_MGR_STA_CONNECTED:
        g_wifi_connecting = false;
        g_wifi_connected = true;
        g_wifi_ready = false;
        net_if = net_if_get(WIFI_VIF_STA_IDX);
        if (net_if != NULL) {
            net_if_up(net_if);
            if (!net_if->static_ip) {
                ls_dhcpc_start(WIFI_VIF_STA_IDX);
            }
        }
        LOGI("wifi connected to AP");
        break;
    case WIFI_MGR_STA_DISCONNECTED:
        g_wifi_connecting = false;
        g_wifi_connected = false;
        g_wifi_ready = false;
        ls_dhcpc_stop(WIFI_VIF_STA_IDX);
        net_if = net_if_get(WIFI_VIF_STA_IDX);
        if (net_if != NULL) {
            net_if_down(net_if);
        }
        LOGI("wifi disconnected from AP");
        break;
    case WIFI_MGR_STA_CONNECT_FAILED:
        g_wifi_connecting = false;
        g_wifi_connected = false;
        g_wifi_ready = false;
        LOGI("wifi connect failed, reason=%d", connection_info->reason);
        break;
    case WIFI_MGR_STA_CONNECTING:
        g_wifi_connecting = true;
        LOGI("wifi connecting...");
        break;
    default:
        break;
    }
}

static void user_mac_manager_init(void)
{
    mac_manager_config_t config = {
        .random_mac_if_mac_invalid = false,
    };

    g_mac_manager = mac_manager_init(mac_manager_ops_get()->mem_ops, mac_manager_ops_get()->content_ops, &config);
    assert(g_mac_manager != NULL);
}

static void user_wifi_manager_init(void)
{
    wifi_mgr_sta_config_t cfg = {0};
    wifi_mgr_autoconn_config_t autoconn_cfg = {
        .interval_ms = NETTEST_AUTOCONN_INTERVAL_MS,
    };

    wifi_mgr_init(wifi_mgr_ops_get());
    wifi_mgr_sta_enable();
    wifi_mgr_sta_add_connection_cb(wifi_mgr_connection_status_cb, NULL);

    strncpy(cfg.ssid, TARGET_WIFI_SSID, sizeof(cfg.ssid) - 1);
    strncpy(cfg.pwd, TARGET_WIFI_PWD, sizeof(cfg.pwd) - 1);

    int count = wifi_mgr_storage_search_ap(g_saved_ap_list, NETTEST_WIFI_SEARCH_AP_BUFFER_SIZE, SEARCH_ALL, NULL);
    for (int i = 0; i < count; i++) {
        LOGI("deleting saved AP: ssid=%s", g_saved_ap_list[i].ssid);
        wifi_mgr_storage_delete_ap(&g_saved_ap_list[i]);
    }

    int ret = wifi_mgr_storage_save_ap(&cfg);
    LOGI("wifi storage save ret=%d ssid=%s", ret, cfg.ssid);
    ret = wifi_mgr_auto_connect_start(&autoconn_cfg);
    LOGI("wifi auto connect start ret=%d", ret);
}

static void cb_lisa_wifi_init_done(void)
{
    LOGI("lisa_wifi_init_done");
    user_fs_init();
    lisa_kv_init();
    user_wifi_manager_init();
    g_wifi_stack_ready = true;
}

int nettest_wifi_init(void)
{
    if (g_wifi_inited) {
        return 0;
    }

    user_mac_manager_init();
    net_dhcp_register_status_callback(dhcp_status_callback, NULL);

    lisa_wifi_ops_t ops = {
        .init_done = cb_lisa_wifi_init_done,
        .custom_mac = custom_get_wifi_mac,
    };

    lisa_wifi_init(&ops);

    g_wifi_inited = true;
    return 0;
}

bool nettest_wifi_is_connected(void)
{
    return g_wifi_connected;
}

bool nettest_wifi_is_ready(void)
{
    return g_wifi_connected && g_wifi_ready;
}

int nettest_wifi_request_connect(void)
{
    if (!g_wifi_stack_ready || g_wifi_connected || g_wifi_connecting) {
        return 0;
    }

    TickType_t now = xTaskGetTickCount();
    if ((now - g_last_connect_attempt_tick) < pdMS_TO_TICKS(3000)) {
        return 0;
    }

    g_last_connect_attempt_tick = now;
    g_wifi_connecting = true;

    wifi_mgr_autoconn_config_t autoconn_cfg = {
        .interval_ms = NETTEST_AUTOCONN_INTERVAL_MS,
    };
    int ret = wifi_mgr_auto_connect_start(&autoconn_cfg);
    if (ret != 0) {
        g_wifi_connecting = false;
    }
    LOGI("wifi auto connect retrigger ret=%d", ret);
    return ret;
}

void nettest_wifi_reset_state(void)
{
    g_wifi_connecting = false;
    g_wifi_connected = false;
    g_wifi_ready = false;
}
```

## src/nettest_wifi.h
```c
/*
 * Copyright (c) 2026, LISTENAI
 *
 * SPDX-License-Identifier: Apache-2.0
 */

#pragma once

#include <stdbool.h>

#ifdef __cplusplus
extern "C" {
#endif

int nettest_wifi_init(void);
bool nettest_wifi_is_connected(void);
bool nettest_wifi_is_ready(void);
int nettest_wifi_request_connect(void);
void nettest_wifi_reset_state(void);

#ifdef __cplusplus
}
#endif
```
