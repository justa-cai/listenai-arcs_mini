## sample.yaml
```
tests:
  samples.wifi_manage:
    build_only: true
```

## prj.conf
```kconfig
# 项目可根据需要在此文件中设置对应的配置
CONFIG_ARCS_HAL_WARNING_DISABLE=y
CONFIG_SDK_MODULE_EASYLOGGER=n
CONFIG_BOOT=n
CONFIG_BOOT_HART=n

# CONFIG_ARCS_HAL_DEBUG=y
CONFIG_MODULE_FREERTOS=y
CONFIG_MODULE_HEAP=y
CONFIG_LINK_OPTION_NOSYS_SPECS=y

CONFIG_ARCS_CP_CORE=y


CONFIG_EASYLOGGER_ASYNC_BUF_SIZE=0x1000

# DISK驱动使能
CONFIG_DISK_DRIVER=y

#using mbedtls for hardware decoding(IF CONFIG_WX_SQLITE3_HARD_CODEC)
CONFIG_SDK_MODULE_MBEDTLS=y
CONFIG_CUSTOM_MBEDTLS_CFG_FILE=y
CONFIG_MBEDTLS_CFG_FILE="config-tls-generic.h"
CONFIG_MBEDTLS_HARDWARE_ENTROPY=y
# CONFIG_MBEDTLS_HARDWARE_AES=y
# CONFIG_MBEDTLS_HARDWARE_SHA1=y
# CONFIG_MBEDTLS_HARDWARE_SHA256=y
# CONFIG_MBEDTLS_HARDWARE_SHA512=y
# CONFIG_MBEDTLS_HARDWARE_AES_CCM=y
# CONFIG_MBEDTLS_HARDWARE_AES_GCM=y
# CONFIG_MBEDTLS_HARDWARE_ECC=y

# System support
CONFIG_MBEDTLS_HAVE_ASM=y
CONFIG_MBEDTLS_HAVE_TIME_DATE=y
CONFIG_MBEDTLS_SSL_ALPN=y

# Save RAM at the expense of ROM
CONFIG_MBEDTLS_AES_ROM_TABLES=y
# mbed TLS feature support
CONFIG_MBEDTLS_CIPHER_MODE_CBC_ENABLED=y
CONFIG_MBEDTLS_KEY_EXCHANGE_RSA_ENABLED=y
CONFIG_MBEDTLS_KEY_EXCHANGE_ECDHE_RSA_ENABLED=y
# Supported TLS versions
CONFIG_MBEDTLS_TLS_VERSION_1_0=y
CONFIG_MBEDTLS_TLS_VERSION_1_1=y
CONFIG_MBEDTLS_TLS_VERSION_1_2=y
# mbed TLS modules
CONFIG_MBEDTLS_CIPHER_AES_ENABLED=y
CONFIG_MBEDTLS_CIPHER=y
CONFIG_MBEDTLS_CTR_DRBG_ENABLED=y
CONFIG_MBEDTLS_ENTROPY_ENABLED=y
CONFIG_MBEDTLS_MD=y
CONFIG_MBEDTLS_MAC_MD5_ENABLED=y
CONFIG_MBEDTLS_HASH_MD5_ENABLED=y
CONFIG_MBEDTLS_MAC_SHA1_ENABLED=y
CONFIG_MBEDTLS_HASH_SHA1_ENABLED=y
CONFIG_MBEDTLS_MAC_SHA256_ENABLED=y
CONFIG_MBEDTLS_SHA256_SMALLER=y
CONFIG_MBEDTLS_HASH_SHA256_ENABLED=y
CONFIG_MBEDTLS_DTLS=y
CONFIG_MBEDTLS_SERVER_NAME_INDICATION=y
CONFIG_MBEDTLS_ECDH_C=y
CONFIG_MBEDTLS_ECP_C=y
CONFIG_MBEDTLS_CIPHER_GCM_ENABLED=y
CONFIG_MBEDTLS_ECP_DP_SECP256R1_ENABLED=y
CONFIG_MBEDTLS_MAC_SHA512_ENABLED=y
CONFIG_MBEDTLS_HASH_SHA512_ENABLED=y
CONFIG_MBEDTLS_PEM_CERTIFICATE_FORMAT=y
CONFIG_MBEDTLS_SSL_MAX_CONTENT_LEN=16384
CONFIG_MBEDTLS_CTR_DRBG_ENABLED=y

# CONFIG_MBEDTLS_DEBUG=y

CONFIG_MBEDTLS_INTERNAL_MEM_ALLOC=n
CONFIG_MBEDTLS_EXTERNAL_MEM_ALLOC=y

# CONFIG_ARCS_HAL_DEBUG=y
CONFIG_MODULE_HEAP=y

CONFIG_LOG=y
CONFIG_SYSLOG_PRINTK_REDIRECT=y
CONFIG_SYSLOG_UART_TX_PIN=3
CONFIG_SYSLOG_UART_TX_PIN_FUNC_SEL=2
CONFIG_SYSLOG_UART_PORT=0
CONFIG_SYSLOG_UART_BAUDRATE=921600


CONFIG_LWIP=y
CONFIG_ARCS_HAL_IPC=y
CONFIG_ARCS_HAL_IPC_MASTER=y
CONFIG_ARCS_HAL_WLIF=y
CONFIG_ARCS_HAL_EVENT=y
CONFIG_ARCS_HAL_CLI_CMD=y
CONFIG_ARCS_HAL_MODULE_SHELL=y

CONFIG_FREERTOS_STATIC_ALLOCATION_ENABLE=y

CONFIG_DCACHE_ENABLE=y


CONFIG_MODULE_ZE_TLS=y
CONFIG_MODULE_HTTPCLIENT=y
CONFIG_MODULE_NOPOLL=y
CONFIG_MODULE_CORESNTP=y
CONFIG_LWIP_OPTION_SO_REUSE=y
CONFIG_LWIP_OPTION_LWIP_DNS=y

CONFIG_BACK_TRACE=y
CONFIG_MEM_CONFIG=n
CONFIG_MEM_CONFIG_USE_CUSTOM_FILE=y
CONFIG_HEAP_SIZE=0x3C00


CONFIG_PSRAM_HEAP_SIZE=0x5b0000

# 文件系统配置
CONFIG_FILE_SYSTEM=y
CONFIG_FATFS_FILESYSTEM=y
# 抽象文件系统
CONFIG_LSFS=y
CONFIG_LSFS_FAT=y
CONFIG_LSFS_REGISTER_VFS=y
CONFIG_LVFS_POSIX_API_ALIAS=y
CONFIG_LVFS=y
CONFIG_LVFS_POSIX_API=y
CONFIG_FS_ENV_MEMORY_MANAGEMENT_USE_PSRAM=y

#WIFI MANAGER
CONFIG_WIFI_MANAGER=y

CONFIG_CJSON=y

CONFIG_LISA_OS=y
CONFIG_LISA_KV=y
```

## src/main.c
```c
#include "stdio.h"
#include "listen_wifi.h"
#include "stdlib.h"
#include "FreeRTOS.h"
#include "task.h"
#include "lisa_log.h"
#include "wifi_manager/wifi_manager.h"

#define WIFI_HOTSPOT_LIST_MAX_NUMBER  (10)

static void _main_wifi_stack_init_done_cb(void)
{
    LOGI("Wifi Stack Init Done");
}

static void wifi_mgr_connection_cb(wifi_mgr_connection_info_t *connection_info, void *arg)
{
    LOGI("mgr connection: %d", connection_info->status);
}

static void wifi_mgr_scan_done_cb(wifi_mgr_scan_info_t *aps_info, int ap_num, void *arg)
{
    int num;
    
    if (aps_info == NULL || ap_num <= 0) {
        LOGE("Scan done error");
        return;
    }

    LOGI("wifi manager scan done,update hotspot number:%d\n", ap_num);
    for (num = 0; num < ap_num; num++) {
       LOGI("ssid: %s rssi: %d", aps_info[num].ssid, aps_info[num].rssi);
    }
    LOGI("\n");
}

int main(int argc, char **argv)
{
    int ret;
    wifi_mgr_scan_info_t ap_info[WIFI_HOTSPOT_LIST_MAX_NUMBER];
    wifi_mgr_connection_status_t ret_status;

    wifi_mgr_sta_config_t cfg = {
        .ssid = "Xiaomi_listenai_2.4G",
        .pwd = "a12345678",
    };

    // wifi驱动初始化
    ls_wifi_pre_init(_main_wifi_stack_init_done_cb);
    
    // wifi管理初始化
    wifi_mgr_init(wifi_mgr_ops_get());
    wifi_mgr_sta_enable();

    // 注册WiFi回调事件
    wifi_mgr_sta_add_connection_cb(wifi_mgr_connection_cb, NULL);
    wifi_mgr_add_scan_done_cb(wifi_mgr_scan_done_cb, NULL);

    // 扫描附近的AP设备
    wifi_mgr_scan_ap(ap_info, WIFI_HOTSPOT_LIST_MAX_NUMBER, false);

    ret = wifi_mgr_sta_connect(&cfg, false);
    if (ret != 0) {
        LOGI("wifi connect failed");
        return -1;
    }

    while (1) {
        ret_status = wifi_mgr_sta_get_status();
        if (ret_status == WIFI_MGR_STA_CONNECTED) {
            wifi_mgr_sta_disconnect(false);
            break;
        }

        vTaskDelay(pdMS_TO_TICKS(1000));
    }

    return 0;
}
```

## src/listen_wifi.c
```c
#include <string.h>
#include <stdbool.h>
#include "wlif.h"
#include "net_ip.h"
#include "net_al.h"
#include "cli_main.h"
#include "ipc_master.h"
#include "ipc_master_utils.h"
#include "shell_def.h"

#include "sysheap.h"
#include "lisa_log.h"
#include "lisa_mem.h"
#include "evs_utils.h"
#include "listen_wifi.h"
#include "ls_event.h"
#include "wifi_api.h"
#include "ls_wifi_type.h"

#if CONFIG_WIFI_MANAGER
#include "wifi_manager/wifi_manager.h"
#endif

#include "lwip/dns.h"

#define TAG "app-wifi"

static bool s_wifi_statck_init_done = false;
static ls_wifi_stack_init_done_cb s_pre_init_done_cb = NULL;

static int _handle_wifi_got_ip(void *arg)
{
    net_if_t *net_if = net_if_get(WIFI_VIF_STA_IDX);
    if (net_if) {
        uint32_t ip, mask, gw;
        net_if_get_ip(net_if, &ip, &mask, &gw);

        char addr_str[16 + 1];
        ip4_addr_t addr;

        addr.addr = ip;
        if (ip4addr_ntoa_r(&addr, addr_str, 16) != NULL) {
            LISA_LOGI(TAG, "IP: %s", addr_str);
        }

        addr.addr = mask;
        if (ip4addr_ntoa_r(&addr, addr_str, 16) != NULL) {
            LISA_LOGI(TAG, "Mask: %s", addr_str);
        }

        addr.addr = gw;
        if (ip4addr_ntoa_r(&addr, addr_str, 16) != NULL) {
            LISA_LOGI(TAG, "Gateway: %s", addr_str);
        }
    }
    // add new dns server
    ls_wifi_refresh_dnsserver("114.114.114.114");

    return 0;
}

static int _app_wifi_event_cb(void *arg, event_module_t event_module, int event_id, void *event_data)
{
    LISA_LOGI(TAG, "_app_wifi_event_cb event_id:%d",event_id);
    switch (event_id) {
    case EVENT_WIFI_INIT_DONE: {
        LISA_LOGD(TAG, "wifi init done");
        s_wifi_statck_init_done = true;
        // next can connect wifi
        if (s_pre_init_done_cb) {
            s_pre_init_done_cb();
            s_pre_init_done_cb = NULL;
        }
    } break;
    case EVENT_WIFI_CONNECTED: {
        LISA_LOGD(TAG, "wifi connected");
        net_if_t *net_if = net_if_get(WIFI_VIF_STA_IDX);
        if (!net_if->static_ip) {
            // start dhcp
            net_if_up(net_if);
            ls_dhcpc_start(WIFI_VIF_STA_IDX);
        }
    } break;
    case EVENT_WIFI_GOT_IP: {
        LISA_LOGD(TAG, "Got IP");
        evs_handler_post_runnable(_handle_wifi_got_ip, NULL);
    } break;
    case EVENT_WIFI_STA_DHCP_FAIL: {
        LISA_LOGE(TAG, "wifi dhcp fail");
        ls_dhcpc_stop(WIFI_VIF_STA_IDX);
    } break;
    case EVENT_WIFI_DISCONNECT: {
        LISA_LOGD(TAG, "wifi disconnected");
    } break;
    case EVENT_WIFI_STA_CONNECT_FAIL: {
        LISA_LOGE(TAG, "wifi connect fail");
    } break;
    case EVENT_WIFI_AP_STARTED: {
        LISA_LOGD(TAG, "wifi ap started");
        // start DHCPS
        ls_dhcps_start(WIFI_VIF_AP_IDX);
    } break;
    case EVENT_WIFI_AP_STA_ADD: {
        LISA_LOGD(TAG, "wifi ap sta add");
    } break;
    case EVENT_WIFI_AP_STA_DEL: {
        LISA_LOGD(TAG, "wifi ap sta delete");
    } break;
    case EVENT_WIFI_AP_STOPPED: {
        LISA_LOGD(TAG, "wifi ap stoped");
        ls_dhcps_stop();
    } break;
    default: {
        LISA_LOGW(TAG, "[%s %d]unknow wifi event %d", __FUNCTION__,__LINE__,event_id);
    } break;
    }

    return LS_OK;
}

void ls_wifi_pre_init(ls_wifi_stack_init_done_cb pre_init_done)
{
    s_pre_init_done_cb = pre_init_done;
    int ret = 0;

    struct ipc_master_cb_tag ipc_cb = {.wifi_tx_data_cfm = wlif_tx_cfm,
                                       .wifi_rx_data_ind = wlif_rx_buf_forward,
                                       .indication_handler = ipc_indication_handler};

    ipc_master_init(&ipc_cb);
    // ipc wifi init
    ipc_wifi_init();

    // register event
    ls_event_init();

    // register wifi event
    ls_event_register_cb(EVENT_WIFI, EVENT_ID_ALL, _app_wifi_event_cb, NULL);

    // init shell
    // shell_init(cli_shell_process);

    // init wifi manager
#if CONFIG_WIFI_MANAGER
    do{
        vTaskDelay(pdMS_TO_TICKS(10));
    }while(!s_wifi_statck_init_done);
    /*TODO: remove this delay*/
    vTaskDelay(pdMS_TO_TICKS(1000));
#endif
}

void ls_wifi_refresh_dnsserver(const char *const dns_srv)
{
    if (DNS_MAX_SERVERS >= 2) {
        ip_addr_t dns_ip_addr;
        if (ipaddr_aton(dns_srv, &dns_ip_addr)) {
            const ip_addr_t *dns_srv = dns_getserver(DNS_MAX_SERVERS - 1);
            if (dns_srv->addr != dns_ip_addr.addr) {
                LISA_LOGD(TAG, "%dth old dns server: %s", DNS_MAX_SERVERS, ipaddr_ntoa(dns_srv));

                // set new dns server
                dns_setserver(DNS_MAX_SERVERS - 1, &dns_ip_addr);

                dns_srv = dns_getserver(DNS_MAX_SERVERS - 1);
                LISA_LOGD(TAG, "%dth new dns server: %s", DNS_MAX_SERVERS, ipaddr_ntoa(dns_srv));
            }
        }
    }
}
```
