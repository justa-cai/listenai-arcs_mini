## CMakeLists.txt
```
cmake_minimum_required(VERSION 3.19)

set(CMAKE_EXPORT_COMPILE_COMMANDS ON)

find_package(listenai-cmake REQUIRED HINTS $ENV{ARCS_BASE})

project(ap)

listenai_include_directories(
    ./
)

# 由 sample 顶层 CMake 透传：CP 镜像 flash 基地址，main.c 中做 _Static_assert
if(DEFINED EXPECTED_CP_FLASH_BASE)
    add_compile_definitions(EXPECTED_CP_FLASH_BASE=${EXPECTED_CP_FLASH_BASE}U)
else()
    message(FATAL_ERROR "缺少 EXPECTED_CP_FLASH_BASE，应由 sample 顶层 CMake 提供")
endif()

add_subdirectory(src)

listenai_add_executable(${PROJECT_NAME})
```

## prj.conf
```kconfig
CONFIG_PSRAM_HEAP_SIZE=0x40000
CONFIG_BACK_TRACE=y

CONFIG_ARCS_AP_CORE=y

CONFIG_LISA_WIFI=y
CONFIG_WIFI_LWIP_DIFF_CORE=y
CONFIG_LOG_BACKEND_IPC_WRITER=y
CONFIG_PRINTF_LOG_REDIRECT=y

# 双核WiFi要手动选择当前核心运行WIFI还是LWIP
CONFIG_WIFI=y

# 射频板型配置
CONFIG_ARCS_HAL_WCND_RF_BOARD_VER=1

CONFIG_CONSOLE_UART_NAME="uart1"

CONFIG_BLUETOOTH=y
CONFIG_BT_DIFF_CORE=y
CONFIG_LISA_BLUETOOTH=y
CONFIG_LISA_BLUETOOTH_BLE=y
CONFIG_LISA_BLUETOOTH_BLE_NETCFG=y
CONFIG_LISA_BLUETOOTH_ROLE_IPC_RECEIVER=y

CONFIG_ARCS_HAL_LOG_LEVEL_VERBOSE=y
```

## src/main.c
```c
#include "FreeRTOS.h"
#include "task.h"
#include "arcs_ap.h"
#include "memap.h"
#include "lisa_wifi.h"
#include "lisa_bluetooth.h"
#include "ble_adv_data.h"
#include "bt_app_if.h"
#define TAG "wifi_ap"
#include "lisa_log.h"

/* AP uses MEM_CP_FLASH_BASE to reset CP; it MUST equal CP prj.conf:CONFIG_MEM_FLASH_BASE.
 * Sample top-level CMake forwards CP's actual value as EXPECTED_CP_FLASH_BASE. */
_Static_assert(MEM_CP_FLASH_BASE == EXPECTED_CP_FLASH_BASE,
               "remote/memap.h: MEM_CP_FLASH_BASE mismatches CP prj.conf:CONFIG_MEM_FLASH_BASE");

static const uint8_t user_adv_data[] = {
    BLE_AD_FLAGS(GAP_AD_TYPE_FLAGS_GENERAL | GAP_AD_TYPE_FLAGS_BREDR_NOT_SUPPORTED),
    BLE_AD_COMPLETE_NAME(8, 'A', 'R', 'C', 'S', '_', 'B', 'L', 'E'),
};

const uint8_t* lisa_bt_get_adv_data(uint8_t *len)
{
    *len = sizeof(user_adv_data);
    return user_adv_data;
}

int main(int argc, char **argv)
{
#if CONFIG_ARCS_AP_CORE
    IP_CMN_SYS->REG_N300_CP_RST_ADDR.all = MEM_CP_FLASH_BASE;
    IP_SYSCTRL->REG_SW_RESET_CP0.all = 0xCAFE000A;
#endif

    lisa_wifi_init();

    lisa_bluetooth_init(NULL);

    /* WiFi connect handler is registered on CP side;
     * AP BLE netcfg will forward credentials via MRPC automatically. */

    while (1) {
        vTaskDelay(pdMS_TO_TICKS(5000));
    }
    return 0;
}
```
