## Kconfig
```
# Copyright (c) 2026, LISTENAI
# SPDX-License-Identifier: Apache-2.0

osource "$ARCS_BASE/Kconfig"

menu "Iperf-Like 测试配置"

choice IPERF_DEFAULT_MODE
	prompt "默认测试模式"
	default IPERF_MODE_UPLINK
	help
	  选择上电后的默认 iperf3 测试模式。

config IPERF_MODE_UPLINK
	bool "上行测试"

config IPERF_MODE_DOWNLINK
	bool "下行测试"

config IPERF_MODE_BIDIRECTIONAL
	bool "双向同时测试"

endchoice

config IPERF_WIFI_SSID
	string "WiFi SSID"
	default "your_wifi_ssid"
	help
	  目标 WiFi 热点名称

config IPERF_WIFI_PWD
	string "WiFi 密码"
	default "your_wifi_password"
	help
	  目标 WiFi 热点密码

config IPERF_SERVER_IP
	string "测试服务器 IP 地址"
	default "192.168.1.100"
	help
	  运行 iperf3 服务端的主机 IP 地址。
	  请按实际局域网环境填写可访问的主机地址。

config IPERF_SERVER_PORT
	int "测试服务器端口"
	default 5201
	help
	  iperf3 服务端默认监听 5201

config IPERF_ROUND_SECONDS
	int "每轮测试持续时间（秒）"
	default 10
	help
	  每轮 TCP 发流测试的持续时间

config IPERF_SEND_BLOCK_SIZE
	int "发送块大小（字节）"
	default 1460
	help
	  每次 send() 调用的数据块大小，建议与 TCP MSS 对齐

config IPERF_ROUND_INTERVAL_MS
	int "轮次间隔（毫秒）"
	default 1000
	help
	  两轮测试之间的等待时间

config IPERF_CONNECT_TIMEOUT_MS
	int "TCP 连接超时（毫秒）"
	default 5000
	help
	  TCP 连接服务器的超时时间

endmenu
```

## sample.yaml
```
tests:
  samples.network.coex.wifi_a2dp_iperf_coex:
    build_only: true
```

## prj.conf
```kconfig
CONFIG_ARCS_HAL_WARNING_DISABLE=y
CONFIG_SDK_MODULE_EASYLOGGER=n
CONFIG_LINK_OPTION_NOSYS_SPECS=y
CONFIG_BACK_TRACE=y

CONFIG_MODULE_FREERTOS=y
CONFIG_MODULE_HEAP=y

CONFIG_LOG=y
CONFIG_EASYLOGGER_ASYNC_BUF_SIZE=0x1000

CONFIG_HEAP_SIZE=0xC000
CONFIG_PSRAM_HEAP_SIZE=0x200000

CONFIG_LISA_OS=y
CONFIG_LISA_PORTING=y
CONFIG_LISA_KV=y
CONFIG_LISA_NETWORK=y
CONFIG_LISA_SHELL=y
CONFIG_LISA_SHELL_TASK_STACK_SIZE=40960
CONFIG_LISA_DEVICE=y
CONFIG_ARCS_CP_CORE=y

CONFIG_WIFI=y
CONFIG_WIFI_LWIP_SAME_CORE=y
CONFIG_LISA_WIFI=y
CONFIG_WIFI_MANAGER=y
CONFIG_LWIP=y
CONFIG_LWIP_TX_BUF_COPY=y
CONFIG_WIFI_TX_BUF_COPY=y
CONFIG_LWIP_OPTION_LWIP_DNS=y
CONFIG_LWIP_OPTION_SO_REUSE=y
CONFIG_SAL_USING_POSIX=y

CONFIG_MAC_MANAGER=y
CONFIG_MAC_MANAGER_MAC_BY_CHIP_ID=y
CONFIG_CJSON=y

CONFIG_IPERF_MODE_UPLINK=y
CONFIG_IPERF_WIFI_SSID="ssid"
CONFIG_IPERF_WIFI_PWD="password"
CONFIG_IPERF_SERVER_IP="192.168.1.100"
CONFIG_IPERF_SERVER_PORT=5201
CONFIG_IPERF_ROUND_SECONDS=10
CONFIG_IPERF_SEND_BLOCK_SIZE=1460
CONFIG_IPERF_ROUND_INTERVAL_MS=1000
CONFIG_IPERF_CONNECT_TIMEOUT_MS=5000

CONFIG_LISA_BLUETOOTH=y
CONFIG_LISA_BLUETOOTH_CLASSIC=y
CONFIG_LISA_BLUETOOTH_CLASSIC_AUDIO=y
CONFIG_LISA_BT_AUDIO_FRAMEWORK=y
CONFIG_LISA_BT_AUDIO_INTERFACE_VIRTUAL=y
CONFIG_LISA_BT_AUDIO_ADAPTER=y
CONFIG_LISA_BLUETOOTH_CLASSIC_HFP=y
CONFIG_LISA_BLUETOOTH_DEVICE_NAME="ARCS_COEX_SOURCE"

CONFIG_LISA_BLUETOOTH_WHITE_LIST_ADD=n
CONFIG_LISA_BLUETOOTH_RESOVLE_LIST_ADD=n

CONFIG_BLE_PROFILE_HOGPD=y
CONFIG_BLE_PROFILE_NETCFG_BLES=y
CONFIG_BLE_PROFILE_BASS=y

CONFIG_BT=y
CONFIG_ARCS_HAL_BT_HAL=y
CONFIG_BT_CLASSIC_ROLE_SOURCE=y
CONFIG_BT_DUAL=y

CONFIG_ARCS_HAL_AT_CMD=y
CONFIG_ARCS_HAL_LOG_LEVEL_VERBOSE=y
CONFIG_LISA_AUDIO_DEVICE=y
CONFIG_LISA_AUDIO_PLAY_ECHO_ENABLE=y
CONFIG_LISA_HWTIMER_DEVICE=y
CONFIG_LISA_HWTIMER_ARCS_DUAL_TIMER=y

CONFIG_FILE_SYSTEM=y
CONFIG_FATFS_FILESYSTEM=y
CONFIG_DISK_DRIVER=y
CONFIG_DISK_DRIVER_SDMMC=y
CONFIG_LISA_SDMMC_DEVICE=y
CONFIG_LSFS=y
CONFIG_LSFS_FAT=y
CONFIG_LSFS_REGISTER_VFS=y
CONFIG_LVFS=y
CONFIG_LVFS_POSIX_API=y

CONFIG_RINGBUF=y
```

## src/main.c
```c
/*
 * Copyright (c) 2026, LISTENAI
 *
 * SPDX-License-Identifier: Apache-2.0
 */

#define LOG_TAG "coex"
#include <lisa_log.h>

#include "FreeRTOS.h"
#include "task.h"

#include "lisa_kv.h"
#include "lisa_shell.h"

#include "coex_bt.h"
#include "coex_bt_audio.h"
#include "coex_iperf.h"
#include "coex_shell.h"
#include "coex_wifi.h"
#include "fs/user_fs.h"

int main(int argc, char **argv)
{
    int ret;

    (void)argc;
    (void)argv;

    LOGI("WiFi+A2DP iperf coex sample booting");

    ret = lisa_shell_init();
    if (ret != 0) {
        LOGI("shell init failed: %d", ret);
    }

    ret = user_fs_init();
    if (ret != 0) {
        LOGW("user fs init failed: %d", ret);
    }

    ret = lisa_kv_init();
    if (ret != 0) {
        LOGW("kv init failed: %d", ret);
    }

    ret = coex_wifi_init();
    if (ret != 0) {
        LOGE("coex wifi init failed: %d", ret);
    }

    ret = coex_iperf_init();
    if (ret != 0) {
        LOGE("coex iperf init failed: %d", ret);
    }

    ret = coex_bt_init();
    if (ret != 0) {
        LOGE("coex bt init failed: %d", ret);
    }

    ret = coex_bt_audio_init();
    if (ret != 0) {
        LOGE("coex bt audio init failed: %d", ret);
    }

    ret = coex_shell_register();
    if (ret != 0) {
        LOGE("coex shell register failed: %d", ret);
    }

    while (1) {
        vTaskDelay(pdMS_TO_TICKS(1000));
    }

    return 0;
}
```

## src/coex_app.h
```c
/*
 * Copyright (c) 2026, LISTENAI
 *
 * SPDX-License-Identifier: Apache-2.0
 */

#pragma once

#include "autoconf.h"
#include "coex_result.h"

#define COEX_TARGET_WIFI_SSID CONFIG_IPERF_WIFI_SSID
#define COEX_TARGET_WIFI_PWD  CONFIG_IPERF_WIFI_PWD

#define COEX_SERVER_IP          CONFIG_IPERF_SERVER_IP
#define COEX_SERVER_PORT        CONFIG_IPERF_SERVER_PORT
#define COEX_ROUND_SECONDS      CONFIG_IPERF_ROUND_SECONDS
#define COEX_SEND_BLOCK_SIZE    CONFIG_IPERF_SEND_BLOCK_SIZE
#define COEX_ROUND_INTERVAL_MS  CONFIG_IPERF_ROUND_INTERVAL_MS
#define COEX_CONNECT_TIMEOUT_MS CONFIG_IPERF_CONNECT_TIMEOUT_MS

#if defined(CONFIG_IPERF_MODE_UPLINK)
#define COEX_DEFAULT_MODE COEX_MODE_UPLINK
#elif defined(CONFIG_IPERF_MODE_DOWNLINK)
#define COEX_DEFAULT_MODE COEX_MODE_DOWNLINK
#else
#define COEX_DEFAULT_MODE COEX_MODE_BIDIRECTIONAL
#endif

#define COEX_PLACEHOLDER_WIFI_SSID "your_wifi_ssid"
#define COEX_PLACEHOLDER_WIFI_PWD  "your_wifi_password"
#define COEX_PLACEHOLDER_SERVER_IP "192.168.1.100"
```

## src/coex_bt.c
```c
/*
 * Copyright (c) 2026, LISTENAI
 *
 * SPDX-License-Identifier: Apache-2.0
 */

#include <stdio.h>
#include <string.h>

#define LOG_TAG "coex.bt"
#include <lisa_log.h>

#include "FreeRTOS.h"
#include "task.h"

#include "lisa_bluetooth.h"

#include "coex_bt.h"

static coex_bt_status_t g_coex_bt_status;

static void coex_bt_format_addr(const gap_bdaddr_t *peer_addr, char out[COEX_BT_ADDR_STR_LEN])
{
    if (peer_addr == NULL || out == NULL) {
        return;
    }

    (void)snprintf(out, COEX_BT_ADDR_STR_LEN,
                   "%02X:%02X:%02X:%02X:%02X:%02X",
                   peer_addr->addr[0], peer_addr->addr[1], peer_addr->addr[2],
                   peer_addr->addr[3], peer_addr->addr[4], peer_addr->addr[5]);
}

static void coex_bt_discovery_ind(const lisa_bt_discovery_info_t *info)
{
    const lisa_bt_discovery_info_t *list;
    uint8_t count = 0;

    if (info != NULL) {
        LOGI("discovered device: %02X:%02X:%02X:%02X:%02X:%02X RSSI=%d Name=%.*s",
             info->addr.addr[0], info->addr.addr[1], info->addr.addr[2],
             info->addr.addr[3], info->addr.addr[4], info->addr.addr[5],
             info->rssi,
             info->name_len, info->name);
    }

    if (lisa_bluetooth_get_discovered_devices(&list, &count) == 0) {
        (void)list;
        g_coex_bt_status.discovered_count = count;
    }
}

static void coex_bt_conn_cb(uint8_t conidx, uint16_t conhdl, const gap_bdaddr_t *peer_addr)
{
    (void)conidx;
    (void)conhdl;

    g_coex_bt_status.connected = true;
    coex_bt_format_addr(peer_addr, g_coex_bt_status.peer_addr);
    LOGI("bt classic connected: %s", g_coex_bt_status.peer_addr);
}

static void coex_bt_disc_cb(uint8_t conidx, uint16_t conhdl, uint16_t reason)
{
    (void)conidx;
    (void)conhdl;

    g_coex_bt_status.connected = false;
    g_coex_bt_status.a2dp_connected = false;
    g_coex_bt_status.peer_addr[0] = '\0';
    LOGI("bt classic disconnected, reason=%u", reason);
}

static void coex_bt_profile_cb(uint8_t conidx, int profile, bool connected)
{
    (void)conidx;

    if (profile == LISA_BT_PROFILE_A2DP) {
        g_coex_bt_status.a2dp_connected = connected;
        LOGI("a2dp profile %s", connected ? "connected" : "disconnected");
    }
}

int coex_bt_init(void)
{
    int ret;

    if (g_coex_bt_status.initialized) {
        return 0;
    }

    ret = lisa_bluetooth_init(NULL);
    if (ret != 0) {
        LOGE("lisa_bluetooth_init failed: %d", ret);
        return ret;
    }

    vTaskDelay(pdMS_TO_TICKS(50));
    lisa_bluetooth_register_discovery_callback(coex_bt_discovery_ind);
    lisa_bt_classic_register_conn_cb(coex_bt_conn_cb);
    lisa_bt_classic_register_disc_cb(coex_bt_disc_cb);
    lisa_bt_classic_register_profile_cb(coex_bt_profile_cb);

    g_coex_bt_status.initialized = true;
    g_coex_bt_status.discovery_registered = true;
    LOGI("bt classic init done");
    return 0;
}

int coex_bt_open(void)
{
    int ret;

    if (!g_coex_bt_status.initialized) {
        ret = coex_bt_init();
        if (ret != 0) {
            return ret;
        }
    }

    ret = lisa_bluetooth_open();
    g_coex_bt_status.opened = lisa_bluetooth_is_opened();
    LOGI("bt open ret=%d opened=%d", ret, g_coex_bt_status.opened);
    return ret;
}

int coex_bt_close(void)
{
    int ret;

    g_coex_bt_status.discovered_count = 0;
    g_coex_bt_status.connected = false;
    g_coex_bt_status.a2dp_connected = false;
    g_coex_bt_status.peer_addr[0] = '\0';

    ret = lisa_bluetooth_close();
    g_coex_bt_status.opened = lisa_bluetooth_is_opened();
    LOGI("bt close ret=%d opened=%d", ret, g_coex_bt_status.opened);
    return ret;
}

int coex_bt_inquiry(void)
{
    lisa_bluetooth_clear_discovered_devices();
    g_coex_bt_status.discovered_count = 0;
    return lisa_bluetooth_inquiry_start(GAPM_DISC_TYPE_GEN_DISC, MAX_DISCOVERED_DEVICES);
}

int coex_bt_connect_by_name(const char *name)
{
    if (name == NULL) {
        return -1;
    }
    return lisa_bluetooth_connect_by_name(name);
}

int coex_bt_connect_by_index(uint8_t index)
{
    return lisa_bluetooth_connect_by_index(index);
}

bool coex_bt_is_connected(void)
{
    return g_coex_bt_status.connected;
}

bool coex_bt_is_a2dp_connected(void)
{
    return g_coex_bt_status.a2dp_connected;
}

void coex_bt_get_status(coex_bt_status_t *status)
{
    const lisa_bt_discovery_info_t *list;
    uint8_t count = 0;

    if (status == NULL) {
        return;
    }

    if (lisa_bluetooth_get_discovered_devices(&list, &count) == 0) {
        (void)list;
        g_coex_bt_status.discovered_count = count;
    }

    g_coex_bt_status.opened = lisa_bluetooth_is_opened();

    *status = g_coex_bt_status;
}
```

## src/coex_bt.h
```c
/*
 * Copyright (c) 2026, LISTENAI
 *
 * SPDX-License-Identifier: Apache-2.0
 */

#ifndef COEX_BT_H
#define COEX_BT_H

#include <stdbool.h>
#include <stdint.h>

#define COEX_BT_ADDR_STR_LEN 18

typedef struct {
    bool initialized;
    bool opened;
    bool discovery_registered;
    bool connected;
    bool a2dp_connected;
    uint8_t discovered_count;
    char peer_addr[COEX_BT_ADDR_STR_LEN];
} coex_bt_status_t;

int coex_bt_init(void);
int coex_bt_open(void);
int coex_bt_close(void);
int coex_bt_inquiry(void);
int coex_bt_connect_by_name(const char *name);
int coex_bt_connect_by_index(uint8_t index);
bool coex_bt_is_connected(void);
bool coex_bt_is_a2dp_connected(void);
void coex_bt_get_status(coex_bt_status_t *status);

#endif /* COEX_BT_H */
```

## src/coex_bt_audio.c
```c
/*
 * Copyright (c) 2026, LISTENAI
 *
 * SPDX-License-Identifier: Apache-2.0
 */

#include <stdbool.h>
#include <stddef.h>
#include <stdint.h>

#define LOG_TAG "coex.bt.audio"
#include <lisa_log.h>

#include "FreeRTOS.h"
#include "task.h"

#include "bt_audio_interface_virtual.h"

#include "audio_pcm.h"
#include "coex_bt.h"
#include "coex_bt_audio.h"

#define COEX_USE_PCM_ENCODE_MODE 1
#define COEX_SAMPLE_RATE 44100
#define COEX_CHANNELS 2
#define COEX_BITS_PER_SAMPLE 16
#define COEX_PCM_FRAME_SIZE (COEX_SAMPLE_RATE / 100 * COEX_CHANNELS * (COEX_BITS_PER_SAMPLE / 8))

extern bt_audio_error_t bt_vintf_init(void);
extern bt_audio_error_t bt_vintf_set_encode_mode(bool encode_pcm);

static TaskHandle_t g_audio_task_handle;
static volatile bool g_audio_running;
static volatile bool g_audio_task_exit;
static coex_bt_audio_status_t g_audio_status = {
    .volume = 50,
};

static void coex_audio_source_task(void *arg)
{
    size_t offset = 0;

    (void)arg;

    LOGI("audio source task started (PCM encode mode)");
    while (g_audio_running) {
        if ((offset + COEX_PCM_FRAME_SIZE) >= audio_pcm_len) {
            offset = 0;
        }

        int ret = vintf_playback_write(&audio_pcm[offset], COEX_PCM_FRAME_SIZE);
        if (ret < 0) {
            LOGE("vintf_playback_write failed: %d", ret);
            break;
        }
        offset += COEX_PCM_FRAME_SIZE;
    }

    g_audio_task_exit = true;
    g_audio_task_handle = NULL;
    g_audio_running = false;
    g_audio_status.streaming = false;
    LOGI("audio source task stopped");
    vTaskDelete(NULL);
}

static void coex_audio_open_complete(bt_audio_format_t format)
{
    (void)format;

    if (xTaskCreate(coex_audio_source_task, "coex_audio", 4096, NULL, 8, &g_audio_task_handle) != pdPASS) {
        LOGE("failed to create coex audio task");
        (void)vintf_profile_close();
        g_audio_status.profile_open = false;
        return;
    }

    g_audio_running = true;
    g_audio_task_exit = false;
    g_audio_status.profile_open = true;
    g_audio_status.streaming = true;
    LOGI("bt audio stream started");
}

int coex_bt_audio_init(void)
{
    bt_audio_error_t ret;

    if (g_audio_status.initialized) {
        return 0;
    }

    ret = bt_vintf_init();
    if (ret != BT_AUDIO_OK) {
        LOGE("bt_vintf_init failed: %d", ret);
        return -1;
    }

    g_audio_status.initialized = true;
    LOGI("bt audio virtual interface initialized");
    return 0;
}

int coex_bt_audio_start(void)
{
    vintf_open_info_t info = {
        .type = VINTF_PROFILE_PLAYBACK,
        .open_complete_callback = coex_audio_open_complete,
        .audio_data_callback = NULL,
        .user_data = NULL,
    };
    bt_audio_error_t ret;

    if (!coex_bt_is_a2dp_connected()) {
        LOGW("a2dp is not connected, run bt_connect first");
        return -1;
    }

    if (g_audio_running || g_audio_status.profile_open) {
        LOGW("audio already running or opening");
        return 0;
    }

#if COEX_USE_PCM_ENCODE_MODE
    ret = bt_vintf_set_encode_mode(true);
#else
    ret = bt_vintf_set_encode_mode(false);
#endif
    if (ret != BT_AUDIO_OK) {
        LOGE("bt_vintf_set_encode_mode failed: %d", ret);
        return -1;
    }

    ret = vintf_profile_open(&info);
    if (ret != BT_AUDIO_OK) {
        LOGE("vintf_profile_open failed: %d", ret);
        return -1;
    }

    g_audio_status.profile_open = true;
    LOGI("bt audio open requested");
    return 0;
}

int coex_bt_audio_stop(void)
{
    if (!g_audio_running && !g_audio_status.profile_open) {
        LOGI("audio stream is not running");
        return 0;
    }

    g_audio_running = false;
    for (int i = 0; i < 50 && !g_audio_task_exit && g_audio_task_handle != NULL; i++) {
        vTaskDelay(pdMS_TO_TICKS(50));
    }

    (void)vintf_profile_close();
    g_audio_status.profile_open = false;
    g_audio_status.streaming = false;
    LOGI("bt audio stream stopped");
    return 0;
}

int coex_bt_audio_set_volume(uint8_t volume)
{
    bt_audio_error_t ret;

    if (volume > 100) {
        return -1;
    }

    ret = vintf_set_volume(volume);
    if (ret != BT_AUDIO_OK) {
        LOGE("vintf_set_volume failed: %d", ret);
        return -1;
    }

    g_audio_status.volume = volume;
    LOGI("bt audio volume set to %u", volume);
    return 0;
}

void coex_bt_audio_get_status(coex_bt_audio_status_t *status)
{
    if (status == NULL) {
        return;
    }

    *status = g_audio_status;
}
```

## src/coex_bt_audio.h
```c
/*
 * Copyright (c) 2026, LISTENAI
 *
 * SPDX-License-Identifier: Apache-2.0
 */

#ifndef COEX_BT_AUDIO_H
#define COEX_BT_AUDIO_H

#include <stdbool.h>
#include <stdint.h>

typedef struct {
    bool initialized;
    bool profile_open;
    bool streaming;
    uint8_t volume;
} coex_bt_audio_status_t;

int coex_bt_audio_init(void);
int coex_bt_audio_start(void);
int coex_bt_audio_stop(void);
int coex_bt_audio_set_volume(uint8_t volume);
void coex_bt_audio_get_status(coex_bt_audio_status_t *status);

#endif /* COEX_BT_AUDIO_H */
```

## src/coex_iperf.h
```c
/*
 * Copyright (c) 2026, LISTENAI
 *
 * SPDX-License-Identifier: Apache-2.0
 */

#pragma once

#include <stdbool.h>
#include <stddef.h>
#include <stdint.h>

#include "coex_result.h"

#ifdef __cplusplus
extern "C" {
#endif

typedef enum {
    COEX_IPERF_STATE_INIT = 0,
    COEX_IPERF_STATE_WAIT_NETWORK,
    COEX_IPERF_STATE_RUNNING,
    COEX_IPERF_STATE_STOPPED,
} coex_iperf_state_t;

typedef struct {
    bool initialized;
    bool enabled;
    coex_iperf_state_t state;
    coex_mode_t current_mode;
    coex_mode_t pending_mode;
    uint32_t round_id;
    coex_round_result_t last_result;
} coex_iperf_status_t;

int coex_iperf_init(void);
void coex_iperf_set_enabled(bool enabled);
bool coex_iperf_is_enabled(void);
void coex_iperf_set_mode(coex_mode_t mode);
coex_mode_t coex_iperf_get_mode(void);
int coex_iperf_set_server(const char *ip, int port);
void coex_iperf_get_server(char *ip, size_t ip_len, int *port);
void coex_iperf_get_status(coex_iperf_status_t *status);
const char *coex_iperf_state_str(coex_iperf_state_t state);

int coex_runner_iperf3_run(coex_mode_t mode,
                           volatile bool *enabled,
                           coex_round_result_t *result);
void coex_runner_iperf3_abort(void);

#ifdef __cplusplus
}
#endif
```

## src/coex_result.c
```c
/*
 * Copyright (c) 2026, LISTENAI
 *
 * SPDX-License-Identifier: Apache-2.0
 */

#include "coex_result.h"

#include <stddef.h>
#include <string.h>

const char *coex_mode_str(coex_mode_t mode)
{
    switch (mode) {
    case COEX_MODE_UPLINK:
        return "uplink";
    case COEX_MODE_DOWNLINK:
        return "downlink";
    case COEX_MODE_BIDIRECTIONAL:
        return "bidirectional";
    default:
        return "unknown";
    }
}

int coex_mode_parse(const char *text, coex_mode_t *mode)
{
    if (text == NULL || mode == NULL) {
        return -1;
    }

    if (strcmp(text, "uplink") == 0) {
        *mode = COEX_MODE_UPLINK;
        return 0;
    }
    if (strcmp(text, "downlink") == 0) {
        *mode = COEX_MODE_DOWNLINK;
        return 0;
    }
    if (strcmp(text, "bidirectional") == 0) {
        *mode = COEX_MODE_BIDIRECTIONAL;
        return 0;
    }

    return -1;
}

const char *coex_stop_reason_str(coex_stop_reason_t reason)
{
    switch (reason) {
    case COEX_STOP_REASON_NONE:
        return "none";
    case COEX_STOP_REASON_COMPLETE:
        return "complete";
    case COEX_STOP_REASON_NETWORK_LOST:
        return "network_lost";
    case COEX_STOP_REASON_CONNECT_FAIL:
        return "connect_fail";
    case COEX_STOP_REASON_SEND_FAIL:
        return "send_fail";
    case COEX_STOP_REASON_RECV_FAIL:
        return "recv_fail";
    case COEX_STOP_REASON_USER_STOP:
        return "user_stop";
    default:
        return "unknown";
    }
}

uint64_t coex_result_throughput_bps(const coex_round_result_t *result)
{
    return coex_result_tx_throughput_bps(result);
}

uint64_t coex_result_tx_throughput_bps(const coex_round_result_t *result)
{
    if (result == NULL || result->duration_ms == 0) {
        return 0;
    }

    return (result->bytes_sent * 8ULL * 1000ULL) / result->duration_ms;
}

uint64_t coex_result_rx_throughput_bps(const coex_round_result_t *result)
{
    if (result == NULL || result->duration_ms == 0) {
        return 0;
    }

    return (result->bytes_received * 8ULL * 1000ULL) / result->duration_ms;
}
```

## src/coex_result.h
```c
/*
 * Copyright (c) 2026, LISTENAI
 *
 * SPDX-License-Identifier: Apache-2.0
 */

#pragma once

#include <stdint.h>

#ifdef __cplusplus
extern "C" {
#endif

typedef enum {
    COEX_MODE_UPLINK = 0,
    COEX_MODE_DOWNLINK,
    COEX_MODE_BIDIRECTIONAL,
} coex_mode_t;

typedef enum {
    COEX_STOP_REASON_NONE = 0,
    COEX_STOP_REASON_COMPLETE,
    COEX_STOP_REASON_NETWORK_LOST,
    COEX_STOP_REASON_CONNECT_FAIL,
    COEX_STOP_REASON_SEND_FAIL,
    COEX_STOP_REASON_RECV_FAIL,
    COEX_STOP_REASON_USER_STOP,
} coex_stop_reason_t;

typedef struct {
    coex_mode_t mode;
    uint64_t bytes_sent;
    uint64_t bytes_received;
    uint32_t duration_ms;
    uint32_t error_count;
    coex_stop_reason_t stop_reason;
} coex_round_result_t;

const char *coex_mode_str(coex_mode_t mode);
int coex_mode_parse(const char *text, coex_mode_t *mode);
const char *coex_stop_reason_str(coex_stop_reason_t reason);
uint64_t coex_result_throughput_bps(const coex_round_result_t *result);
uint64_t coex_result_tx_throughput_bps(const coex_round_result_t *result);
uint64_t coex_result_rx_throughput_bps(const coex_round_result_t *result);

#ifdef __cplusplus
}
#endif
```

## src/coex_shell.c
```c
/*
 * Copyright (c) 2026, LISTENAI
 *
 * SPDX-License-Identifier: Apache-2.0
 */

#include <stdbool.h>
#include <stdint.h>
#include <stdio.h>
#include <stdlib.h>
#include <string.h>
#include <errno.h>
#include <limits.h>

#include "FreeRTOS.h"
#include "task.h"

#include "lisa_mem.h"
#include "shell.h"

#include "ls_wf_coex.h"

#include "coex_app.h"
#include "coex_bt.h"
#include "coex_bt_audio.h"
#include "coex_iperf.h"
#include "coex_shell.h"
#include "coex_wifi.h"

static void coex_shell_print_ip(Shell *shell, uint32_t ip)
{
    shellPrint(shell, "%u.%u.%u.%u",
               ip & 0xff,
               (ip >> 8) & 0xff,
               (ip >> 16) & 0xff,
               (ip >> 24) & 0xff);
}

static void coex_shell_print_wifi_status(Shell *shell)
{
    coex_wifi_status_t status;

    coex_wifi_get_status(&status);
    shellPrint(shell, "initialized: %s\n", status.initialized ? "yes" : "no");
    shellPrint(shell, "stack_ready: %s\n", status.stack_ready ? "yes" : "no");
    shellPrint(shell, "connecting: %s\n", status.connecting ? "yes" : "no");
    shellPrint(shell, "connected: %s\n", status.connected ? "yes" : "no");
    shellPrint(shell, "dhcp_ready: %s\n", status.ready ? "yes" : "no");
    shellPrint(shell, "ip: ");
    coex_shell_print_ip(shell, status.ip_addr);
    shellPrint(shell, "\n");
}

static void coex_shell_print_iperf_status(Shell *shell)
{
    coex_iperf_status_t status;
    char server_ip[16];
    int server_port;
    uint64_t tx_bps;
    uint64_t rx_bps;

    coex_iperf_get_status(&status);
    coex_iperf_get_server(server_ip, sizeof(server_ip), &server_port);
    tx_bps = coex_result_tx_throughput_bps(&status.last_result);
    rx_bps = coex_result_rx_throughput_bps(&status.last_result);

    shellPrint(shell, "initialized: %s\n", status.initialized ? "yes" : "no");
    shellPrint(shell, "enabled: %s\n", status.enabled ? "yes" : "no");
    shellPrint(shell, "state: %s\n", coex_iperf_state_str(status.state));
    shellPrint(shell, "current_test_mode: %s\n", coex_mode_str(status.current_mode));
    shellPrint(shell, "pending_test_mode: %s\n", coex_mode_str(status.pending_mode));
    shellPrint(shell, "server: %s:%d\n", server_ip, server_port);
    shellPrint(shell, "round_seconds: %d\n", COEX_ROUND_SECONDS);
    shellPrint(shell, "send_block_size: %d\n", COEX_SEND_BLOCK_SIZE);
    shellPrint(shell, "round_id: %u\n", status.round_id);
    shellPrint(shell, "last_bytes_sent: %llu\n", status.last_result.bytes_sent);
    shellPrint(shell, "last_bytes_received: %llu\n", status.last_result.bytes_received);
    shellPrint(shell, "last_duration_ms: %u\n", status.last_result.duration_ms);
    shellPrint(shell, "last_error_count: %u\n", status.last_result.error_count);
    shellPrint(shell, "last_stop_reason: %s\n", coex_stop_reason_str(status.last_result.stop_reason));
    shellPrint(shell, "last_tx_throughput_bps: %llu\n", tx_bps);
    shellPrint(shell, "last_rx_throughput_bps: %llu\n", rx_bps);
}

static void coex_shell_print_bt_status(Shell *shell)
{
    coex_bt_status_t bt_status;
    coex_bt_audio_status_t audio_status;

    coex_bt_get_status(&bt_status);
    coex_bt_audio_get_status(&audio_status);

    shellPrint(shell, "initialized: %s\n", bt_status.initialized ? "yes" : "no");
    shellPrint(shell, "opened: %s\n", bt_status.opened ? "yes" : "no");
    shellPrint(shell, "discovery_registered: %s\n", bt_status.discovery_registered ? "yes" : "no");
    shellPrint(shell, "discovered_devices: %u\n", bt_status.discovered_count);
    shellPrint(shell, "acl_connected: %s\n", bt_status.connected ? "yes" : "no");
    shellPrint(shell, "a2dp_connected: %s\n", bt_status.a2dp_connected ? "yes" : "no");
    shellPrint(shell, "peer_addr: %s\n", bt_status.peer_addr[0] ? bt_status.peer_addr : "n/a");
    shellPrint(shell, "audio_initialized: %s\n", audio_status.initialized ? "yes" : "no");
    shellPrint(shell, "audio_profile_open: %s\n", audio_status.profile_open ? "yes" : "no");
    shellPrint(shell, "audio_streaming: %s\n", audio_status.streaming ? "yes" : "no");
    shellPrint(shell, "audio_volume: %u\n", audio_status.volume);
}

static int coex_shell_parse_uint(const char *arg, unsigned int *value)
{
    char *end = NULL;
    unsigned long parsed;

    if (arg == NULL || value == NULL) {
        return -1;
    }

    errno = 0;
    parsed = strtoul(arg, &end, 0);
    if (errno != 0 || end == arg || *end != '\0' || parsed > UINT_MAX) {
        return -1;
    }

    *value = (unsigned int)parsed;
    return 0;
}

static int cmd_wifi(int argc, char **argv)
{
    Shell *shell = shellGetCurrent();

    if (argc < 2) {
        shellPrint(shell, "Usage: wifi <connect [ssid pwd]|disconnect|status|help>\n");
        return -1;
    }

    if (strcmp(argv[1], "connect") == 0) {
        int ret;

        if (argc == 2) {
            ret = coex_wifi_connect();
        } else if (argc == 4) {
            ret = coex_wifi_connect_to(argv[2], argv[3]);
        } else {
            shellPrint(shell, "Usage: wifi connect [ssid pwd]\n");
            return -1;
        }

        shellPrint(shell, "wifi connect ret=%d\n", ret);
        return ret;
    }

    if (strcmp(argv[1], "disconnect") == 0) {
        int ret = coex_wifi_disconnect();
        shellPrint(shell, "wifi disconnect ret=%d\n", ret);
        return ret;
    }

    if (strcmp(argv[1], "status") == 0) {
        coex_shell_print_wifi_status(shell);
        return 0;
    }

    shellPrint(shell, "Usage: wifi <connect [ssid pwd]|disconnect|status|help>\n");
    return -1;
}

static int cmd_iperf(int argc, char **argv)
{
    Shell *shell = shellGetCurrent();
    const char *subcmd;
    int arg_base = 0;

    if (argc < 1) {
        shellPrint(shell, "Usage: iperf <start|stop|status|mode|server|help>\n");
        return -1;
    }

    subcmd = argv[0];
    if (strcmp(subcmd, "iperf") == 0) {
        if (argc < 2) {
            shellPrint(shell, "Usage: iperf <start|stop|status|mode|server|help>\n");
            return -1;
        }
        subcmd = argv[1];
        arg_base = 1;
    }

    if (strcmp(subcmd, "start") == 0) {
        coex_iperf_set_enabled(true);
        shellPrint(shell, "iperf loop enabled\n");
        if (!coex_wifi_is_ready()) {
            shellPrint(shell, "wifi not ready, run 'wifi connect' first\n");
        }
        return 0;
    }

    if (strcmp(subcmd, "stop") == 0) {
        coex_iperf_set_enabled(false);
        shellPrint(shell, "iperf loop disabled\n");
        return 0;
    }

    if (strcmp(subcmd, "status") == 0) {
        coex_shell_print_iperf_status(shell);
        return 0;
    }

    if (strcmp(subcmd, "server") == 0) {
        char server_ip[16];
        int server_port;
        int server_index = arg_base + 1;

        coex_iperf_get_server(server_ip, sizeof(server_ip), &server_port);
        if (argc <= server_index) {
            shellPrint(shell, "current server: %s:%d\n", server_ip, server_port);
            shellPrint(shell, "set server: iperf server <ip> [port]\n");
            return 0;
        }

        if (argc > server_index + 2) {
            shellPrint(shell, "Usage: iperf server <ip> [port]\n");
            return -1;
        }

        if (argc > server_index + 1) {
            unsigned int parsed_port;

            if (coex_shell_parse_uint(argv[server_index + 1], &parsed_port) != 0 ||
                parsed_port == 0 || parsed_port > 65535U) {
                shellPrint(shell, "Invalid port: %s\n", argv[server_index + 1]);
                return -1;
            }
            server_port = (int)parsed_port;
        }

        int ret = coex_iperf_set_server(argv[server_index], server_port);
        if (ret == -EBUSY) {
            shellPrint(shell, "iperf is running, run 'iperf stop' before changing server\n");
        }
        shellPrint(shell, "iperf server set ret=%d ip=%s port=%d\n", ret, argv[server_index], server_port);
        return ret;
    }

    if (strcmp(subcmd, "mode") == 0) {
        coex_mode_t mode;
        int mode_index = arg_base + 1;

        if (argc <= mode_index) {
            shellPrint(shell, "current mode: %s\n", coex_mode_str(coex_iperf_get_mode()));
            shellPrint(shell, "set mode: iperf mode uplink|downlink|bidirectional\n");
            return 0;
        }

        if (coex_mode_parse(argv[mode_index], &mode) != 0) {
            shellPrint(shell, "Unknown mode: %s\n", argv[mode_index]);
            shellPrint(shell, "Usage: iperf mode uplink|downlink|bidirectional\n");
            return -1;
        }

        coex_iperf_set_mode(mode);
        shellPrint(shell, "iperf mode %s will apply on next round\n", coex_mode_str(mode));
        return 0;
    }

    shellPrint(shell, "Usage: iperf <start|stop|status|mode|server|help>\n");
    return -1;
}

static int cmd_bt_inquiry_shell(int argc, char **argv)
{
    (void)argc;
    (void)argv;
    return coex_bt_inquiry();
}

static int cmd_bt_open_shell(int argc, char **argv)
{
    (void)argc;
    (void)argv;
    return coex_bt_open();
}

static int cmd_bt_close_shell(int argc, char **argv)
{
    (void)argc;
    (void)argv;
    (void)coex_bt_audio_stop();
    return coex_bt_close();
}

static int cmd_bt_connect_shell(int argc, char **argv)
{
    if (argc < 2) {
        return -1;
    }
    return coex_bt_connect_by_name(argv[1]);
}

static int cmd_bt_connect_index_shell(int argc, char **argv)
{
    if (argc < 2) {
        return -1;
    }
    return coex_bt_connect_by_index((uint8_t)atoi(argv[1]));
}

static int cmd_bt_audio_start_shell(int argc, char **argv)
{
    (void)argc;
    (void)argv;
    return coex_bt_audio_start();
}

static int cmd_bt_audio_stop_shell(int argc, char **argv)
{
    (void)argc;
    (void)argv;
    return coex_bt_audio_stop();
}

static int cmd_bt_audio_volume_shell(int argc, char **argv)
{
    if (argc < 2) {
        return -1;
    }
    return coex_bt_audio_set_volume((uint8_t)atoi(argv[1]));
}

static int cmd_coex_slot_time_shell(int argc, char **argv)
{
    Shell *shell = shellGetCurrent();
    unsigned int coex_period_us;
    unsigned int wifi_time_us;
    int ret;

    if (argc < 3) {
        shellPrint(shell, "Usage: coex_slot_time <coex_period_us> <wifi_time_us>\n");
        return -1;
    }

    if (coex_shell_parse_uint(argv[1], &coex_period_us) != 0 ||
        coex_shell_parse_uint(argv[2], &wifi_time_us) != 0) {
        shellPrint(shell, "Invalid argument\n");
        shellPrint(shell, "Usage: coex_slot_time <coex_period_us> <wifi_time_us>\n");
        return -1;
    }

    ret = coex_win_slot_time_set(coex_period_us, wifi_time_us);
    shellPrint(shell, "coex_slot_time ret=%d, coex_period_us=%u, wifi_time_us=%u\n",
               ret, coex_period_us, wifi_time_us);
    return ret;
}

static int cmd_coex(int argc, char **argv)
{
    Shell *shell = shellGetCurrent();

    if (argc < 2 || strcmp(argv[1], "status") != 0) {
        shellPrint(shell, "Usage: coex status\n");
        return -1;
    }

    shellPrint(shell, "[wifi]\n");
    coex_shell_print_wifi_status(shell);
    shellPrint(shell, "[iperf]\n");
    coex_shell_print_iperf_status(shell);
    shellPrint(shell, "[bt]\n");
    coex_shell_print_bt_status(shell);
    return 0;
}

static int threads_cmd(int argc, char **argv)
{
    (void)argc;
    (void)argv;

    Shell *shell = shellGetCurrent();
    uint32_t tasks = uxTaskGetNumberOfTasks();
    TaskStatus_t *item = lisa_mem_alloc(tasks * sizeof(TaskStatus_t));

    if (item) {
        uint32_t total = 0;

        tasks = uxTaskGetSystemState(item, tasks, &total);
        if (total > 0) {
            shellPrint(shell, "\n---------------------------------------------------------------------------------------------\n");
            shellPrint(shell, "Name                      State  Prio  Stack  MinFree    MaxUsed    Tid    Call100US      PCT\n");
            shellPrint(shell, "---------------------------------------------------------------------------------------------\n");
            for (uint32_t i = 0, pct = 0; i < tasks; i++) {
                uint32_t stack_size = (item[i].pxEndOfStack - item[i].pxStackBase + 2) * sizeof(StackType_t);
                uint32_t min_free = item[i].usStackHighWaterMark * sizeof(StackType_t);
                float max_used_pct = 100.0f - (float)min_free / (float)stack_size * 100.0f;

                if ((pct = (uint32_t)(100.0f * item[i].ulRunTimeCounter / total))) {
                    shellPrint(shell, "%-25s %-6c %-6u %-6u %-10u %-10.1f %-6u %-12u %5u%%\n",
                               item[i].pcTaskName,
                               "XRBSD"[item[i].eCurrentState],
                               item[i].uxCurrentPriority,
                               stack_size,
                               min_free,
                               max_used_pct,
                               item[i].xTaskNumber,
                               item[i].ulRunTimeCounter,
                               pct);
                } else {
                    shellPrint(shell, "%-25s %-6c %-6u %-6u %-10u %-10.1f %-6u %-12u %5s%%\n",
                               item[i].pcTaskName,
                               "XRBSD"[item[i].eCurrentState],
                               item[i].uxCurrentPriority,
                               stack_size,
                               min_free,
                               max_used_pct,
                               item[i].xTaskNumber,
                               item[i].ulRunTimeCounter,
                               "<1");
                }
            }
            shellPrint(shell, "---------------------------------------------------------------------------------------------\n\n");
        }
        lisa_mem_free(item);
    }

    return 0;
}

int coex_shell_register(void)
{
    return 0;
}

SHELL_EXPORT_CMD(SHELL_CMD_PERMISSION(0) | SHELL_CMD_TYPE(SHELL_TYPE_CMD_MAIN), wifi, cmd_wifi, wifi controls);
SHELL_EXPORT_CMD(SHELL_CMD_PERMISSION(0) | SHELL_CMD_TYPE(SHELL_TYPE_CMD_MAIN), iperf, cmd_iperf, iperf controls);
SHELL_EXPORT_CMD(SHELL_CMD_PERMISSION(0) | SHELL_CMD_TYPE(SHELL_TYPE_CMD_MAIN), bt_open, cmd_bt_open_shell, open bt stack);
SHELL_EXPORT_CMD(SHELL_CMD_PERMISSION(0) | SHELL_CMD_TYPE(SHELL_TYPE_CMD_MAIN), bt_close, cmd_bt_close_shell, close bt stack);
SHELL_EXPORT_CMD(SHELL_CMD_PERMISSION(0) | SHELL_CMD_TYPE(SHELL_TYPE_CMD_MAIN), bt_inquiry, cmd_bt_inquiry_shell, bt inquiry);
SHELL_EXPORT_CMD(SHELL_CMD_PERMISSION(0) | SHELL_CMD_TYPE(SHELL_TYPE_CMD_MAIN), bt_connect, cmd_bt_connect_shell, bt connect by name);
SHELL_EXPORT_CMD(SHELL_CMD_PERMISSION(0) | SHELL_CMD_TYPE(SHELL_TYPE_CMD_MAIN), bt_connect_index, cmd_bt_connect_index_shell, bt connect by index);
SHELL_EXPORT_CMD(SHELL_CMD_PERMISSION(0) | SHELL_CMD_TYPE(SHELL_TYPE_CMD_MAIN), bt_audio_start, cmd_bt_audio_start_shell, start bt audio);
SHELL_EXPORT_CMD(SHELL_CMD_PERMISSION(0) | SHELL_CMD_TYPE(SHELL_TYPE_CMD_MAIN), bt_audio_stop, cmd_bt_audio_stop_shell, stop bt audio);
SHELL_EXPORT_CMD(SHELL_CMD_PERMISSION(0) | SHELL_CMD_TYPE(SHELL_TYPE_CMD_MAIN), bt_audio_volume, cmd_bt_audio_volume_shell, set bt audio volume);
SHELL_EXPORT_CMD(SHELL_CMD_PERMISSION(0) | SHELL_CMD_TYPE(SHELL_TYPE_CMD_MAIN), coex_slot_time, cmd_coex_slot_time_shell, set coex slot time);
SHELL_EXPORT_CMD(SHELL_CMD_PERMISSION(0) | SHELL_CMD_TYPE(SHELL_TYPE_CMD_MAIN), coex, cmd_coex, coexistence controls);
SHELL_EXPORT_CMD(SHELL_CMD_PERMISSION(0) | SHELL_CMD_TYPE(SHELL_TYPE_CMD_MAIN) | SHELL_CMD_DISABLE_RETURN, threads,
                 threads_cmd, show threads info);
```

## src/coex_shell.h
```c
/*
 * Copyright (c) 2026, LISTENAI
 *
 * SPDX-License-Identifier: Apache-2.0
 */

#pragma once

int coex_shell_register(void);
```

## src/coex_wifi.c
```c
/*
 * Copyright (c) 2026, LISTENAI
 *
 * SPDX-License-Identifier: Apache-2.0
 */

#include <assert.h>
#include <errno.h>
#include <string.h>

#define LOG_TAG "coex.wifi"
#include <lisa_log.h>

#include "coex_wifi.h"

#include "FreeRTOS.h"
#include "task.h"

#include "autoconf.h"
#include "lisa_wifi.h"
#include "mac_manager.h"
#include "mac_manager_ops.h"
#include "net_al.h"
#include "net_def.h"
#include "wifi_manager/wifi_manager.h"

#define COEX_WIFI_SEARCH_AP_BUFFER_SIZE 10

static mac_manager_t *g_mac_manager;
static volatile bool g_wifi_connected;
static volatile bool g_wifi_ready;
static volatile bool g_wifi_connecting;
static bool g_wifi_inited;
static bool g_wifi_manager_inited;
static volatile bool g_wifi_stack_ready;
static volatile uint32_t g_wifi_ip_addr;
static wifi_mgr_sta_config_t g_saved_ap_list[COEX_WIFI_SEARCH_AP_BUFFER_SIZE];

static int8_t custom_get_wifi_mac(uint8_t mac_addr[6])
{
    int8_t ret;

    if (mac_addr == NULL) {
        return -1;
    }

    ret = mac_manager_get(g_mac_manager, mac_addr, 6);
    if (ret == 0) {
        LOGI("wifi mac: %02X:%02X:%02X:%02X:%02X:%02X",
             mac_addr[0], mac_addr[1], mac_addr[2], mac_addr[3], mac_addr[4], mac_addr[5]);
    }

    return ret;
}

static void dhcp_status_callback(int vif_idx, bool success, uint32_t ip_addr, uint32_t netmask, uint32_t gateway, void *arg)
{
    (void)netmask;
    (void)gateway;
    (void)arg;

    if (success) {
        LOGI("DHCP success on VIF-%d: IP=%u.%u.%u.%u",
             vif_idx,
             ip_addr & 0xff, (ip_addr >> 8) & 0xff, (ip_addr >> 16) & 0xff, (ip_addr >> 24) & 0xff);
        g_wifi_ip_addr = ip_addr;
        g_wifi_ready = true;
    } else {
        LOGI("DHCP failed on VIF-%d", vif_idx);
        g_wifi_ip_addr = 0;
        g_wifi_ready = false;
    }
}

static void wifi_mgr_connection_status_cb(wifi_mgr_connection_info_t *connection_info, void *arg)
{
    net_if_t *net_if;

    (void)arg;
    if (connection_info == NULL) {
        return;
    }

    LOGI("wifi connection status: %d", connection_info->status);

    switch (connection_info->status) {
    case WIFI_MGR_STA_CONNECTED:
        g_wifi_connecting = false;
        g_wifi_connected = true;
        g_wifi_ready = false;
        net_if = net_if_get(WIFI_VIF_STA_IDX);
        if (net_if != NULL) {
            net_if_up(net_if);
            if (!net_if->static_ip) {
                ls_dhcpc_start(WIFI_VIF_STA_IDX);
            }
        }
        LOGI("wifi connected to AP");
        break;
    case WIFI_MGR_STA_DISCONNECTED:
        g_wifi_connecting = false;
        g_wifi_connected = false;
        g_wifi_ready = false;
        g_wifi_ip_addr = 0;
        ls_dhcpc_stop(WIFI_VIF_STA_IDX);
        net_if = net_if_get(WIFI_VIF_STA_IDX);
        if (net_if != NULL) {
            net_if_down(net_if);
        }
        LOGI("wifi disconnected from AP");
        break;
    case WIFI_MGR_STA_CONNECT_FAILED:
        g_wifi_connecting = false;
        g_wifi_connected = false;
        g_wifi_ready = false;
        g_wifi_ip_addr = 0;
        LOGI("wifi connect failed, reason=%d", connection_info->reason);
        break;
    case WIFI_MGR_STA_CONNECTING:
        g_wifi_connecting = true;
        LOGI("wifi connecting...");
        break;
    default:
        break;
    }
}

static void user_mac_manager_init(void)
{
    mac_manager_config_t config = {
        .random_mac_if_mac_invalid = false,
    };

    if (g_mac_manager != NULL) {
        return;
    }

    g_mac_manager = mac_manager_init(mac_manager_ops_get()->mem_ops,
                                     mac_manager_ops_get()->content_ops,
                                     &config);
    assert(g_mac_manager != NULL);
}

static void user_wifi_manager_init(void)
{
    if (g_wifi_manager_inited) {
        return;
    }

    wifi_mgr_init(wifi_mgr_ops_get());
    wifi_mgr_sta_enable();
    wifi_mgr_sta_add_connection_cb(wifi_mgr_connection_status_cb, NULL);
    g_wifi_manager_inited = true;
}

static void cb_lisa_wifi_init_done(void)
{
    LOGI("lisa_wifi_init_done");
    user_wifi_manager_init();
    g_wifi_stack_ready = true;
}

int coex_wifi_init(void)
{
    lisa_wifi_ops_t ops = {
        .init_done = cb_lisa_wifi_init_done,
        .custom_mac = custom_get_wifi_mac,
    };

    if (g_wifi_inited) {
        return 0;
    }

    user_mac_manager_init();
    net_dhcp_register_status_callback(dhcp_status_callback, NULL);
    lisa_wifi_init(&ops);
    g_wifi_inited = true;

    LOGI("wifi init requested");
    return 0;
}

int coex_wifi_connect_to(const char *ssid, const char *pwd)
{
    wifi_mgr_sta_config_t cfg = {0};
    int count;
    int ret;

    if (ssid == NULL || pwd == NULL || ssid[0] == '\0') {
        return -EINVAL;
    }

    if (strlen(ssid) >= sizeof(cfg.ssid) || strlen(pwd) >= sizeof(cfg.pwd)) {
        LOGI("wifi connect config too long: ssid_len=%u pwd_len=%u",
             (unsigned int)strlen(ssid), (unsigned int)strlen(pwd));
        return -ENAMETOOLONG;
    }

    if (!g_wifi_stack_ready) {
        LOGI("wifi stack is not ready yet");
        return -EAGAIN;
    }

    if (g_wifi_connected || g_wifi_connecting) {
        return 0;
    }

    strncpy(cfg.ssid, ssid, sizeof(cfg.ssid) - 1);
    strncpy(cfg.pwd, pwd, sizeof(cfg.pwd) - 1);

    count = wifi_mgr_storage_search_ap(g_saved_ap_list,
                                       COEX_WIFI_SEARCH_AP_BUFFER_SIZE,
                                       SEARCH_ALL,
                                       NULL);
    for (int i = 0; i < count; i++) {
        wifi_mgr_storage_delete_ap(&g_saved_ap_list[i]);
    }

    ret = wifi_mgr_storage_save_ap(&cfg);
    if (ret != 0 && ret != -EEXIST) {
        LOGI("wifi storage save failed: %d", ret);
    }

    ret = wifi_mgr_sta_connect(&cfg, false);
    if (ret == 0) {
        g_wifi_connecting = true;
    }

    LOGI("wifi connect request ret=%d ssid=%s", ret, cfg.ssid);
    return ret;
}

int coex_wifi_connect(void)
{
    return coex_wifi_connect_to(CONFIG_IPERF_WIFI_SSID, CONFIG_IPERF_WIFI_PWD);
}

int coex_wifi_disconnect(void)
{
    int ret;

    if (!g_wifi_stack_ready) {
        return -EAGAIN;
    }

    (void)wifi_mgr_auto_connect_stop();
    ret = wifi_mgr_sta_disconnect(false);
    if (ret == 0) {
        g_wifi_connecting = false;
    }

    LOGI("wifi disconnect request ret=%d", ret);
    return ret;
}

bool coex_wifi_is_ready(void)
{
    return g_wifi_connected && g_wifi_ready;
}

void coex_wifi_get_status(coex_wifi_status_t *status)
{
    if (status == NULL) {
        return;
    }

    taskENTER_CRITICAL();
    status->initialized = g_wifi_inited;
    status->stack_ready = g_wifi_stack_ready;
    status->connected = g_wifi_connected;
    status->ready = g_wifi_ready;
    status->connecting = g_wifi_connecting;
    status->ip_addr = g_wifi_ip_addr;
    taskEXIT_CRITICAL();
}
```
