## CMakeLists.txt
```
cmake_minimum_required(VERSION 3.13)

set(CMAKE_EXPORT_COMPILE_COMMANDS ON)

find_package(listenai-cmake REQUIRED HINTS $ENV{ARCS_BASE})

project(arcs)

listenai_add_executable(${PROJECT_NAME})

target_sources(${PROJECT_NAME} PRIVATE src/main.c src/ls_crypto.c)
```

## prj.conf
```kconfig
# 项目可根据需要在此文件中设置对应的配置
CONFIG_MEM_CONFIG=y

CONFIG_MEM_SRAM_BASE=0x20010000
CONFIG_MEM_SRAM_SIZE=0x00020000

CONFIG_MEM_PSRAM_BASE=0x28000000
CONFIG_MEM_PSRAM_SIZE=0x00800000

CONFIG_MEM_FLASH_BASE=0x30000000
CONFIG_MEM_FLASH_SIZE=0x00200000

# AP core
CONFIG_ARCS_AP_CORE=y
CONFIG_CLOCK_INIT=y
CONFIG_PSRAM_INIT=y

# LSF
CONFIG_ARCS_HAL_LSF=y
CONFIG_IPC_LSF=y
CONFIG_DISK_MEM=n

# CONFIG_ARCS_HAL_IC_MUTEX=n

# LOG UART
CONFIG_SYSLOG_UART_PORT=1
CONFIG_SYSLOG_UART_BAUDRATE=921600
CONFIG_SYSLOG_UART_TX_PIN=21
CONFIG_SYSLOG_UART_TX_PIN_FUNC_SEL=3

# C LIB
CONFIG_LINK_OPTION_NONE_SPECS=y

# HEAP
CONFIG_HEAP_SIZE=0x10000
CONFIG_PSRAM_HEAP_SIZE=0x100000

# CPP
CONFIG_LINK_CPP_RUNTIME_SECTIONS=n
CONFIG_CPP_EXCEPTIONS=n

# Debug
CONFIG_BACK_TRACE=y

# freertos
CONFIG_FREERTOS_STATIC_ALLOCATION_ENABLE=y
CONFIG_FREERTOS_FAST_FUNC_SECTION=".text"

# main task
CONFIG_MAIN_TASK_STACK_SIZE=8192
CONFIG_MAIN_TASK_PRIORITY=1

CONFIG_LOG=y
CONFIG_SYSLOG_PRINTK_REDIRECT=y
CONFIG_SYSLOG_UART_TX_PORT=1
CONFIG_SYSLOG_UART_TX_PIN=2
CONFIG_SYSLOG_UART_TX_PIN_FUNC_SEL=3
CONFIG_SYSLOG_UART_PORT=1
CONFIG_SYSLOG_UART_BAUDRATE=921600
```

## src/main.c
```c
#include "stdio.h"
#include <string.h>
#include <stdbool.h>
// #include <assert.h>

#include "arcs_ap.h"
#include "ic_message.h"

#include "FreeRTOS.h"
#include "task.h"
#include "semphr.h"

extern void ls_crypto_init(void);
extern void ls_crypto_sha256_test(void);

void ic_mutex_task(void *param)
{
    int ret;

    printf("ic_mutex_task enter...\n");

    ls_crypto_init();

    while (1) {

        ls_crypto_sha256_test();
        vTaskDelay(pdMS_TO_TICKS(10));
    }
}

int main(int argc, char **argv)
{
    printf("AP Hard ID: %d\n", CONFIG_HARTID);

#if CONFIG_ARCS_AP_CORE
    #define MEM_CP_FLASH_BASE  (0x30d00000)
    #define MEM_CP_FLASH_SIZE  (0x300000)
    printf("boot cp from address: 0x%x\n", MEM_CP_FLASH_BASE);
    IP_CMN_SYS->REG_N300_CP_RST_ADDR.all = MEM_CP_FLASH_BASE;
    IP_SYSCTRL->REG_SW_RESET_CP0.all = 0xCAFE000A;
#endif

    ic_message_init();
    printf("ic_message_init done!\n");

    xTaskCreate(ic_mutex_task, "ic_mutex_task", 4096, NULL, 6, NULL);

    return 0;
}
```

## src/ls_crypto.c
```c
/*
 * ls_crypto.c
 *
 *  Created on: 2024-11-7
 *  
 *      Author: zyyang
 *
 */

/*
 * INCLUDES
 ****************************************************************************************
 */

 #include "log_print.h"
 #include "Driver_CRYPTO.h"
 #include "FreeRTOS.h"
 #include <stdio.h>
 #include <string.h>
 #ifdef CFG_CRYPTO_IC_MUTEX
 #include "ic_lock.h"
 #endif
 
 void* CRYPTO0_Handler = NULL;
 
 static void CRYPTO_Init_Handler(void){
     CRYPTO0_Handler = CRYPTO0();
 }
 
 static volatile int32_t CRYPTO_Result = CSK_DRIVER_OK;
 #ifdef CFG_RTOS
 #include <semphr.h>
 #ifdef CFG_CRYPTO_IC_MUTEX
 static IC_Mutex crypto_ic_mutex;
 #endif
 
 static SemaphoreHandle_t CRYPTO_res_semaphore;
 static SemaphoreHandle_t CRYPTO_tsk_semaphore;
 static int32_t CRYPTO_EventCallback_RTOS(uint32_t event, int32_t result, void* workspace){
     if(CSK_CRYPTO_EVENT_WAIT_BUSY == event)
     {
         // wait other procedure finish
 #ifdef CFG_CRYPTO_IC_MUTEX
         IC_Mutex_acquire(&crypto_ic_mutex);
 #else
         xSemaphoreTake(CRYPTO_res_semaphore, -1);
 #endif
     }
     else if(CSK_CRYPTO_EVENT_FINISHED == event)
     {
 #ifdef CFG_CRYPTO_IC_MUTEX
         IC_Mutex_release(&crypto_ic_mutex);
 #else
         xSemaphoreGive(CRYPTO_res_semaphore);
 #endif
     }
     else if(CSK_CRYPTO_EVENT_WAIT_DONE == event)
     {
         xSemaphoreTake(CRYPTO_tsk_semaphore, -1);
         return CRYPTO_Result;
     }
     else if(CSK_CRYPTO_EVENT_DONE == event)
     {
         BaseType_t xHigherPriorityTaskWoken = pdFALSE;
         CRYPTO_Result = result;
         xSemaphoreGiveFromISR(CRYPTO_tsk_semaphore, &xHigherPriorityTaskWoken);
     }
 
     return CSK_DRIVER_OK;
 }
 #else
 static volatile uint32_t CRYPTO_BUSY = 0;
 static volatile uint32_t CRYPTO_DONE = 0;
 static int32_t CRYPTO_EventCallback_NOS(uint32_t event, int32_t result, void* workspace)
 {
     if(CSK_CRYPTO_EVENT_WAIT_BUSY == event)
     {
         // wait other procedure finish
         while(CRYPTO_BUSY);
         CRYPTO_BUSY = 1;
     }
     else if(CSK_CRYPTO_EVENT_FINISHED == event)
     {
         CRYPTO_BUSY = 0;
     }
     else if(CSK_CRYPTO_EVENT_WAIT_DONE == event)
     {
         while(!CRYPTO_DONE);
         CRYPTO_DONE = 0;
         return CRYPTO_Result;
     }
     else if(CSK_CRYPTO_EVENT_DONE == event)
     {
         CRYPTO_Result = result;
         CRYPTO_DONE = 1;
     }
 
     return CSK_DRIVER_OK;
 }
 #endif
 
 void ls_crypto_init(void)
 {
 #ifdef CFG_RTOS
     CRYPTO_res_semaphore = xSemaphoreCreateBinary();
     CRYPTO_tsk_semaphore = xSemaphoreCreateBinary();
     xSemaphoreGive(CRYPTO_res_semaphore);
 #endif
 #ifdef CFG_CRYPTO_IC_MUTEX
     IC_Mutex_init(&crypto_ic_mutex, IC_MUTEX_SLEEP_WAIT, IC_MUTEX_TYPE_CRYPTO);
 #endif
     CRYPTO_Init_Handler();
 #ifndef CFG_RTOS
     CRYPTO_Initialize(CRYPTO0_Handler, CRYPTO_EventCallback_NOS, NULL);
 #else
     CRYPTO_Initialize(CRYPTO0_Handler, CRYPTO_EventCallback_RTOS, NULL);
 #endif

 }
 
#define DATA_LEN 1024
static uint8_t source[DATA_LEN];
static uint8_t dest[32];

void ls_crypto_sha256_test(void)
{
    for (int i = 0; i < DATA_LEN; i++){
        source[i] = i % 256;
    }
    memset(dest, 0, 32);

    CRYPTO_PowerControl(CRYPTO0_Handler, CSK_CRYPTO_HW_AES_SHA, CSK_POWER_FULL);
    CRYPTO_Control(CRYPTO0_Handler, CSK_CRYPTO_SET_HASH_MODE, CSK_CRYPTO_HASH_SHA256);

    CRYPTO_Hash(CRYPTO0_Handler, (uint32_t*)source, DATA_LEN, (uint32_t*)dest, 0);
    
    for (int i = 0; i < 32; i++) {
        printf("%02x ", dest[i]);
    }
    printf("\n");


    CRYPTO_PowerControl(CRYPTO0_Handler, CSK_CRYPTO_HW_AES_SHA, CSK_POWER_OFF);

}
```
