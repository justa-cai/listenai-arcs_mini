## CMakeLists.txt
```
cmake_minimum_required(VERSION 3.13)

set(CMAKE_EXPORT_COMPILE_COMMANDS ON)

find_package(listenai-cmake REQUIRED HINTS $ENV{ARCS_BASE})

project(app)

listenai_include_directories(
    ./
)

listenai_add_executable(${PROJECT_NAME})

target_sources(${PROJECT_NAME} PRIVATE src/main.c)
```

## sample.yaml
```
tests:
  samples.touch:
    build_only: true
```

## prj.conf
```kconfig
CONFIG_LISA_DISPLAY=y
CONFIG_LISA_DISPLAY_ST7789P3=y
CONFIG_LISA_DISPLAY_TE_SYNC=n
CONFIG_LISA_DISPLAY_CPDMA_ROTATE=n
CONFIG_LISA_DISPLAY_INTERFACE_SPI_4_LINE=y
CONFIG_DISPLAY_ST7789P3_WIDTH=240
CONFIG_DISPLAY_ST7789P3_HEIGHT=320
CONFIG_DISPLAY_ST7789P3_X_OFFSET=0
CONFIG_DISPLAY_ST7789P3_Y_OFFSET=0

CONFIG_LISA_TOUCH=y
CONFIG_LISA_TOUCH_CST328=y

# CONFIG_ARCS_HAL_DEBUG=y
CONFIG_MODULE_FREERTOS=y
CONFIG_MODULE_HEAP=y
CONFIG_LINK_OPTION_NOSYS_SPECS=y


CONFIG_EASYLOGGER_ASYNC_BUF_SIZE=0x1000

CONFIG_MODULE_HEAP=y

CONFIG_LOG=y
CONFIG_SYSLOG_PRINTK_REDIRECT=y

CONFIG_SYSLOG_UART_TX_PIN=3
CONFIG_SYSLOG_UART_TX_PIN_FUNC_SEL=2
CONFIG_SYSLOG_UART_PORT=0
CONFIG_SYSLOG_UART_BAUDRATE=921600


CONFIG_FREERTOS_STATIC_ALLOCATION_ENABLE=y

CONFIG_DCACHE_ENABLE=n


CONFIG_BACK_TRACE=y

CONFIG_HEAP_SIZE=0x3C00


CONFIG_PSRAM_HEAP_SIZE=0x3b0000

# 使能collection-c
CONFIG_SDK_MODULE_COLLECTIONS_C=y

CONFIG_SDK_MODULE_MBEDTLS=n
CONFIG_SDK_MODULE_CURL=n
CONFIG_LOG=y
CONFIG_BACK_TRACE=y

CONFIG_LISA_OS=y
CONFIG_FREERTOS_STATIC_ALLOCATION_ENABLE=y
```

## src/main.c
```c
#include <stdio.h>
#include <stdlib.h>
#include "IOMuxManager.h"
#include "lisa_display.h"
#include "lisa_touch.h"
#include "FreeRTOS.h"
#include "task.h"
#include "lisa_log.h"
#include "board.h"

void *touch_device = NULL;
static volatile bool touch_int_trigger = false;

/**
        该函数在中断上下文
 */
static void touch_int_callback(void)
{
    touch_int_trigger = true;
}

int main(int argc, char **argv)
{
    uint16_t x, y;

    LOGD("touch sample start.\r\n");

    /* 对于 ST7789P3 方案，触摸初始化无需先点亮 LCD，可直接初始化触摸 */
    touch_hw_config_t config = {
        .i2c_dev = LISA_TOUCH_I2C_DEV,
        .i2c_pins = {
            .sda = {
                .sda_pad = LISA_TOUCH_I2C_SDA_PORT,
                .sda_pin = LISA_TOUCH_I2C_SDA_PIN,
                .sda_func = LISA_TOUCH_I2C_SDA_FUNC,
            },
            .scl = {
                .scl_pad = LISA_TOUCH_I2C_SCL_PORT,
                .scl_pin = LISA_TOUCH_I2C_SCL_PIN,
                .scl_func = LISA_TOUCH_I2C_SCL_FUNC,
            },
        },
        .gpio_pins.reset.reset_pad = LISA_TOUCH_I2C_RST_PORT,
        .gpio_pins.reset.reset_pin = LISA_TOUCH_I2C_RST_PIN,
        .gpio_pins.reset.reset_func = LISA_TOUCH_I2C_RST_FUNC,
        .gpio_pins.intr.int_pad = LISA_TOUCH_I2C_INT_PORT,
        .gpio_pins.intr.int_pin = LISA_TOUCH_I2C_INT_PIN,
        .gpio_pins.intr.int_func = LISA_TOUCH_I2C_INT_FUNC,
    };
    touch_device = lisa_touch_create(&config);
    if (touch_device == NULL) {
        LOGE("lisa_touchy_create fail.\r\n");
        return -1;
    }

    lisa_touch_set_int_callback(touch_device, touch_int_callback);

    while (1) {
        if (touch_int_trigger == true) {
            touch_int_trigger = false;
            bool pressed = false;
            lisa_touch_read_coordinates(touch_device, &x, &y, &pressed);
            LOGI("touch: x=%d, y=%d, pressed=%d.", x, y, pressed);
        }
        vTaskDelay(pdMS_TO_TICKS(100));
    }

    return 0;
}
```
