## CMakeLists.txt
```
cmake_minimum_required(VERSION 3.19)

set(CMAKE_EXPORT_COMPILE_COMMANDS ON)

find_package(listenai-cmake REQUIRED HINTS $ENV{ARCS_BASE})

project(lisa_flash_halt_remote_core_ap)

listenai_add_executable(${PROJECT_NAME})

target_sources(${PROJECT_NAME} PRIVATE src/main.c)
```

## sample.yaml
```
tests:
  samples.drivers.devices.lisa_flash.halt_remote_core.remote:
    build_only: true
```

## prj.conf
```kconfig
# ============================================
# LISA Flash Dual-Core Example - AP Core
# (Remote Core - Gets Halted by CP Core)
# ============================================

# Core Configuration
CONFIG_ARCS_AP_CORE=y

# IPC Configuration for Dual-Core
CONFIG_RTOS_AL=y
CONFIG_LISA_FLASH_ARCS_HALT_BY_REMOTE_CORE=y
CONFIG_LOG_BACKEND_IPC_WRITER=y

CONFIG_CONSOLE_UART_NAME="uart1"

# redefine memory config for AP core
CONFIG_MEM_SRAM_BASE=0x20010000
CONFIG_MEM_SRAM_SIZE=0x00020000
CONFIG_MEM_PSRAM_BASE=0x28000000
CONFIG_MEM_PSRAM_SIZE=0x00100000
```

## prj_venusa.conf
```kconfig
# ============================================
# LISA Flash VenusA Dual-Core Hook Sample - AP
# AP receives flash hook messages and waits in SRAM.
# ============================================

# VenusA AP core image (hart 0)
CONFIG_HARTID=0

# Build the VenusA flash hook receiver into the AP image.
CONFIG_LISA_DEVICE=y
CONFIG_LISA_FLASH=y
CONFIG_LISA_FLASH_HALT_REMOTE_CORE=y
CONFIG_LISA_FLASH_HOOK_WAITER_ONLY=y

# AP image is burned at flash base 0x30000000.
CONFIG_MEM_FLASH_BASE=0x30000000
CONFIG_MEM_FLASH_SIZE=0x00080000

# Split VenusA RAM explicitly for this two-image sample.
CONFIG_MEM_SRAM_BASE=0x20009000
CONFIG_MEM_SRAM_SIZE=0x0000D000
CONFIG_MEM_PSRAM_BASE=0x38000000
CONFIG_MEM_PSRAM_SIZE=0x00400000
CONFIG_MEM_APRAM_BASE=0x20040000
CONFIG_MEM_APRAM_SIZE=0x00040000

CONFIG_CONSOLE_UART_NAME="uart1"
CONFIG_MAIN_TASK_STACK_SIZE=3072
CONFIG_HEAP_SIZE=0x2000
CONFIG_LOG_MODE_ASYNC=n
CONFIG_EASYLOGGER_LOG_MODE_ASYNC=n
```

## src/main.c
```c
/*
 * Copyright (c) 2025, LISTENAI
 *
 * SPDX-License-Identifier: Apache-2.0
 */

/**
 * @file main.c
 * @brief LISA Flash 双核环境示例 (AP 核)
 *
 * 本示例演示 AP 核在双核环境下的运行，作为远端核心，它会在 CP 核执行 Flash 操作时
 * 被自动停止，确保 Flash 访问的安全性。
 *
 * ## 功能说明
 * 1. AP 核持续运行一个计数任务
 * 2. 当 CP 核执行 Flash 操作时，AP 核会被 IPC 机制自动停止
 * 3. Flash 操作完成后，AP 核自动恢复运行
 * 4. 通过串口输出可以观察到 AP 核的停止和恢复过程
 *
 * @note 配置 CONFIG_LISA_FLASH_ARCS_HALT_BY_REMOTE_CORE=y 允许被远端核心停止
 */

#include <stdio.h>
#include <stdint.h>
#include <stdbool.h>

#include "sys_init.h"
#include "soc/chip.h"
#include "sys/boot_core.h"

#include "FreeRTOS.h"
#include "task.h"

#include "IOMuxManager.h"

#define TAG "remote_main"
#include <lisa_log.h>

void ipc_utils_before_halt_by_peer_core(void)
{
    LISA_LOGI(TAG, "%s", __func__);
}

void ipc_utils_after_resume_by_peer_core(void)
{
    LISA_LOGI(TAG, "%s", __func__);
}

int main(int argc, char **argv)
{
    uint32_t heartbeat = 0;

    LISA_LOGI(TAG, "\n========================================");
    LISA_LOGI(TAG, "=== LISA Flash Dual-Core Example ===");
    LISA_LOGI(TAG, "===      (AP Core - Remote)        ===");
    LISA_LOGI(TAG, "========================================");
    LISA_LOGI(TAG, "Observe the log messages indicating halt and resume events.\n");
    LISA_LOGI(TAG, "AP flash ready");

    while (1) {
        LISA_LOGI(TAG, "AP heartbeat %lu", (unsigned long)heartbeat++);
        vTaskDelay(pdMS_TO_TICKS(1000));
    }
    return 0;
}

static int boot_cp(void)
{
    int ret = sys_boot_core(1, 0x30080000);
    if (ret != 0) {
        LISA_LOGE(TAG, "CP core boot failed: %d", ret);
        return ret;
    }

    LISA_LOGI(TAG, "CP core booted.\n");
    return 0;
}

SYS_INIT(boot_cp, SYS_INIT_LEVEL_PRE_DEVICES_INIT, 1);      /* 优先级 */
```
