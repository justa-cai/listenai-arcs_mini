## CMakeLists.txt
```
cmake_minimum_required(VERSION 3.19)

set(CMAKE_EXPORT_COMPILE_COMMANDS ON)

find_package(listenai-cmake REQUIRED HINTS $ENV{ARCS_BASE})

set(LISA_FLASH_HALT_REMOTE_CORE_CP_TARGET lisa_flash_halt_remote_core_cp)
set(LISA_FLASH_HALT_REMOTE_CORE_AP_TARGET lisa_flash_halt_remote_core_ap)

project(${LISA_FLASH_HALT_REMOTE_CORE_CP_TARGET})

listenai_add_executable(${PROJECT_NAME})
target_sources(${PROJECT_NAME} PRIVATE src/main.c)

include(ExternalProject)

if(CONFIG_SOC_VENUSA)
    set(LISA_FLASH_HALT_REMOTE_CORE_REMOTE_CONFIG ${CMAKE_CURRENT_SOURCE_DIR}/remote/prj_venusa.conf)
    set(LISA_FLASH_HALT_REMOTE_CORE_SAMPLE_NAME "VenusA LISA Flash Hook Sample")
else()
    set(LISA_FLASH_HALT_REMOTE_CORE_REMOTE_CONFIG ${CMAKE_CURRENT_SOURCE_DIR}/remote/prj.conf)
    set(LISA_FLASH_HALT_REMOTE_CORE_SAMPLE_NAME "LISA Flash Dual-Core Example")
endif()

if(CONFIG_DEFAULT)
    set(LISA_FLASH_HALT_REMOTE_CORE_CP_CONFIG ${CONFIG_DEFAULT})
else()
    set(LISA_FLASH_HALT_REMOTE_CORE_CP_CONFIG ${CMAKE_CURRENT_SOURCE_DIR}/prj.conf)
endif()

ExternalProject_Add(
    remote_core
    SOURCE_DIR ${CMAKE_CURRENT_SOURCE_DIR}/remote
    BINARY_DIR ${CMAKE_CURRENT_BINARY_DIR}/remote
    CMAKE_ARGS
        -DCMAKE_BUILD_TYPE=${CMAKE_BUILD_TYPE}
        -DCMAKE_TOOLCHAIN_FILE=${CMAKE_TOOLCHAIN_FILE}
        -DCMAKE_MAKE_PROGRAM=${CMAKE_MAKE_PROGRAM}
        -DBOARD=${BOARD}
        -DCONFIG_DEFAULT=${LISA_FLASH_HALT_REMOTE_CORE_REMOTE_CONFIG}
        $<$<BOOL:${BOARD_SEARCH_PATH}>:-DBOARD_SEARCH_PATH=${BOARD_SEARCH_PATH}>
    BUILD_ALWAYS 1
    INSTALL_COMMAND ""
)

add_dependencies(${PROJECT_NAME} remote_core)

find_program(PYTHON3 python3 REQUIRED)
set(MERGE_SCRIPT "$ENV{ARCS_BASE}/tools/scripts/merge_bins.py")

file(STRINGS "${LISA_FLASH_HALT_REMOTE_CORE_CP_CONFIG}" PRJ_CONF REGEX "^CONFIG_MEM_FLASH_BASE=")
string(REGEX REPLACE "^CONFIG_MEM_FLASH_BASE=(0x[0-9a-fA-F]+)" "\\1" FLASH_BASE_ADDR ${PRJ_CONF})

if(NOT FLASH_BASE_ADDR)
    set(FLASH_OFFSET "0x80000")
else()
    math(EXPR FLASH_OFFSET "${FLASH_BASE_ADDR} - 0x30000000" OUTPUT_FORMAT HEXADECIMAL)
endif()

add_custom_target(merge_images ALL
    COMMAND ${PYTHON3} ${MERGE_SCRIPT}
            --output ${CMAKE_CURRENT_BINARY_DIR}/merged.bin
            --bin 0x00000 ${CMAKE_CURRENT_BINARY_DIR}/remote/${LISA_FLASH_HALT_REMOTE_CORE_AP_TARGET}.bin
            --bin ${FLASH_OFFSET} ${CMAKE_CURRENT_BINARY_DIR}/${PROJECT_NAME}.bin
    DEPENDS ${PROJECT_NAME} remote_core
    COMMENT "Merging ${LISA_FLASH_HALT_REMOTE_CORE_AP_TARGET}.bin and ${PROJECT_NAME}.bin into merged.bin"
)

message(STATUS "========================================")
message(STATUS "${LISA_FLASH_HALT_REMOTE_CORE_SAMPLE_NAME}")
message(STATUS "========================================")
if(CONFIG_SOC_VENUSA)
    message(STATUS "CP Core (Flash operator): ${PROJECT_NAME}")
    message(STATUS "CP Core config: ${LISA_FLASH_HALT_REMOTE_CORE_CP_CONFIG}")
    message(STATUS "AP Core (Hook waiter): ${LISA_FLASH_HALT_REMOTE_CORE_AP_TARGET}")
    message(STATUS "AP Core config: ${LISA_FLASH_HALT_REMOTE_CORE_REMOTE_CONFIG}")
else()
    message(STATUS "CP Core (Master): ${PROJECT_NAME}")
    message(STATUS "Remote Core (AP): ${LISA_FLASH_HALT_REMOTE_CORE_AP_TARGET}")
endif()
message(STATUS "========================================")
```

## sample.yaml
```
tests:
  samples.drivers.devices.lisa_flash.halt_remote_core:
    programmer: arcs
    runner: uart
    platform_allow:
      - arcs_evb
    build_extra_args: ""
    images:
      - file: "remote/lisa_flash_halt_remote_core_ap.bin"
        address: "0x0"
      - file: "lisa_flash_halt_remote_core_cp.bin"
        address: "0x80000"
    log_analyzer:
      type: "regex"
      pattern: "CP flash passed"

  samples.drivers.devices.lisa_flash.halt_remote_core.venusa:
    build_only: true
```

## prj.conf
```kconfig
# ============================================
# LISA Flash Dual-Core Example - CP Core
# (Master Core - Runs Flash Operations)
# ============================================

# Core Configuration
CONFIG_ARCS_CP_CORE=y
CONFIG_BOOT=n

# LISA Device Framework
CONFIG_LISA_DEVICE=y
CONFIG_LISA_FLASH=y
CONFIG_LISA_FLASH_ARCS_HALT_REMOTE_CORE=y

# IPC Configuration for Dual-Core
CONFIG_LOG_BACKEND_IPC_READER=y

# Flash memory base address for CP core
CONFIG_MEM_FLASH_BASE=0x30080000

# HAL Configuration
CONFIG_LOG_MODE_ASYNC=n
CONFIG_EASYLOGGER_LOG_MODE_ASYNC=n
CONFIG_ARCS_HAL_EXT_RAM_SECTION=".ramcode"

# redefine memory config for CP core
CONFIG_MEM_SRAM_BASE=0x20030000
CONFIG_MEM_SRAM_SIZE=0x00010000
CONFIG_MEM_PSRAM_BASE=0x28100000
CONFIG_MEM_PSRAM_SIZE=0x00100000
```

## prj_venusa.conf
```kconfig
# ============================================
# LISA Flash VenusA Dual-Core Hook Sample - CP
# CP runs flash erase/write/read operations.
# ============================================

# VenusA CP core image (hart 1)
CONFIG_HARTID=1
CONFIG_BOOT=n
CONFIG_CLOCK_INIT=n
CONFIG_PSRAM_INIT=n

# LISA Flash driver with VenusA ic_message hooks.
# CP must not re-initialize shared clock/PSRAM after AP has booted.
CONFIG_LISA_DEVICE=y
CONFIG_LISA_FLASH=y
CONFIG_LISA_FLASH_HALT_REMOTE_CORE=y

# CP image starts at AP image + 0x80000.
CONFIG_MEM_FLASH_BASE=0x30080000
CONFIG_MEM_FLASH_SIZE=0x00F80000

# Split VenusA RAM explicitly for this two-image sample.
CONFIG_MEM_SRAM_BASE=0x20016000
CONFIG_MEM_SRAM_SIZE=0x0000A000
CONFIG_MEM_PSRAM_BASE=0x38400000
CONFIG_MEM_PSRAM_SIZE=0x00400000
CONFIG_MEM_APRAM_BASE=0x20040000
CONFIG_MEM_APRAM_SIZE=0x00040000

CONFIG_MAIN_TASK_STACK_SIZE=3072
CONFIG_HEAP_SIZE=0x2000
CONFIG_LOG_MODE_ASYNC=n
CONFIG_EASYLOGGER_LOG_MODE_ASYNC=n
```

## src/main.c
```c
/*
 * Copyright (c) 2025, LISTENAI
 *
 * SPDX-License-Identifier: Apache-2.0
 */

/**
 * @file main.c
 * @brief LISA Flash 双核环境示例 (CP 核)
 *
 * 本示例演示在双核环境下使用 LISA Flash 驱动，CP 核执行 Flash 操作，
 * 通过启用 CONFIG_LISA_FLASH_ARCS_HALT_REMOTE_CORE 在 Flash 操作期间
 * 自动停止远端核心（AP 核），确保 Flash 访问的安全性。
 *
 * ## 功能说明
 * 1. CP 核运行 Flash 读写操作
 * 2. Flash 操作期间通过 IPC 机制自动停止 AP 核
 * 3. Flash 操作完成后自动恢复 AP 核运行
 * 4. 验证双核协同工作的正确性
 *
 * @note 配置 CONFIG_LISA_FLASH_ARCS_HALT_REMOTE_CORE=y 启用远端核心停止功能
 */

#include <stdbool.h>
#include <stdio.h>
#include <string.h>

#include "lisa_device.h"
#include "lisa_flash.h"

#include "FreeRTOS.h"
#include "task.h"
/* Flash 设备名称 */
#define FLASH_DEVICE "flash0"

/* 测试区域偏移地址和大小 */
#define TEST_OFFSET  0x100000   /* 测试区域起始偏移 1MB */
#define TEST_SIZE    256       /* 测试数据大小 */

/* 测试迭代次数 */
#define TEST_ITERATIONS  5

/* 测试数据缓冲区 */
static uint8_t write_buf[TEST_SIZE];
static uint8_t read_buf[TEST_SIZE];

/**
 * @brief 打印 Flash 设备信息
 */
static void print_flash_info(lisa_device_t *flash)
{
    printf("\n=== Flash Device Information ===\n");

    /* 获取 Flash 参数 */
    const lisa_flash_parameters_t *params = lisa_flash_get_parameters(flash);
    if (!params) {
        printf("Error: Failed to get flash parameters\n");
        return;
    }

    printf("Write block size: %zu bytes\n",
           lisa_flash_params_get_write_block_size(params));
    printf("Erase value: 0x%02X\n",
           lisa_flash_params_get_erase_value(params));
    printf("No explicit erase: %s\n",
           lisa_flash_params_get_no_explicit_erase(params) ? "Yes" : "No");

    /* 获取页面布局信息 */
    size_t layout_count = 0;
    const lisa_flash_pages_layout_t *layout = lisa_flash_page_layout(flash, &layout_count);
    if (!layout) {
        printf("Error: Failed to get flash layout\n");
        return;
    }

    printf("\n=== Flash Layout ===\n");
    printf("Layout segments: %zu\n", layout_count);

    size_t total_offset = 0;
    for (size_t i = 0; i < layout_count; i++) {
        printf("Segment %zu: %zu pages × %zu bytes (offset: 0x%zx)\n",
               i,
               layout[i].pages_count,
               layout[i].pages_size,
               total_offset);
        total_offset += layout[i].pages_count * layout[i].pages_size;
    }

    size_t total_size = lisa_flash_get_size_from_layout(layout, layout_count);
    printf("Total flash size: %zu bytes (%zu KB)\n",
           total_size, total_size / 1024);
    printf("================================\n\n");
}

/**
 * @brief Flash 读写测试
 */
static int flash_read_write_test(lisa_device_t *flash, int iteration)
{
    int ret;

    printf("\n=== Flash Read/Write Test (Iteration %d) ===\n", iteration);

    /* 获取 Flash 参数 */
    const lisa_flash_parameters_t *params = lisa_flash_get_parameters(flash);
    if (!params) {
        printf("Error: Failed to get flash parameters\n");
        return -1;
    }

    /* 获取页面布局 */
    size_t layout_count = 0;
    const lisa_flash_pages_layout_t *layout = lisa_flash_page_layout(flash, &layout_count);
    if (!layout || layout_count == 0) {
        printf("Error: Failed to get flash layout\n");
        return -1;
    }

    size_t page_size = layout[0].pages_size;
    printf("Using page size: %zu bytes\n", page_size);

    /* 1. 准备测试数据 */
    printf("\n1. Preparing test data...\n");
    for (size_t i = 0; i < TEST_SIZE; i++) {
        write_buf[i] = (uint8_t)((i + iteration * 0x10) & 0xFF);
    }
    printf("   Test data prepared: %zu bytes\n", TEST_SIZE);

    /* 2. 擦除 Flash 区域 */
    printf("\n2. Erasing flash at offset 0x%x, size %zu bytes...\n",
           TEST_OFFSET, page_size);
    printf("   [CP Core] Halting remote core (AP) during erase...\n");

    ret = lisa_flash_erase(flash, TEST_OFFSET, page_size);
    if (ret != 0) {
        printf("   Error: Erase failed with code %d\n", ret);
        return ret;
    }
    printf("   Erase successful\n");
    printf("   [CP Core] Remote core (AP) resumed\n");

    /* 3. 写入数据 */
    printf("\n3. Writing %zu bytes to flash at offset 0x%x...\n",
           TEST_SIZE, TEST_OFFSET);
    printf("   [CP Core] Halting remote core (AP) during write...\n");

    ret = lisa_flash_write(flash, TEST_OFFSET, write_buf, TEST_SIZE);
    if (ret != 0) {
        printf("   Error: Write failed with code %d\n", ret);
        return ret;
    }
    printf("   Write successful\n");
    printf("   [CP Core] Remote core (AP) resumed\n");

    /* 4. 读取数据 */
    printf("\n4. Reading %zu bytes from flash at offset 0x%x...\n",
           TEST_SIZE, TEST_OFFSET);
    memset(read_buf, 0, TEST_SIZE);
    ret = lisa_flash_read(flash, TEST_OFFSET, read_buf, TEST_SIZE);
    if (ret != 0) {
        printf("   Error: Read failed with code %d\n", ret);
        return ret;
    }
    printf("   Read successful\n");

    /* 5. 验证数据 */
    printf("\n5. Verifying data...\n");
    bool verify_ok = true;
    for (size_t i = 0; i < TEST_SIZE; i++) {
        if (read_buf[i] != write_buf[i]) {
            printf("   Error: Data mismatch at offset %zu: "
                   "expected 0x%02X, got 0x%02X\n",
                   i, write_buf[i], read_buf[i]);
            verify_ok = false;
            break;
        }
    }

    if (verify_ok) {
        printf("   Verification successful! All %zu bytes match.\n", TEST_SIZE);
    } else {
        printf("   Verification failed!\n");
        return -1;
    }

    /* 6. 打印前16字节数据 */
    printf("\n6. First 16 bytes of data:\n");
    printf("   Write: ");
    for (size_t i = 0; i < 16 && i < TEST_SIZE; i++) {
        printf("%02X ", write_buf[i]);
    }
    printf("\n   Read:  ");
    for (size_t i = 0; i < 16 && i < TEST_SIZE; i++) {
        printf("%02X ", read_buf[i]);
    }
    printf("\n");

    printf("\n=== Test Iteration %d Completed Successfully ===\n\n", iteration);
    return 0;
}

int main(int argc, char **argv)
{
  
    printf("\n");
    printf("========================================\n");
    printf("=== LISA Flash Dual-Core Example ===\n");
    printf("===      (CP Core - Master)        ===\n");
    printf("========================================\n");
    printf("\n");
    printf("This example demonstrates Flash operations in dual-core environment.\n");
    printf("CONFIG_LISA_FLASH_ARCS_HALT_REMOTE_CORE is enabled, so the remote\n");
    printf("core (AP) will be automatically halted during Flash operations.\n");
    printf("\n");

    /* 1. 获取 Flash 设备（设备已自动初始化） */
    printf("\n1. Getting flash device '%s'...\n", FLASH_DEVICE);
    lisa_device_t *flash = lisa_device_get(FLASH_DEVICE);
    if (!flash) {
        printf("Error: Failed to get flash device '%s'\n", FLASH_DEVICE);
        return -1;
    }

    /* 2. 检查设备状态 */
    if (!lisa_device_ready(flash)) {
        printf("Error: Flash device '%s' is not ready\n", FLASH_DEVICE);
        return -1;
    }
    printf("   Flash device '%s' is ready and auto-initialized at %p\n", FLASH_DEVICE, flash);

    /* 3. 打印 Flash 信息 */
    printf("\n2. Querying flash device information...\n");
    print_flash_info(flash);

    /* 4. 执行多次读写测试 */
    printf("\n3. Running multiple Flash read/write tests...\n");
    printf("   Testing with %d iterations to verify dual-core coordination\n\n", TEST_ITERATIONS);

    for (int i = 1; i <= TEST_ITERATIONS; i++) {
        int ret = flash_read_write_test(flash, i);
        if (ret != 0) {
            printf("\nFlash test FAILED at iteration %d!\n", i);
            return ret;
        }

        /* 延时以便观察 AP 核的运行状态 */
        printf("   Waiting 2 seconds before next iteration...\n\n");
    }

    printf("\n========================================\n");
    printf("All tests passed successfully!\n");
    printf("Total iterations: %d\n", TEST_ITERATIONS);
    printf("========================================\n\n");
    printf("CP flash passed\n");

    return 0;
}
```
