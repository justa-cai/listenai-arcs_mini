## CMakeLists.txt
```
cmake_minimum_required(VERSION 3.19)

set(CMAKE_EXPORT_COMPILE_COMMANDS ON)

find_package(listenai-cmake REQUIRED HINTS $ENV{ARCS_BASE})

project(lisa_display)

listenai_add_executable(${PROJECT_NAME})

target_sources(${PROJECT_NAME} PRIVATE src/main.c)
```

## sample.yaml
```
tests:
  samples.lisa_display:
    programmer: arcs
    runner: uart
    log_analyzer:
      type: "regex"
      pattern: "Display capabilities: \\d+ x \\d+"
```

## prj.conf
```kconfig
CONFIG_LISA_DEVICE=y
CONFIG_LISA_GPIO_DEVICE=y
CONFIG_LISA_GPIOA=y
CONFIG_LISA_GPIOB=y
CONFIG_LISA_PWM=y
CONFIG_LISA_SPI0=y
CONFIG_LISA_SPI1=y

CONFIG_LISA_DISPLAY_DEVICE=y
CONFIG_LISA_DISPLAY_PANEL_ST7789P3=y
CONFIG_PANEL_ST7789P3_WIDTH=240
CONFIG_PANEL_ST7789P3_HEIGHT=320
CONFIG_PANEL_ST7789P3_X_OFFSET=0

CONFIG_LISA_DISPLAY_BUS_SPI_4WIRE=y

CONFIG_PSRAM_HEAP_SIZE=0x3b0000
```

## src/main.c
```c
/*
 * Copyright (c) 2025, LISTENAI
 *
 * SPDX-License-Identifier: Apache-2.0
 */

#include <lisa_device.h>
#include <lisa_display.h>
#include <lisa_mem.h>
#include <stdint.h>
#include "IOMuxManager.h"
#include "lisa_gpio.h"
#include "board.h"

#define LOG_TAG "sample_display"
#include <lisa_log.h>

/*
    为满足不同板型示例场景，重定向设备的pinmux配置
*/
#ifdef CONFIG_BOARD_ARCS_EVB

#define LCD_CS_PIN 5
#define LCD_SPI_CLK_PIN 3
#define LCD_SPI_DATA_PIN 1

void lisa_gpioa_pinmux()
{
    IOMuxManager_PinConfigure(CSK_IOMUX_PAD_A, LCD_RST_PIN, CSK_IOMUX_FUNC_ALTER1);
}

void lisa_gpiob_pinmux()
{
    IOMuxManager_PinConfigure(CSK_IOMUX_PAD_B, LCD_TE_PIN, CSK_IOMUX_FUNC_DEFAULT);
    IOMuxManager_PinConfigure(CSK_IOMUX_PAD_B, LCD_CD_PIN, CSK_IOMUX_FUNC_DEFAULT);
    IOMuxManager_PinConfigure(CSK_IOMUX_PAD_B, LCD_CS_PIN, CSK_IOMUX_FUNC_DEFAULT);
}

void lisa_spi1_pinmux()
{
    IOMuxManager_PinConfigure(CSK_IOMUX_PAD_B, LCD_SPI_CLK_PIN, CSK_IOMUX_FUNC_ALTER6);
    IOMuxManager_PinConfigure(CSK_IOMUX_PAD_B, LCD_SPI_DATA_PIN, CSK_IOMUX_FUNC_ALTER6);
}

#elif CONFIG_BOARD_ARCS_MINI
/* ARCS_MINI: LCD 引脚宏（LCD_CS_PIN、LCD_CD_PIN、LCD_RST_PIN 等）来自 pinmux.h，
 * SPI0/GPIOA/GPIOB/PWM pinmux 均已在 pinmux.c 中配置 */
#endif

enum color {
    COLOR_RED,
    COLOR_GREEN,
    COLOR_BLUE,
};

static void fill_buffer_with_color(uint16_t color, uint16_t *buf, size_t pixel_count)
{
    for (size_t i = 0; i < pixel_count; i++) {
        buf[i] = color;
    }
}

int main(int argc, char **argv)
{
    LISA_LOGI(LOG_TAG, "Display sample started");

    lisa_device_t *gpioa_dev = lisa_device_get("gpioa");
    lisa_device_t *gpiob_dev = lisa_device_get("gpiob");

    lisa_display_config_t display_config = {
        .bus_type = LISA_DISPLAY_BUS_SPI_4WIRE,
        .panel_name = "st7789p3",
        .bus_config = {.spi_4wire =
                           {
#ifdef CONFIG_BOARD_ARCS_MINI
                               .spi_dev = lisa_device_get("spi0"),
                               .cs_gpio = gpioa_dev,
                               .cs_pin = LCD_CS_PIN,
                               .dc_gpio = gpioa_dev,
                               .dc_pin = LCD_CD_PIN,
#else
                               .spi_dev = lisa_device_get("spi1"),
                               .cs_gpio = gpiob_dev,
                               .cs_pin = LCD_CS_PIN,
                               .dc_gpio = gpiob_dev,
                               .dc_pin = LCD_CD_PIN,
#endif
                               .spi_freq = 50 * 1000 * 1000,

                           }},
        .backlight = {.type = LISA_DISPLAY_BACKLIGHT_TYPE_PWM,
#ifdef CONFIG_BOARD_ARCS_MINI
                      .config.pwm = {.channel = 1, .dev = lisa_device_get("pwm0"), .freq = 2000}},
#else
                      .blacklight_polarity = LISA_DISPLAY_BLACKLIGHT_POLARITY_LOW,
                      .config.pwm = {.channel = 0, .dev = lisa_device_get("pwm0"), .freq = 2000}},
#endif
#ifdef CONFIG_BOARD_ARCS_MINI
        .rst_gpio = gpiob_dev,
#else
        .rst_gpio = gpioa_dev,
#endif
        .rst_pin = LCD_RST_PIN,
        // .te_gpio = gpiob_dev,
        // .te_pin  = LCD_TE_PIN
    };

    lisa_device_t *display_device = lisa_device_get("display");
    if (!display_device) {
        LISA_LOGE(LOG_TAG, "Failed to get display device");
        return -1;
    }

    lisa_display_attach_bus(display_device, &display_config);

    lisa_display_capabilities_t caps;
    lisa_display_get_capabilities(display_device, &caps);
    LISA_LOGI(LOG_TAG, "Display capabilities: %d x %d", caps.width, caps.height);

    size_t buffer_pixels = caps.width * caps.height;
    size_t buffer_size = buffer_pixels * sizeof(uint16_t);
    uint16_t *buffer = lisa_mem_alloc(buffer_size);
    if (!buffer) {
        LISA_LOGE(LOG_TAG, "Failed to allocate buffer");
        return -1;
    }

    lisa_display_buffer_desc_t desc = {
        .width = caps.width,
        .height = caps.height,
        .buf_size = buffer_size,
    };

    lisa_display_blanking_off(display_device);

    int color_idx = 0;
    uint8_t brightness = 0;

    lisa_display_set_brightness(display_device, brightness);
    while (1) {
        uint16_t current_color = LISA_DISPLAY_COLOR_RED;
        switch (color_idx) {
        case COLOR_RED:
            current_color = LISA_DISPLAY_COLOR_RED;
            break;
        case COLOR_GREEN:
            current_color = LISA_DISPLAY_COLOR_GREEN;
            break;
        case COLOR_BLUE:
            current_color = LISA_DISPLAY_COLOR_BLUE;
            break;
        default:
            break;
        }

        fill_buffer_with_color(current_color, buffer, buffer_pixels);
        lisa_display_write(display_device, 0, 0, &desc, buffer);

        // Update color index for next loop
        color_idx = (color_idx + 1) % 3;
        brightness = (brightness + 1) % 100;
        LOGI("brightness: %d", brightness);
        lisa_display_set_brightness(display_device, brightness);

        lisa_thread_mdelay(1000);
    }
}
```
