## CMakeLists.txt
```
cmake_minimum_required(VERSION 3.19)

set(CMAKE_EXPORT_COMPILE_COMMANDS ON)

find_package(listenai-cmake REQUIRED HINTS $ENV{ARCS_BASE})

project(arcs)

listenai_add_executable(${PROJECT_NAME})

target_sources(${PROJECT_NAME} PRIVATE 
    src/main.c 
    src/temp_calc.c
)
```

## sample.yaml
```
tests:
  samples.lisa_adc.read_temperature_channel:
    programmer: arcs
    runner: uart
    log_analyzer:
      type: "regex"
      pattern: "Temperature: raw="
```

## prj.conf
```kconfig
CONFIG_LISA_DEVICE=y
CONFIG_LISA_ADC=y
```

## src/main.c
```c
/*
 * Copyright (c) 2025, LISTENAI
 *
 * SPDX-License-Identifier: Apache-2.0
 */

/**
 * @file main.c
 * @brief LISA ADC 温度传感器读取示例
 *
 * 本示例演示如何使用 LISA ADC 驱动读取内部温度传感器：
 * 1. 初始化ADC设备
 * 2. 配置温度传感器通道参数（使用1.2V参考电压和10-bit分辨率）
 * 3. 循环读取温度传感器通道数值
 * 4. 转换为电压值并显示
 *
 * @note 温度传感器为内部通道7，无需配置PINMUX
 */
#define LOG_TAG "sample"
#include <lisa_log.h>

#include <stdbool.h>
#include <stdio.h>
#include "lisa_device.h"
#include "lisa_adc.h"

#include "FreeRTOS.h"
#include "task.h"

#include "temp_calc.h"

#define ADC_CHANNEL_TEMP    7         // 内部温度传感器通道
#define ADC_DEVICE          "adc0"

int main(int argc, char **argv)
{
    LISA_LOGI(LOG_TAG, "=== LISA ADC Temperature Sensor Read Example ===\n");

    /* 获取ADC设备 */
    lisa_device_t *adc_dev = lisa_device_get(ADC_DEVICE);
    if (!lisa_device_ready(adc_dev)) {
        LISA_LOGE(LOG_TAG, "Error: %s device not ready\n", ADC_DEVICE);
        return -1;
    }
    LISA_LOGI(LOG_TAG, "%s device ready\n", ADC_DEVICE);

    /* 配置温度传感器通道：使用1.2V参考电压，10-bit分辨率 */
    lisa_adc_channel_config_t temp_config = {
        .reference = LISA_ADC_REF_VDD_1V2,
        .resolution = LISA_ADC_RESOLUTION_10BIT,
    };
    int ret = lisa_adc_channel_setup(adc_dev, ADC_CHANNEL_TEMP, &temp_config);
    if (ret != 0) {
        LISA_LOGE(LOG_TAG, "Error: Failed to configure temperature channel %d (code: %d)\n", ADC_CHANNEL_TEMP, ret);
        return -1;
    }
    LISA_LOGI(LOG_TAG, "Temperature sensor channel %d configured: 1.2V reference, 10-bit resolution\n", ADC_CHANNEL_TEMP);

    /* 配置温度校准参数
     * 注意：这些参数需要根据实际测量环境进行调整
     * - temp_cal: 校准时的环境温度，需考虑芯片自热效应
     * - voltage_cal: 校准温度下测得的传感器电压值
     */
    temp_calibration_t temp_cal = {
        .temp_cal = 29.8f,          // 校准温度
        .voltage_cal = 0.73125f // 校准点传感器电压 (V)
    };

    LISA_LOGI(LOG_TAG, "Start reading temperature sensor (channel %d)...\n\n", ADC_CHANNEL_TEMP);

    while (1) {
        uint16_t temp_raw = 0;
        ret = lisa_adc_read(adc_dev, ADC_CHANNEL_TEMP, &temp_raw);

        if (ret == 0) {
            /* 转换为传感器电压值 (V) */
            float voltage = adc_raw_to_voltage(temp_raw, 1.2f, 10);  // 1.2V 参考, 10-bit

            /* 计算芯片温度 */
            float die_temp = calc_temperature(&temp_cal, voltage);

            LISA_LOGI(LOG_TAG, "Temperature: raw=0x%x (%u), voltage=%fV, temp=%.2f C\n",
                   temp_raw, temp_raw, voltage, die_temp);
        } else {
            LISA_LOGE(LOG_TAG, "Error: Temperature sensor read failed (code: %d)\n", ret);
        }

        vTaskDelay(pdMS_TO_TICKS(1000));
    }

    return 0;
}
```

## src/temp_calc.c
```c
/*
 * Copyright (c) 2025, LISTENAI
 *
 * SPDX-License-Identifier: Apache-2.0
 */

/**
 * @file temp_calc.c
 * @brief 温度传感器计算实现
 */

#include "temp_calc.h"

float adc_raw_to_voltage(uint16_t raw_value, float reference_v, uint8_t resolution)
{
    uint32_t max_value = (1UL << resolution);  // 2^resolution
    return (float)raw_value / (float)max_value * reference_v;
}

float calc_temperature(const temp_calibration_t *cal, float voltage)
{
    if (!cal) {
        return 0.0f;
    }

    /* 计算公式:
     * temperature = temp_cal + (temp_cal + 273.15) / voltage_cal * (voltage - voltage_cal)
     *
     * 公式推导：
     * 1. 传感器电压与绝对温度成正比: voltage / T = k (常数)
     * 2. 在校准点: voltage_cal / T_cal = k
     * 3. 在测量点: voltage / T = k
     * 4. 因此: T = T_cal * (voltage / voltage_cal)
     * 5. 温度变化量: ΔT = T - T_cal = T_cal * (voltage - voltage_cal) / voltage_cal
     * 6. 当前温度(℃): temperature = temp_cal + ΔT
     *
     * 其中 T_cal = temp_cal + 273.15 (绝对温度K)
     */
    float temp_abs_cal = cal->temp_cal + 273.15f;  // 校准点绝对温度 (K)
    float k = temp_abs_cal / cal->voltage_cal;     // 温度-电压转换系数 (K/V)
    float delta_temp = k * (voltage - cal->voltage_cal); // 温度变化量 (K 或 ℃)

    return cal->temp_cal + delta_temp;
}
```

## src/temp_calc.h
```c
/*
 * Copyright (c) 2025, LISTENAI
 *
 * SPDX-License-Identifier: Apache-2.0
 */

/**
 * @file temp_calc.h
 * @brief 温度传感器计算接口
 */

#pragma once

#include <stdint.h>

#ifdef __cplusplus
extern "C" {
#endif

/**
 * @brief 温度传感器校准参数结构体
 *
 * 用于存储温度传感器的校准数据。
 * 温度传感器输出电压与绝对温度成正比关系。
 */
typedef struct {
    float temp_cal;       /**< 校准点温度 (℃) */
    float voltage_cal;    /**< 校准点对应的电压值 (V) */
} temp_calibration_t;

/**
 * @brief 将 ADC 原始值转换为电压
 *
 * @param raw_value     ADC 原始采样值
 * @param reference_v   参考电压 (V)
 * @param resolution    分辨率 (bits)
 *
 * @return 传感器电压值 (V)
 *
 * @example
 * @code
 * uint16_t raw = 600;
 * float voltage = adc_raw_to_voltage(raw, 1.2f, 10);  // 10-bit, 1.2V 参考
 * @endcode
 */
float adc_raw_to_voltage(uint16_t raw_value, float reference_v, uint8_t resolution);

/**
 * @brief 基于传感器电压计算芯片温度
 *
 * 使用单点校准的线性温度计算公式：
 *   temperature = temp_cal + (temp_cal + 273.15) / voltage_cal * (voltage - voltage_cal)
 *
 * 原理说明：
 *   传感器电压与绝对温度成正比: V ∝ T(K)
 *   通过校准点建立电压-温度关系，计算当前温度偏移量
 *
 * @param cal     校准参数结构体指针
 * @param voltage 当前测量的传感器电压值 (V)
 *
 * @return 计算得到的芯片温度 (℃)
 *
 * @note 计算精度依赖于校准参数的准确性
 * @note 建议在稳定温度环境下进行校准
 *
 * @example 使用示例：
 * @code
 * // 定义校准参数（通常在生产时测定）
 * temp_calibration_t cal = {
 *     .temp_cal = 26.3,              // 校准温度 26.3℃
 *     .voltage_cal = 0.70819921875   // 对应电压 0.708V
 * };
 *
 * // 读取 ADC 并转换为电压
 * uint16_t raw;
 * lisa_adc_read(adc_dev, 7, &raw);
 * float voltage = adc_raw_to_voltage(raw, 1.2f, 10);
 *
 * // 计算温度
 * float temperature = calc_temperature(&cal, voltage);
 * @endcode
 */
float calc_temperature(const temp_calibration_t *cal, float voltage);

#ifdef __cplusplus
}
#endif
```
