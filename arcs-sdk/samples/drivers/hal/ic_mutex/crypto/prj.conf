## CMakeLists.txt
```
cmake_minimum_required(VERSION 3.19)

set(CMAKE_EXPORT_COMPILE_COMMANDS ON)

find_package(listenai-cmake REQUIRED HINTS $ENV{ARCS_BASE})

set(IC_MUTEX_CRYPTO_CP_TARGET ic_mutex_crypto_cp)
set(IC_MUTEX_CRYPTO_AP_TARGET ic_mutex_crypto_ap)

project(${IC_MUTEX_CRYPTO_CP_TARGET})

listenai_add_executable(${PROJECT_NAME})
target_sources(${PROJECT_NAME} PRIVATE src/main.c src/ls_crypto.c)

include(ExternalProject)

ExternalProject_Add(
    remote_core
    SOURCE_DIR ${CMAKE_CURRENT_SOURCE_DIR}/remote
    BINARY_DIR ${CMAKE_CURRENT_BINARY_DIR}/remote
    CMAKE_ARGS
        -DCMAKE_BUILD_TYPE=${CMAKE_BUILD_TYPE}
        -DCMAKE_TOOLCHAIN_FILE=${CMAKE_TOOLCHAIN_FILE}
        -DCMAKE_MAKE_PROGRAM=${CMAKE_MAKE_PROGRAM}
        -DBOARD=${BOARD}
        $<$<BOOL:${BOARD_SEARCH_PATH}>:-DBOARD_SEARCH_PATH=${BOARD_SEARCH_PATH}>
    BUILD_ALWAYS 1
    INSTALL_COMMAND ""
)

add_dependencies(${PROJECT_NAME} remote_core)
```

## sample.yaml
```
tests:
  samples.drivers.ic_mutex.crypto:
    programmer: arcs
    runner: uart
    build_extra_args: ""
    images:
      - file: "remote/ic_mutex_crypto_ap.bin"
        address: "0x0"
      - file: "ic_mutex_crypto_cp.bin"
        address: "0xD00000"
    log_analyzer:
      type: "regex"
      pattern: "AP SHA256 sample passed"
```

## prj.conf
```kconfig
# 项目可根据需要在此文件中设置对应的配置

# memory config
CONFIG_MEM_CONFIG=y

CONFIG_MEM_SRAM_BASE=0x20030000
CONFIG_MEM_SRAM_SIZE=0x00010000


CONFIG_MEM_FLASH_BASE=0x30D00000
CONFIG_MEM_FLASH_SIZE=0x00300000

# CP core
CONFIG_ARCS_CP_CORE=y

# C LIB
CONFIG_LINK_OPTION_NONE_SPECS=y

# LSF
CONFIG_ARCS_HAL_LSF=y
CONFIG_IPC_LSF=y
CONFIG_DISK_MEM=n

CONFIG_ARCS_HAL_CRYPTO=y

# CONFIG_ARCS_HAL_IC_MUTEX=n

# HEAP
CONFIG_HEAP_SIZE=0x9700
CONFIG_PSRAM_HEAP_SIZE=0x100000

# CPP
CONFIG_LINK_CPP_RUNTIME_SECTIONS=n
CONFIG_CPP_EXCEPTIONS=n

# Debug
CONFIG_BACK_TRACE=y

# freertos
CONFIG_FREERTOS_STATIC_ALLOCATION_ENABLE=y

# main task
CONFIG_MAIN_TASK_STACK_SIZE=8192
CONFIG_MAIN_TASK_PRIORITY=1

# CP这里一定不能使能，否则会初始化时钟和PSRAM，和AP冲突
CONFIG_BOOT_HART=n
CONFIG_BOOT=n

CONFIG_LOG_BACKEND_IPC_READER=y
```

## src/main.c
```c
#include "stdio.h"
#include <stdbool.h>

// module: ic
#include "ic_message.h"

#include "FreeRTOS.h"

extern void ls_crypto_init(void);
extern void ls_crypto_sha256_test(void);

void ic_mutex_task(void *param)
{
    bool sample_reported = false;

    printf("ic_mutex_task enter...\n");

    ls_crypto_init();

    while (1) {
        ls_crypto_sha256_test();
        if (!sample_reported) {
            printf("IC mutex crypto sample passed\n");
            sample_reported = true;
        }
        vTaskDelay(pdMS_TO_TICKS(10));
    }
}

int main(int argc, char **argv)
{
    ic_message_init();
    printf("ic_message_init done!\n");

    xTaskCreate(ic_mutex_task, "ic_mutex_task",4096, NULL, 6, NULL);

    return 0;
}
```

## src/ls_crypto.c
```c
/*
 * ls_crypto.c
 *
 *  Created on: 2024-11-7
 *
 *      Author: zyyang
 *
 */

#include "stdio.h"
#include "string.h"
#include "lisa_log.h"
#include "Driver_CRYPTO.h"
#if CONFIG_ARCS_HAL_IC_MUTEX
#include "ic_mutex.h"
#endif

#if CONFIG_ARCS_HAL_IC_MUTEX
static IC_Mutex crypto_ic_mutex;
#endif

void *CRYPTO0_Handler = NULL;

static void CRYPTO_Init_Handler(void)
{
    CRYPTO0_Handler = CRYPTO0();
}

static volatile int32_t CRYPTO_Result = CSK_DRIVER_OK;
#ifdef CFG_RTOS
#include "FreeRTOS.h"
#include <semphr.h>

static SemaphoreHandle_t CRYPTO_res_semaphore;
static SemaphoreHandle_t CRYPTO_tsk_semaphore;
static int32_t CRYPTO_EventCallback_RTOS(uint32_t event, int32_t result, void *workspace)
{
    // CLOGD("CRYPTO_EventCallback_RTOS, event:%d", event);
    if (CSK_CRYPTO_EVENT_WAIT_BUSY == event) {
#if CONFIG_ARCS_HAL_IC_MUTEX
        IC_Mutex_acquire(&crypto_ic_mutex);
#else
        // wait other procedure finish
        xSemaphoreTake(CRYPTO_res_semaphore, -1);
#endif
    } else if (CSK_CRYPTO_EVENT_FINISHED == event) {
#if CONFIG_ARCS_HAL_IC_MUTEX
        IC_Mutex_release(&crypto_ic_mutex);
#else
        xSemaphoreGive(CRYPTO_res_semaphore);
#endif
    } else if (CSK_CRYPTO_EVENT_WAIT_DONE == event) {
        xSemaphoreTake(CRYPTO_tsk_semaphore, -1);
        return CRYPTO_Result;
    } else if (CSK_CRYPTO_EVENT_DONE == event) {
        BaseType_t xHigherPriorityTaskWoken = pdFALSE;
        CRYPTO_Result = result;
        xSemaphoreGiveFromISR(CRYPTO_tsk_semaphore, &xHigherPriorityTaskWoken);
    }

    return CSK_DRIVER_OK;
}
#else
static volatile uint32_t CRYPTO_BUSY = 0;
static volatile uint32_t CRYPTO_DONE = 0;
static int32_t CRYPTO_EventCallback_NOS(uint32_t event, int32_t result, void *workspace)
{
    if (CSK_CRYPTO_EVENT_WAIT_BUSY == event) {
        // wait other procedure finish
        while (CRYPTO_BUSY)
            ;
        CRYPTO_BUSY = 1;
    } else if (CSK_CRYPTO_EVENT_FINISHED == event) {
        CRYPTO_BUSY = 0;
    } else if (CSK_CRYPTO_EVENT_WAIT_DONE == event) {
        while (!CRYPTO_DONE)
            ;
        CRYPTO_DONE = 0;
        return CRYPTO_Result;
    } else if (CSK_CRYPTO_EVENT_DONE == event) {
        CRYPTO_Result = result;
        CRYPTO_DONE = 1;
    }

    return CSK_DRIVER_OK;
}
#endif

void ls_crypto_init(void)
{

#ifdef CFG_RTOS
    CRYPTO_res_semaphore = xSemaphoreCreateBinary();
    CRYPTO_tsk_semaphore = xSemaphoreCreateBinary();
    xSemaphoreGive(CRYPTO_res_semaphore);
    // xSemaphoreGive(CRYPTO_tsk_semaphore);
#endif
    CRYPTO_Init_Handler();
#ifndef CFG_RTOS
    CRYPTO_Initialize(CRYPTO0_Handler, CRYPTO_EventCallback_NOS, NULL);
#else
    CRYPTO_Initialize(CRYPTO0_Handler, CRYPTO_EventCallback_RTOS, NULL);
#endif

#if CONFIG_ARCS_HAL_IC_MUTEX
    IC_Mutex_init(&crypto_ic_mutex, IC_MUTEX_SLEEP_WAIT, IC_MUTEX_TYPE_CRYPTO);
#endif
}

#define DATA_LEN 1024
static uint8_t source[DATA_LEN];
static uint8_t dest[32];

void ls_crypto_sha256_test(void)
{
    for (int i = 0; i < DATA_LEN; i++) {
        source[i] = i % 256;
    }
    memset(dest, 0, 32);

    CRYPTO_PowerControl(CRYPTO0_Handler, CSK_CRYPTO_HW_AES_SHA, CSK_POWER_FULL);
    CRYPTO_Control(CRYPTO0_Handler, CSK_CRYPTO_SET_HASH_MODE, CSK_CRYPTO_HASH_SHA256);

    CRYPTO_Hash(CRYPTO0_Handler, (uint32_t *)source, DATA_LEN, (uint32_t *)dest, 0);

    LOGH("SHA256", dest, 32);

    CRYPTO_PowerControl(CRYPTO0_Handler, CSK_CRYPTO_HW_AES_SHA, CSK_POWER_OFF);
}
```
