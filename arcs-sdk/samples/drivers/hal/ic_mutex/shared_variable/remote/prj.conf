## CMakeLists.txt
```
cmake_minimum_required(VERSION 3.19)

set(CMAKE_EXPORT_COMPILE_COMMANDS ON)

find_package(listenai-cmake REQUIRED HINTS $ENV{ARCS_BASE})

project(ic_mutex_shared_variable_ap)

listenai_add_executable(${PROJECT_NAME})

target_sources(${PROJECT_NAME} PRIVATE src/main.c)
```

## prj.conf
```kconfig
# 项目可根据需要在此文件中设置对应的配置
CONFIG_MEM_CONFIG=y

CONFIG_MEM_SRAM_BASE=0x20010000
CONFIG_MEM_SRAM_SIZE=0x00020000

CONFIG_MEM_PSRAM_BASE=0x28000000
CONFIG_MEM_PSRAM_SIZE=0x00800000

CONFIG_MEM_FLASH_BASE=0x30000000
CONFIG_MEM_FLASH_SIZE=0x00200000

# AP core
CONFIG_ARCS_AP_CORE=y
CONFIG_CLOCK_INIT=y
CONFIG_PSRAM_INIT=y

# LSF
CONFIG_ARCS_HAL_LSF=y
CONFIG_IPC_LSF=y
CONFIG_DISK_MEM=n

# LOG UART
CONFIG_LOG=y

# C LIB
CONFIG_LINK_OPTION_NONE_SPECS=y

# HEAP
CONFIG_HEAP_SIZE=0x10000
CONFIG_PSRAM_HEAP_SIZE=0x100000

# CPP
CONFIG_LINK_CPP_RUNTIME_SECTIONS=n
CONFIG_CPP_EXCEPTIONS=n

# Debug
CONFIG_BACK_TRACE=y

# freertos
CONFIG_FREERTOS_STATIC_ALLOCATION_ENABLE=y
CONFIG_FREERTOS_FAST_FUNC_SECTION=".text"

# main task
CONFIG_MAIN_TASK_STACK_SIZE=8192
CONFIG_MAIN_TASK_PRIORITY=1
```

## src/main.c
```c
#include "stdio.h"
#include <string.h>
#include <stdbool.h>
// #include <assert.h>

#include "arcs_ap.h"

// module: ic
#include "ic_mutex.h"
#include "ic_fence.h"
#include "ic_message.h"

#include "FreeRTOS.h"
#include "task.h"
#include "semphr.h"

#define ASSERT(a) \
    if ((a) != true) { \
        printf("ASSERT: %s\n", __FUNCTION__, __LINE__); \
        while(1); \
    }

// 全局: 核间资源. ICFence id: 1
static IC_Mutex shared_ic_mutex;
static ICFenceHandle ic_fence_1;
volatile int gCounter = 0;

void ic_mutex_task(void *param)
{
    int ret;
    bool sample_reported = false;

    printf("ic_mutex_task enter...\n");

    IC_Mutex_init(&shared_ic_mutex, IC_MUTEX_SLEEP_WAIT, IC_MUTEX_TYPE_5);

    // ICFence id:1 - 本测试程序使用
    ic_fence_1 = ICFence_Creator_createObj(1);
    ASSERT(ic_fence_1 != NULL);

    // 对象级的核间同步, 以确认对端已经就绪.
    ICFence_syncWithRemote(ic_fence_1);

    ICFence_notify(ic_fence_1, (uint32_t)(uintptr_t) &gCounter);


    while (1) {
        ret = IC_Mutex_acquire(&shared_ic_mutex);
        ASSERT(ret == IC_OK);

        // 默认: memory_order_seq_cst
        gCounter ++;
        printf("gCounter == %d\n", gCounter);
        if (!sample_reported) {
            printf("AP shared counter sample passed: %d\n", gCounter);
            sample_reported = true;
        }
        
        // atomic_fetch_add_explicit(&gCounter, 1, memory_order_seq_cst);
        
        ret = IC_Mutex_release(&shared_ic_mutex);
        ASSERT(ret == IC_OK);
        
        vTaskDelay(pdMS_TO_TICKS(1000));
        
    }
}

int main(int argc, char **argv)
{
    printf("AP Hard ID: %d\n", CONFIG_HARTID);

#if CONFIG_ARCS_AP_CORE
    #define MEM_CP_FLASH_BASE  (0x30d00000)
    #define MEM_CP_FLASH_SIZE  (0x300000)
    printf("boot cp from address: 0x%x\n", MEM_CP_FLASH_BASE);
    IP_CMN_SYS->REG_N300_CP_RST_ADDR.all = MEM_CP_FLASH_BASE;
    IP_SYSCTRL->REG_SW_RESET_CP0.all = 0xCAFE000A;
#endif

    ic_message_init();
    printf("ic_message_init done!\n");

    xTaskCreate(ic_mutex_task, "ic_mutex_task", 4096, NULL, 6, NULL);

    return 0;
}
```
