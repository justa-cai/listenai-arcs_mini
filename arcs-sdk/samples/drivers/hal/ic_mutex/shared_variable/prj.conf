## CMakeLists.txt
```
cmake_minimum_required(VERSION 3.19)

set(CMAKE_EXPORT_COMPILE_COMMANDS ON)

find_package(listenai-cmake REQUIRED HINTS $ENV{ARCS_BASE})

set(IC_MUTEX_SHARED_VARIABLE_CP_TARGET ic_mutex_shared_variable_cp)
set(IC_MUTEX_SHARED_VARIABLE_AP_TARGET ic_mutex_shared_variable_ap)

project(${IC_MUTEX_SHARED_VARIABLE_CP_TARGET})

listenai_add_executable(${PROJECT_NAME})
target_sources(${PROJECT_NAME} PRIVATE src/main.c)

include(ExternalProject)

ExternalProject_Add(
    remote_core
    SOURCE_DIR ${CMAKE_CURRENT_SOURCE_DIR}/remote
    BINARY_DIR ${CMAKE_CURRENT_BINARY_DIR}/remote
    CMAKE_ARGS
        -DCMAKE_BUILD_TYPE=${CMAKE_BUILD_TYPE}
        -DCMAKE_TOOLCHAIN_FILE=${CMAKE_TOOLCHAIN_FILE}
        -DCMAKE_MAKE_PROGRAM=${CMAKE_MAKE_PROGRAM}
        -DBOARD=${BOARD}
        $<$<BOOL:${BOARD_SEARCH_PATH}>:-DBOARD_SEARCH_PATH=${BOARD_SEARCH_PATH}>
    BUILD_ALWAYS 1
    INSTALL_COMMAND ""
)

add_dependencies(${PROJECT_NAME} remote_core)
```

## sample.yaml
```
tests:
  samples.drivers.ic_mutex.shared_variable:
    programmer: arcs
    runner: uart
    build_extra_args: ""
    images:
      - file: "remote/ic_mutex_shared_variable_ap.bin"
        address: "0x0"
      - file: "ic_mutex_shared_variable_cp.bin"
        address: "0xD00000"
    log_analyzer:
      type: "regex"
      pattern: "IC mutex shared variable sample passed"
```

## prj.conf
```kconfig
# 项目可根据需要在此文件中设置对应的配置

# memory config
CONFIG_MEM_CONFIG=y

CONFIG_MEM_SRAM_BASE=0x20030000
CONFIG_MEM_SRAM_SIZE=0x00010000

CONFIG_MEM_PSRAM_BASE=0x28800000
CONFIG_MEM_PSRAM_SIZE=0x00800000

CONFIG_MEM_FLASH_BASE=0x30D00000
CONFIG_MEM_FLASH_SIZE=0x00300000

# CP core
CONFIG_ARCS_CP_CORE=y

# C LIB
CONFIG_LINK_OPTION_NONE_SPECS=y

# LSF
CONFIG_ARCS_HAL_LSF=y
CONFIG_IPC_LSF=y
CONFIG_DISK_MEM=n

# HEAP
CONFIG_HEAP_SIZE=0xA000
CONFIG_PSRAM_HEAP_SIZE=0x100000

# CPP
CONFIG_LINK_CPP_RUNTIME_SECTIONS=n
CONFIG_CPP_EXCEPTIONS=n

# Debug
CONFIG_BACK_TRACE=y

# freertos
CONFIG_FREERTOS_STATIC_ALLOCATION_ENABLE=y

# main task
CONFIG_MAIN_TASK_STACK_SIZE=8192
CONFIG_MAIN_TASK_PRIORITY=1

# CP这里一定不能使能，否则会初始化时钟和PSRAM，和AP冲突
CONFIG_BOOT=n
CONFIG_ARCS_HAL_IPC_PRINT=y
```

## src/main.c
```c
#include "stdio.h"
#include <string.h>
#include <stdbool.h>

// module: ic
#include "ic_mutex.h"
#include "ic_fence.h"
#include "ic_proxy.h"
#include "ic_message.h"

#include "FreeRTOS.h"
#include "queue.h"
#include "semphr.h"

#define ASSERT(a) \
    if ((a) != true) { \
        printf("ASSERT: %s\n", __FUNCTION__, __LINE__); \
        while(1); \
    }


// 全局: 核间资源. ICFence id: 1
static IC_Mutex shared_ic_mutex;
static ICFenceHandle ic_fence_1;
volatile int *gPtrCounter = NULL;

void ic_mutex_task(void *param)
{
    int ret;
    bool sample_reported = false;

    printf("ic_mutex_task enter...\n");
    IC_Mutex_init(&shared_ic_mutex, IC_MUTEX_SLEEP_WAIT, IC_MUTEX_TYPE_5);

    // 延时一些，等待server端的ICFence对象就绪
    vTaskDelay(pdMS_TO_TICKS(1000));

    // ICFence id:1 - 本测试程序使用
    // 此时server端的ICFence对象已就绪
    ic_fence_1 = (ICFenceHandle) IC_Proxy_getRemoteFence(1);

    // 对象级的核间同步, 以确认对端已经就绪.
    ICFence_syncWithRemote(ic_fence_1);

    ICFence_wait(ic_fence_1, (uint32_t*) &gPtrCounter);

    while (1) {
        ret = IC_Mutex_acquire(&shared_ic_mutex);
        ASSERT(ret == IC_OK);

        // 默认: memory_order_seq_cst
        (*gPtrCounter) ++;
        printf("gCounter == %d\n", *gPtrCounter);
        if (!sample_reported) {
            printf("IC mutex shared variable sample passed\n");
            sample_reported = true;
        }

        // atomic_fetch_add_explicit(&gCounter, 1, memory_order_seq_cst);

        ret = IC_Mutex_release(&shared_ic_mutex);
        ASSERT(ret == IC_OK);

        vTaskDelay(pdMS_TO_TICKS(1000));
    }
}

int main(int argc, char **argv)
{
    printf("CP=======! Hard ID: %d\n", CONFIG_HARTID);

    vTaskDelay(pdMS_TO_TICKS(1000));

    ic_message_init();
    printf("ic_message_init done!\n");

    xTaskCreate(ic_mutex_task, "ic_mutex_task",4096, NULL, 6, NULL);

    return 0;
}
```
