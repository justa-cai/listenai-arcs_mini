## CMakeLists.txt
```
cmake_minimum_required(VERSION 3.13)

set(CMAKE_EXPORT_COMPILE_COMMANDS ON)

find_package(listenai-cmake REQUIRED HINTS $ENV{ARCS_BASE})

if(NOT DEFINED CONFIG_DEFAULT)
    set(CONFIG_DEFAULT "${CMAKE_CURRENT_SOURCE_DIR}/prj.conf")
endif()

project(vaddr_remap_fw_a)

listenai_add_executable(${PROJECT_NAME})

target_sources(${PROJECT_NAME} PRIVATE src/main.c)
```

## Kconfig
```
# Copyright (c) 2025, LISTENAI
# SPDX-License-Identifier: Apache-2.0

osource "$ARCS_BASE/Kconfig"

config VADDR_REMAP_FW_VARIANT_NAME
	string "vaddr remap firmware variant name"
	default "AP"

config VADDR_REMAP_FW_FLASH_OFFSET
	hex "vaddr remap firmware flash offset"
	default 0x20000
```

## prj.conf
```kconfig
CONFIG_LOG=y
CONFIG_PRINTF_LOG_REDIRECT=y
CONFIG_ARCS_AP_CORE=y
CONFIG_MEM_FLASH_BASE=0x08000000
CONFIG_MEM_FLASH_SIZE=0x00800000
CONFIG_MEM_PSRAM_BASE=0x28800000
CONFIG_MEM_PSRAM_SIZE=0x00100000
CONFIG_PSRAM_INIT=n

CONFIG_VADDR_REMAP_FW_VARIANT_NAME="AP"
CONFIG_VADDR_REMAP_FW_FLASH_OFFSET=0x20000
```

## prj_fw_cp.conf
```kconfig
CONFIG_LOG=y
CONFIG_PRINTF_LOG_REDIRECT=y
CONFIG_BOOT=n
CONFIG_BOOT_HART=n
CONFIG_ARCS_CP_CORE=y
CONFIG_MEM_FLASH_BASE=0x08000000
CONFIG_MEM_FLASH_SIZE=0x00800000
CONFIG_MEM_PSRAM_BASE=0x28800000
CONFIG_MEM_PSRAM_SIZE=0x00100000
CONFIG_PSRAM_INIT=n

CONFIG_VADDR_REMAP_FW_VARIANT_NAME="CP"
CONFIG_VADDR_REMAP_FW_FLASH_OFFSET=0x20000
```

## src/main.c
```c
/**
 * vaddr_remap sample firmware — driven by prj_fw_*.conf
 */

#define LOG_TAG "vaddr_fw"

#include <lisa_log.h>

int main(void)
{
    LOGI("========================================");
    LOGI("  >>> Firmware %s running! <<<", CONFIG_VADDR_REMAP_FW_VARIANT_NAME);
    LOGI("  Region base: 0x%08lX", (unsigned long)CONFIG_MEM_FLASH_BASE);
    LOGI("  Flash offset: 0x%05lX", (unsigned long)CONFIG_VADDR_REMAP_FW_FLASH_OFFSET);
    LOGI("========================================");

    while (1) {
        __asm__ volatile("wfi");
    }
}
```
