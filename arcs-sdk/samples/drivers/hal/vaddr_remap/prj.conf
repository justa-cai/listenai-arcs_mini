## CMakeLists.txt
```
cmake_minimum_required(VERSION 3.19)

set(CMAKE_EXPORT_COMPILE_COMMANDS ON)

find_package(listenai-cmake REQUIRED HINTS $ENV{ARCS_BASE})

if(NOT DEFINED CONFIG_DEFAULT)
    set(CONFIG_DEFAULT "${CMAKE_CURRENT_SOURCE_DIR}/prj.conf")
endif()

get_filename_component(SAMPLE_CONFIG_NAME "${CONFIG_DEFAULT}" NAME)

set(FW_CONFIG_PATH "${CMAKE_CURRENT_SOURCE_DIR}/fw/prj.conf")

if(SAMPLE_CONFIG_NAME STREQUAL "prj_jump_to_cp.conf")
    set(FW_CONFIG_PATH "${CMAKE_CURRENT_SOURCE_DIR}/fw/prj_fw_cp.conf")
elseif(NOT SAMPLE_CONFIG_NAME STREQUAL "prj.conf" AND
       NOT SAMPLE_CONFIG_NAME STREQUAL "prj_ap.conf")
    message(FATAL_ERROR "Unsupported vaddr_remap sample config: ${SAMPLE_CONFIG_NAME}")
endif()

project(vaddr_remap_loader)

listenai_add_executable(${PROJECT_NAME})

target_sources(${PROJECT_NAME} PRIVATE src/main.c)

# Build fw_a as external project
include(ExternalProject)

ExternalProject_Add(
    vaddr_remap_fw_a
    SOURCE_DIR ${CMAKE_CURRENT_SOURCE_DIR}/fw
    BINARY_DIR ${CMAKE_CURRENT_BINARY_DIR}/fw_a
    CMAKE_ARGS
        -DCMAKE_BUILD_TYPE=${CMAKE_BUILD_TYPE}
        -DCMAKE_TOOLCHAIN_FILE=${CMAKE_TOOLCHAIN_FILE}
        -DCMAKE_MAKE_PROGRAM=${CMAKE_MAKE_PROGRAM}
        -DCONFIG_DEFAULT=${FW_CONFIG_PATH}
        -DBOARD=${BOARD}
        $<$<BOOL:${BOARD_SEARCH_PATH}>:-DBOARD_SEARCH_PATH=${BOARD_SEARCH_PATH}>
    BUILD_ALWAYS 1
    INSTALL_COMMAND ""
)

add_dependencies(${PROJECT_NAME} vaddr_remap_fw_a)
```

## Kconfig
```
# Copyright (c) 2025, LISTENAI
# SPDX-License-Identifier: Apache-2.0

osource "$ARCS_BASE/Kconfig"

config VADDR_REMAP_SAMPLE_BOOT_VARIANT_NAME
	string "vaddr remap sample boot variant name"
	default "AP"

config VADDR_REMAP_SAMPLE_FW_FLASH_OFFSET
	hex "vaddr remap sample firmware flash offset"
	default 0x20000

config VADDR_REMAP_SAMPLE_BOOT_FW_IN_CP
	bool "boot remapped firmware on CP core"
```

## sample.yaml
```
tests:
  samples.drivers.vaddr_remap.ap:
    programmer: arcs
    runner: uart
    build_extra_args: "-c prj.conf"
    images:
      - file: "vaddr_remap_loader.bin"
        address: "0x0"
      - file: "fw_a/vaddr_remap_fw_a.bin"
        address: "0x20000"
    log_analyzer:
      type: "regex"
      pattern: "Firmware AP running!"

  samples.drivers.vaddr_remap.cp:
    programmer: arcs
    runner: uart
    build_extra_args: "-c prj_jump_to_cp.conf"
    images:
      - file: "vaddr_remap_loader.bin"
        address: "0x0"
      - file: "fw_a/vaddr_remap_fw_a.bin"
        address: "0x20000"
    log_analyzer:
      type: "regex"
      pattern: "Firmware CP running!"
```

## prj.conf
```kconfig
CONFIG_LOG=n
CONFIG_PRINTF_LOG_REDIRECT=n
CONFIG_ARCS_AP_CORE=y
CONFIG_FREERTOS_STACK_HW_CHECK=n
CONFIG_MODULE_FREERTOS=n

CONFIG_LISA_DEVICE=n
CONFIG_LISA_OS=n

CONFIG_CONSOLE=n

CONFIG_CONSOLE_UART_BACKEND=n

CONFIG_VADDR_REMAP_SAMPLE_BOOT_VARIANT_NAME="AP"
CONFIG_VADDR_REMAP_SAMPLE_FW_FLASH_OFFSET=0x20000
```

## prj_jump_to_cp.conf
```kconfig
CONFIG_LOG=y
CONFIG_PRINTF_LOG_REDIRECT=n
CONFIG_ARCS_AP_CORE=y
CONFIG_FREERTOS_STACK_HW_CHECK=n

CONFIG_VADDR_REMAP_SAMPLE_BOOT_VARIANT_NAME="CP"
CONFIG_VADDR_REMAP_SAMPLE_FW_FLASH_OFFSET=0x20000
CONFIG_VADDR_REMAP_SAMPLE_BOOT_FW_IN_CP=y
```

## src/main.c
```c
/*
 * vaddr_remap sample — loader
 *
 * Demonstrates using the vaddr_remap HAL driver to map Region A to a Flash
 * offset, then boot firmware at that virtual address on AP or CP.
 *
 * Flash layout (configured in sample.yaml images):
 *   0x00000  loader (this program, linked at 0x30000000 XIP)
 *   0x20000  fw_a   (linked at Region A: 0x08000000)
 */

#include <stdio.h>

#include "arcs_ap.h"
#include "vaddr_remap.h"

#define SAMPLE_REGION    VADDR_REGION_A
#define FW_FLASH_OFFSET  CONFIG_VADDR_REMAP_SAMPLE_FW_FLASH_OFFSET

typedef void (*entry_fn)(void);

static void setup_flash_mapping(void)
{
    vaddr_remap_init(VADDR_TARGET_FLASH);
    vaddr_remap_map(SAMPLE_REGION, FW_FLASH_OFFSET);
    vaddr_remap_apply();
}

int main(void)
{
    entry_fn fw_entry = (entry_fn)VADDR_REGION_A_BASE;

    setup_flash_mapping();

#if CONFIG_VADDR_REMAP_SAMPLE_BOOT_FW_IN_CP
    IP_CMN_SYS->REG_N300_CP_RST_ADDR.all = VADDR_REGION_A_BASE;
    IP_SYSCTRL->REG_SW_RESET_CP0.all = 0xCAFE000A;
#else
    fw_entry();
#endif

    while (1) {
        __asm__ volatile("wfi");
    }
}
```
