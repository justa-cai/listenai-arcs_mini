## arcs-sdk/samples/drivers/dma2d/sample.yaml
```yaml
tests:
  samples.dma2d:
    programmer: arcs
    runner: uart
    log_analyzer:
      type: "regex"
      pattern: "YUV444 Transfer to RGB888 with DMA2D function Success!"
```

## arcs-sdk/samples/drivers/gpadc/sample.yaml
```yaml
tests:
  samples.gpadc:
    programmer: arcs
    runner: uart
    log_analyzer:
      type: "regex"
      pattern: "Hello, world! GPADC"
```

## arcs-sdk/samples/drivers/gpdma/sample.yaml
```yaml
tests:
  samples.gpdma:
    programmer: arcs
    runner: uart
    log_analyzer:
      type: "regex"
      pattern: "gpdma end"
```

## arcs-sdk/samples/drivers/gpio/input/sample.yaml
```yaml
tests:
  samples.gpio_input:
    programmer: arcs
    runner: uart
    log_analyzer:
      type: "regex"
      pattern: "Hello, world!"
```

## arcs-sdk/samples/drivers/hal/aon_timer/sample.yaml
```yaml
tests:
  samples.aon_timer:
    programmer: arcs
    runner: uart
    log_analyzer:
      type: "regex"
      pattern: "aon_timer end"
```

## arcs-sdk/samples/drivers/hal/aon_wdt/sample.yaml
```yaml
tests:
  samples.aon_wdt:
    programmer: arcs
    runner: uart
    log_analyzer:
      type: "regex"
      pattern: "Aon_Wdt end"
```

## arcs-sdk/samples/drivers/hal/cmu/sample.yaml
```yaml
tests:
  samples.drivers.cmu:
    programmer: arcs
    runner: uart
    log_analyzer:
      type: "regex"
      pattern: "CMU check success"
```

## arcs-sdk/samples/drivers/hal/dualtimer/sample.yaml
```yaml
tests:
  samples.dualtimer:
    programmer: arcs
    runner: uart
    log_analyzer:
      type: "regex"
      pattern: "DUAL_TIMER_Interrupt_Periodic end"
```

## arcs-sdk/samples/drivers/hal/efuse/sample.yaml
```yaml
tests:
  samples.efuse:
    programmer: arcs
    runner: uart
    log_analyzer:
      type: "regex"
      pattern: "eFuse dump complete."
```

## arcs-sdk/samples/drivers/hal/gpio/output/sample.yaml
```yaml
tests:
  samples.gpio_output:
    programmer: arcs
    runner: uart
    log_analyzer:
      type: "regex"
      pattern: "Hello, world!"
```

## arcs-sdk/samples/drivers/hal/spi/sample.yaml
```yaml
tests:
  samples.spi:
    programmer: arcs
    runner: uart
    log_analyzer:
      type: "regex"
      pattern: "Hello, world! SPI"
```

## arcs-sdk/samples/drivers/i2c/slave_scan/sample.yaml
```yaml
tests:
  samples.slave_scan:
    programmer: arcs
    runner: uart
    log_analyzer:
      type: "regex"
      pattern: "Start scanning I2C bus..."
```

## arcs-sdk/samples/drivers/keysense/sample.yaml
```yaml
tests:
  samples.keysense:
    programmer: arcs
    runner: uart
    log_analyzer:
      type: "regex"
      pattern: "Hello, world! KEYSENSE"
```

## arcs-sdk/samples/drivers/pwm/sample.yaml
```yaml
tests:
  samples.pwm:
    programmer: arcs
    runner: uart
    log_analyzer:
      type: "regex"
      pattern: "Hello, world! PWM"
```

## arcs-sdk/samples/drivers/rtc/sample.yaml
```yaml
tests:
  samples.rtc:
    programmer: arcs
    runner: uart
    log_analyzer:
      type: "regex"
      pattern: "Hello, world! RTC"
```

## arcs-sdk/samples/drivers/sysheap/sample.yaml
```yaml
tests:
  samples.sysheap:
    programmer: arcs
    runner: uart
    log_analyzer:
      type: "regex"
      pattern: "sysheap end."
```

## arcs-sdk/samples/drivers/trng/sample.yaml
```yaml
tests:
  samples.trng:
    programmer: arcs
    runner: uart
    log_analyzer:
      type: "regex"
      pattern: "trng interrupt test end!!!!"
```

## arcs-sdk/samples/drivers/uart/sample.yaml
```yaml
tests:
  samples.uart:
    programmer: arcs
    runner: uart
    log_analyzer:
      type: "regex"
      pattern: "Hello, world! UART RX TX"
```

## arcs-sdk/samples/drivers/wdt/sample.yaml
```yaml
tests:
  samples.wdt:
    programmer: arcs
    runner: uart
    log_analyzer:
      type: "regex"
      pattern: "Hello, world! WDT"
```

## arcs-sdk/samples/libraries/collections-c/sample.yaml
```yaml
tests:
  samples.collections_c:
    programmer: arcs
    runner: uart
    log_analyzer:
      type: "regex"
      pattern: "collections-c sample done"
```

## arcs-sdk/samples/libraries/zig/helloworld/sample.yaml
```yaml
tests:
  samples.zig_helloworld:
    programmer: arcs
    runner: uart
    platform_allow:
      - arcs_evb
    log_analyzer:
      type: "regex"
      pattern: "=== Zig Test PASSED ==="
```
