## CMakeLists.txt
```
cmake_minimum_required(VERSION 3.19)

set(CMAKE_EXPORT_COMPILE_COMMANDS ON)

find_package(listenai-cmake REQUIRED HINTS $ENV{ARCS_BASE})

project(app_enter_boot_recovery_upgrade_fw)

if(NOT DEFINED OTA_CP_VERIFY_ADDR)
    message(FATAL_ERROR "OTA_CP_VERIFY_ADDR is required")
endif()
if(NOT DEFINED OTA_CP_VERIFY_MAGIC)
    message(FATAL_ERROR "OTA_CP_VERIFY_MAGIC is required")
endif()

listenai_add_executable(${PROJECT_NAME})
target_sources(${PROJECT_NAME} PRIVATE src/main.c)
target_compile_definitions(${PROJECT_NAME} PRIVATE
    OTA_CP_VERIFY_ADDR=${OTA_CP_VERIFY_ADDR}
    OTA_CP_VERIFY_MAGIC="${OTA_CP_VERIFY_MAGIC}"
)
```

## prj.conf
```kconfig
CONFIG_BOOT=y
CONFIG_BOOT_SECOND_STAGE=y
CONFIG_BOOT_OTA_PACKAGE=y

CONFIG_BOOT_CONTROL_STORE_BASE_ADDR=0x30700000

CONFIG_LISA_DEVICE=y
CONFIG_LISA_FLASH=y
```

## src/main.c
```c
#include <stdbool.h>
#include <stdio.h>
#include <string.h>

#include "FreeRTOS.h"
#include "sys/reboot.h"
#include "task.h"
#include "uboot_recovery_api.h"

#define UPGRADE_VERIFY_MARKER "FLASH OTA upgraded firmware running (AP+CP verified)"
#define UPGRADE_RECOVERY_REQUEST_MARKER "FLASH OTA upgraded firmware requesting soft recovery"
#define UPGRADE_RECOVERY_ARMED_MARKER "FLASH OTA upgraded firmware recovery armed, rebooting"

static bool cp_payload_is_valid(void)
{
    const char expected[] = OTA_CP_VERIFY_MAGIC;
    const void *cp_payload_addr = (const void *)OTA_CP_VERIFY_ADDR;

    return memcmp(cp_payload_addr, expected, sizeof(expected) - 1U) == 0;
}

int main(void)
{
    if (!cp_payload_is_valid()) {
        printf("FLASH OTA CP payload verify failed\n");
        return -1;
    }

    printf("%s\n", UPGRADE_VERIFY_MARKER);
    vTaskDelay(pdMS_TO_TICKS(200));

    printf("%s\n", UPGRADE_RECOVERY_REQUEST_MARKER);
    if (uboot_recovery_request(UBOOT_RECOVERY_MODE_SOFT) != 0) {
        printf("FLASH OTA soft recovery request failed\n");
        return -1;
    }

    printf("%s\n", UPGRADE_RECOVERY_ARMED_MARKER);
    vTaskDelay(pdMS_TO_TICKS(200));
    sys_reboot(SYS_REBOOT_SOFT);
}
```
