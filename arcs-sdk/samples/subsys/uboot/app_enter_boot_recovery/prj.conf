## CMakeLists.txt
```
cmake_minimum_required(VERSION 3.19)

set(CMAKE_EXPORT_COMPILE_COMMANDS ON)

find_package(listenai-cmake REQUIRED HINTS $ENV{ARCS_BASE})

project(arcs)

listenai_add_executable(${PROJECT_NAME})
listenai_include_directories(
    ${CMAKE_CURRENT_SOURCE_DIR}/src
)
target_sources(${PROJECT_NAME} PRIVATE
    src/main.c
)
```

## sample.yaml
```
tests:
  samples.subsys.uboot.app_enter_boot_recovery:
    programmer: arcs
    runner: uart
    images:
      - file: "arcs.bin"
        address: "0x0"
    log_analyzer:
      type: "regex"
      pattern: "boot adb: start reason=soft req"
```

## prj.conf
```kconfig
CONFIG_BOOT=y
CONFIG_BOOT_SECOND_STAGE=y
CONFIG_BOOT_FLASH_SIZE=0x40000

CONFIG_LISA_DEVICE=y
CONFIG_LISA_FLASH=y

# Let the app request boot recovery mode, then expose boot-side ADB as the proof path.
CONFIG_BOOT_ADB=y
CONFIG_BOOT_ADB_SHELL=y
CONFIG_BOOT_ADB_SYNC=y
CONFIG_ADB_MAX_PAYLOAD_SIZE=32768
```

## src/main.c
```c
#include <stdio.h>

#include "FreeRTOS.h"
#include "sys/reboot.h"
#include "task.h"
#include "uboot_recovery_api.h"

#define RECOVERY_LOG_DRAIN_DELAY_MS 200U

static void flush_recovery_log(void)
{
    /* Give the UART log path time to drain before the software reset fires. */
    fflush(stdout);
    vTaskDelay(pdMS_TO_TICKS(RECOVERY_LOG_DRAIN_DELAY_MS));
}

int main(void)
{
    printf("APP enter boot recovery sample running\n");
    flush_recovery_log();

    if (uboot_recovery_request(UBOOT_RECOVERY_MODE_SOFT) != 0) {
        printf("APP request boot recovery mode failed\n");
        return -1;
    }

    printf("APP requested boot recovery mode, rebooting\n");
    flush_recovery_log();
    sys_reboot(SYS_REBOOT_SOFT);
}
```

## src/shell_cfg_user.h
```c
/**
 * @file shell_cfg_user.h
 * @brief Sample-local letter-shell overlay for BOOT_ADB recovery.
 */

#ifndef __SHELL_CFG_USER_H__
#define __SHELL_CFG_USER_H__

#include <stddef.h>
#include <stdint.h>
#include <stdlib.h>

#include "FreeRTOS.h"
#include "task.h"

#define SHELL_DEFAULT_USER "boot"
#define SHELL_SHOW_INFO 0
#define SHELL_TASK_WHILE 0
#define SHELL_CLS_WHEN_LOGIN 0
#define SHELL_HELP_LIST_USER 0
#define SHELL_HELP_LIST_VAR 0
#define SHELL_HELP_LIST_KEY 0

#define SHELL_USING_COMPANION 0
#define SHELL_SUPPORT_END_LINE 1
#define SHELL_ENTER_LF 0
#define SHELL_ENTER_CR 1
#define SHELL_ENTER_CRLF 0
#define SHELL_SCAN_BUFFER 128
#define SHELL_GET_TICK() xTaskGetTickCount()
#define SHELL_USING_LOCK 0
#define SHELL_MALLOC(size) 0
#define SHELL_FREE(obj) 0

#endif
```
