## CMakeLists.txt
```
cmake_minimum_required(VERSION 3.19)

set(CMAKE_EXPORT_COMPILE_COMMANDS ON)

find_package(listenai-cmake REQUIRED HINTS $ENV{ARCS_BASE})

project(uboot_ota_app_only_trigger)

listenai_add_executable(${PROJECT_NAME})
listenai_include_directories(
    ${CMAKE_CURRENT_SOURCE_DIR}/src
)
target_sources(${PROJECT_NAME} PRIVATE
    src/main.c
)
```

## Kconfig
```
# SPDX-License-Identifier: Apache-2.0

osource "$ARCS_BASE/Kconfig"

choice SAMPLE_BOOT_OTA_TRIGGER_SOURCE
	prompt "APP-only OTA trigger source"
	default SAMPLE_BOOT_OTA_TRIGGER_FLASH

config SAMPLE_BOOT_OTA_TRIGGER_FLASH
	bool "Trigger OTA from flash payload"

config SAMPLE_BOOT_OTA_FLASH_PACKAGE_SIZE
	hex "Flash OTA package size"
	depends on SAMPLE_BOOT_OTA_TRIGGER_FLASH
	default 0xFDE4
	help
	  OTA package size passed to uboot_ota_start_from_flash().
	  The default matches the txz generated from the static res/ payload.

config SAMPLE_BOOT_OTA_TRIGGER_TF
	bool "Trigger OTA from TF payload path"

endchoice

config SAMPLE_BOOT_OTA_TRIGGER_TF_PATH
	string "TF OTA package path"
	depends on SAMPLE_BOOT_OTA_TRIGGER_TF
	default "download/update.txz"
	help
	  OTA package path passed to uboot_ota_start_from_tf().
	  The boot side normalizes path prefixes internally.
```

## sample.yaml
```
tests:
  # 仅执行构建，不提供直接板级测试入口
  samples.subsys.uboot_ota.app_only_trigger:
    build_only: true
  samples.subsys.uboot_ota.app_only_trigger.tf:
    build_only: true
    build_extra_args: "-DCONFIG_SAMPLE_BOOT_OTA_TRIGGER_FLASH=n -DCONFIG_SAMPLE_BOOT_OTA_TRIGGER_TF=y"
```

## prj.conf
```kconfig
CONFIG_BOOT=n
CONFIG_BOOT_HART=n

CONFIG_MEM_FLASH_BASE=0x30040000
CONFIG_BOOT_CONTROL_STORE_BASE_ADDR=0x3003E000

CONFIG_BOOT_RECOVERY_API=y
CONFIG_BOOT_OTA_API=y
```

## src/main.c
```c
#include <stdio.h>

#include "FreeRTOS.h"
#include "sys/reboot.h"
#include "task.h"
#include "uboot_ota_api.h"

#define OTA_LOG_DRAIN_DELAY_MS 200U
#define OTA_PAYLOAD_FLASH_OFFSET 0x00600000UL

#if defined(CONFIG_SAMPLE_BOOT_OTA_TRIGGER_FLASH) && \
    !defined(CONFIG_SAMPLE_BOOT_OTA_FLASH_PACKAGE_SIZE)
#error "CONFIG_SAMPLE_BOOT_OTA_FLASH_PACKAGE_SIZE is required for flash OTA trigger"
#endif

#if defined(CONFIG_SAMPLE_BOOT_OTA_TRIGGER_FLASH) && \
    (CONFIG_SAMPLE_BOOT_OTA_FLASH_PACKAGE_SIZE == 0)
#error "FLASH OTA package size must be greater than zero"
#endif

static void flush_ota_log(void)
{
    /* Give the UART path time to flush before the software reset fires. */
    fflush(stdout);
    vTaskDelay(pdMS_TO_TICKS(OTA_LOG_DRAIN_DELAY_MS));
}

#if defined(CONFIG_SAMPLE_BOOT_OTA_TRIGGER_FLASH)
static int trigger_from_flash(void)
{
    printf("APP-only OTA source: flash\n");
    return uboot_ota_start_from_flash(
        OTA_PAYLOAD_FLASH_OFFSET,
        CONFIG_SAMPLE_BOOT_OTA_FLASH_PACKAGE_SIZE
    );
}
#endif

#if defined(CONFIG_SAMPLE_BOOT_OTA_TRIGGER_TF)
static int trigger_from_tf(void)
{
    printf("APP-only OTA source: tf path=%s\n", CONFIG_SAMPLE_BOOT_OTA_TRIGGER_TF_PATH);
    return uboot_ota_start_from_tf(CONFIG_SAMPLE_BOOT_OTA_TRIGGER_TF_PATH);
}
#endif

int main(void)
{
    int ret;

    printf("APP-only OTA trigger sample running\n");
    flush_ota_log();

#if defined(CONFIG_SAMPLE_BOOT_OTA_TRIGGER_FLASH)
    /* Assume the OTA package has already been staged in the flash OTA area. */
    ret = trigger_from_flash();
#elif defined(CONFIG_SAMPLE_BOOT_OTA_TRIGGER_TF)
    /* Assume the OTA package has already been staged at the TF card OTA path. */
    ret = trigger_from_tf();
#else
#error "Select one OTA trigger source"
#endif

    if (ret != 0) {
        printf("APP-only OTA request save failed\n");
        return -1;
    }

    printf("APP-only OTA request saved, rebooting\n");
    flush_ota_log();
    sys_reboot(SYS_REBOOT_SOFT);
}
```
