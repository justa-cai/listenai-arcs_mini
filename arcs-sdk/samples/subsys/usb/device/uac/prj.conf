## CMakeLists.txt
```
cmake_minimum_required(VERSION 3.19)

set(CMAKE_EXPORT_COMPILE_COMMANDS ON)

find_package(listenai-cmake REQUIRED HINTS $ENV{ARCS_BASE})

project(arcs)

listenai_add_executable(${PROJECT_NAME})

# Main source files
target_sources(${PROJECT_NAME} PRIVATE
    src/main.c
    src/mic/mic.c
    src/speaker/speaker.c
    src/uac/uac_device.c
    src/uac/usb_descriptors.c
)

# Include directories
listenai_include_directories(
    ./
    src
    src/mic
    src/speaker
    src/uac
)

# Compiler optimizations
target_compile_options(${PROJECT_NAME} PRIVATE
    -Os
    -Wall
)
```

## Kconfig
```
# Copyright (c) 2026, LISTENAI
# SPDX-License-Identifier: Apache-2.0

osource "$ARCS_BASE/Kconfig"

menu "UAC sample configuration"

config UAC_MIC_SAMPLE_RATE
	int "UAC microphone sample rate"
	default 16000
	range 8000 48000

config UAC_MIC_CHANNELS
	int "UAC microphone channel count"
	default 2
	range 1 2

config UAC_MIC_SAMPLE_BITS
	int "UAC microphone sample bits"
	default 16
	range 16 32
	help
	  Supported values are 16, 24 and 32.

config UAC_SPK_SAMPLE_RATE
	int "UAC speaker sample rate"
	default 16000
	range 8000 48000

config UAC_SPK_CHANNELS
	int "UAC speaker channel count"
	default 1
	range 1 2

config UAC_SPK_SAMPLE_BITS
	int "UAC speaker sample bits"
	default 16
	range 16 32
	help
	  Supported values are 16, 24 and 32.

config UAC_MIC_PERIOD_MS
	int "Microphone USB write period in ms"
	default 1
	range 1 20

config UAC_MIC_RING_MS
	int "LISA audio microphone ring buffer time in ms"
	default 256
	range 16 2000

config UAC_SPK_READ_MS
	int "Speaker USB read period in ms"
	default 1
	range 1 20

config UAC_SPK_RING_MS
	int "USB speaker ring buffer time in ms"
	default 256
	range 16 2000

config UAC_TASK_STACK
	int "UAC task stack size"
	default 2048
	range 1024 8192

config UAC_ENABLE_BOARD_PA
	bool "Enable board speaker PA control"
	default y if BOARD_VENUSA_RD_EVB
	select LISA_AUDIO_PLAY_PA_ENABLE
	help
	  Enable board-level speaker power amplifier control for boards that
	  require it. venusa_rd_evb routes PA_EN to GPIOA0.

config LISA_AUDIO_PLAY_PA_PAD
	default 0 if UAC_ENABLE_BOARD_PA

config LISA_AUDIO_PLAY_PA_PIN
	default 0 if UAC_ENABLE_BOARD_PA

config LISA_AUDIO_PLAY_PA_PULSE_COUNT
	default 0 if UAC_ENABLE_BOARD_PA

config UAC_PLAY_BUFFER_COUNT
	int "LISA audio playback buffer count"
	default 12
	range 2 32

config UAC_PLAY_BUFFER_MS
	int "LISA audio playback buffer duration in ms"
	default 16
	range 1 100

config UAC_RECORD_ANALOG_GAIN
	int "LISA audio record analog gain"
	default 16

config UAC_RECORD_DIGITAL_GAIN
	int "LISA audio record digital gain"
	default 8

config UAC_PLAY_ANALOG_GAIN
	int "LISA audio playback analog gain"
	default 0

config UAC_PLAY_DIGITAL_GAIN
	int "LISA audio playback digital gain"
	default -12

config UAC_PLAY_VOLUME_DIVISOR
	int "UAC host volume attenuation divisor"
	default 4
	range 1 16

config UAC_PLAY_MUTE_DB
	int "UAC host volume mute threshold in dB"
	default -96
	range -100 -1

config UAC_RECORD_DIFFERENTIAL_INPUT
	bool "Use differential microphone input"
	default y

config UAC_RECORD_HPF
	bool "Enable record high-pass filter"
	default y

endmenu
```

## sample.yaml
```
tests:
  samples.usb.device.uac:
    build_only: true
```

## prj.conf
```kconfig
# TinyUSB UAC2 Full-Speed sample: mic 16k/2ch/16bit, speaker 16k/1ch/16bit

# Single-core memory layout for audio/USB samples
CONFIG_MEM_SRAM_SIZE=0x00038000
CONFIG_MEM_IPC_ISOLATED=n
CONFIG_MEM_LUNA_SHARED_SIZE=0x0

# LISA Device Framework
CONFIG_LISA_DEVICE=y
CONFIG_LISA_AUDIO_DEVICE=y

# Memory and system
CONFIG_RINGBUF=y
CONFIG_HEAP_SIZE=0x10000
CONFIG_PSRAM_HEAP_SIZE=0x100000
CONFIG_LINK_OPTION_NOSYS_SPECS=y
CONFIG_MAIN_TASK_STACK_SIZE=4096

# TinyUSB
CONFIG_TINY_USB=y
CONFIG_TINY_USB_USE_CUSTOM_CONFIG_FILE=y
CONFIG_TINY_USB_CONFIG_FILE="tusb_config.h"

# UAC defaults
CONFIG_UAC_MIC_SAMPLE_RATE=16000
CONFIG_UAC_MIC_CHANNELS=2
CONFIG_UAC_MIC_SAMPLE_BITS=16
CONFIG_UAC_SPK_SAMPLE_RATE=16000
CONFIG_UAC_SPK_CHANNELS=1
CONFIG_UAC_SPK_SAMPLE_BITS=16

# Debug
CONFIG_LOG=y
CONFIG_LOG_LEVEL_DEBUG=y
CONFIG_BACK_TRACE=y
```

## venusa_rd_evb_overlay.conf
```kconfig
# Optional board overlay for venusa_rd_evb PA_EN.
# prj.conf stays board-neutral; UAC_ENABLE_BOARD_PA defaults to y on venusa_rd_evb.
CONFIG_UAC_ENABLE_BOARD_PA=y
CONFIG_LISA_AUDIO_PLAY_PA_ENABLE=y
CONFIG_LISA_AUDIO_PLAY_PA_PAD=0
CONFIG_LISA_AUDIO_PLAY_PA_PIN=0
CONFIG_LISA_AUDIO_PLAY_PA_PULSE_COUNT=0
```

## src/main.c
```c
/*
 * Copyright (c) 2026, LISTENAI
 *
 * SPDX-License-Identifier: Apache-2.0
 */

#include "FreeRTOS.h"
#include "task.h"

#include "lisa_device.h"
#include "mic.h"
#include "speaker.h"
#include "uac_device.h"

#define TAG "main"
#include "lisa_log.h"

#define AUDIO_DEVICE_NAME "audio0"

int main(void)
{
    LISA_LOGI(TAG, "TinyUSB UAC2 lisa_audio sample starting");

    lisa_device_t *audio_dev = lisa_device_get(AUDIO_DEVICE_NAME);
    if (audio_dev == NULL) {
        LISA_LOGE(TAG, "failed to get %s", AUDIO_DEVICE_NAME);
        return -1;
    }

    int ret = mic_init(audio_dev);
    if (ret != 0) {
        LISA_LOGE(TAG, "mic_init failed: %d", ret);
        return ret;
    }

    ret = speaker_init();
    if (ret != 0) {
        LISA_LOGE(TAG, "speaker_init failed: %d", ret);
        return ret;
    }

    const uac_device_config_t uac_config = {
        .capture = mic_stream(),
        .playback = speaker_stream(),
    };

    ret = uac_device_start(&uac_config);
    if (ret != 0) {
        LISA_LOGE(TAG, "uac_device_start failed: %d", ret);
        return ret;
    }

    LISA_LOGI(TAG, "TinyUSB UAC2 lisa_audio sample ready");

    while (1) {
        vTaskDelay(pdMS_TO_TICKS(5000));
        LISA_LOGI(TAG, "UAC sample running");
    }

    return 0;
}
```
