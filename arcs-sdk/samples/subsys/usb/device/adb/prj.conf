## Kconfig
```
# Copyright (c) 2025, LISTENAI
# SPDX-License-Identifier: Apache-2.0

osource "$ARCS_BASE/Kconfig"
osource "../../../modules/fs/Kconfig"
```

## prj.conf
```kconfig
# 项目可根据需要在此文件中设置对应的配置

# TinyUSB 配置
CONFIG_TINY_USB=y
CONFIG_TINY_USB_USE_CUSTOM_CONFIG_FILE=y
CONFIG_TINY_USB_CONFIG_FILE="tusb_config.h"

# 文件系统配置
CONFIG_FILE_SYSTEM=y
CONFIG_FATFS_FILESYSTEM=y
CONFIG_DISK_DRIVER=y
CONFIG_DISK_DRIVER_SDMMC=y

# 抽象文件系统
CONFIG_LSFS=y
CONFIG_LSFS_FAT=y

# ADB 配置
CONFIG_TUSB_APP_CLASS=y
CONFIG_ADB_SYNC=y
CONFIG_ADB_PUSH_PULL_DEFAULT_ROOT="/SD:/adb/"
CONFIG_ADB_SHELL=y

# Shell 配置
CONFIG_SDK_MODULE_LETTER_SHELL=y
CONFIG_SDK_MODULE_LETTER_SHELL_CONFIG_FILE="shell_cfg_user.h"

# 系统配置
CONFIG_LINK_OPTION_NOSYS_SPECS=y
CONFIG_DCACHE_ENABLE=y

# 内存配置
CONFIG_PSRAM_HEAP_SIZE=0x300000
CONFIG_HEAP_SIZE=0x10000

# 日志配置
CONFIG_EASYLOGGER_ASYNC_BUF_SIZE=102400
```

## src/fs.c
```c
#include <string.h>
#include "lsfs.h"
#include "disk/disk_access.h"
#include "lisa_sdmmc.h"
#include "log_print.h"

#define RAMDISK_DEVICE      "RAM:"
#define RAMDISK_MOUNT_POINT "/" RAMDISK_DEVICE
#define RAMDISK_FILE        RAMDISK_MOUNT_POINT "/ram.txt"

#define FLASHDISK_DEVICE      "NAND:"
#define FLASHDISK_MOUNT_POINT "/" FLASHDISK_DEVICE
#define FLASHDISK_FILE        FLASHDISK_MOUNT_POINT "/flash.txt"

#define SDMMC_DEVICE      "SD:"
#define SDMMC_MOUNT_POINT "/" SDMMC_DEVICE
#define SDMMC_FILE        SDMMC_MOUNT_POINT "/sdmmc.txt"

static struct lsfs_mount_t ram_lsfs_mnt = {
    .type = LSFS_FATFS,
    .mnt_point = RAMDISK_MOUNT_POINT,
    .fs_data = NULL,
};

static struct lsfs_mount_t flash_lsfs_mnt = {
    .type = LSFS_FATFS,
    .mnt_point = FLASHDISK_MOUNT_POINT,
    .fs_data = NULL,
};

static struct lsfs_mount_t sdmmc_lsfs_mnt = {
    .type = LSFS_FATFS,
    .mnt_point = SDMMC_MOUNT_POINT,
    .fs_data = NULL,
};

static int fs_mount(struct lsfs_mount_t *mp)
{
    int ret;

    ret = lsfs_mount(mp);
    if (ret != 0) {
        LOGD("No file system reformatting");
        ret = lsfs_mkfs(mp->type, &mp->mnt_point[1], NULL, 0);
        if (ret == 0) {
            LOGD("mkfs success");
            ret = lsfs_mount(mp);
        } else {
            LOGD("mkfs failed,fr:%d", ret);
        }
    }

    if (ret != 0) {
        LOGD("Failed to mount filesystem: %d", ret);
        return ret;
    }
    LOGD("%s mounted successfully", mp->mnt_point);
}

static int fs_unmount(struct lsfs_mount_t *mp)
{
    int ret;

    ret = lsfs_unmount(mp);
    if (ret != 0) {
        LOGD("%s unmount failed!\n", mp->mnt_point);
        return ret;
    }
    LOGD("%s unmount success!\n", mp->mnt_point);
    return 0;
}

static int list_dir(const char *path)
{
    struct lsfs_dir_t dir;
    struct lsfs_dirent entry;
    int ret;
    int nfile = 0, ndir = 0;
    /* 初始化目录对象 */
    lsfs_dir_t_init(&dir);

    ret = lsfs_opendir(&dir, path);
    LOGD("%s opendir: %d", path, ret);
    if (ret == 0) {

        while (1) {
            ret = lsfs_readdir(&dir, &entry);
            if (ret != 0 || entry.name[0] == 0) {
                break; /* Error or end of dir */
            }

            if (entry.type == LSFS_DIR_ENTRY_DIR) {
                /* Directory */
                LOGD("   <DIR>   %s", entry.name);
                ndir++;
            } else {
                /* File */
                LOGD("%10lu %s", entry.size, entry.name);
                nfile++;
            }
        }
        lsfs_closedir(&dir);
        LOGD("%d dirs, %d files.", ndir, nfile);
    } else {
        LOGD("Failed to open \"%s\". (%u)", path, ret);
    }
    return ret;
}

int fs_write_read(const char *fullpath)
{
    struct lsfs_file_t file;
    int ret;
    char buffer[64];

    lsfs_file_t_init(&file);
    ret = lsfs_open(&file, fullpath, LSFS_O_CREATE | LSFS_O_TRUNC | LSFS_O_WRITE);
    if (ret != 0) {
        LOGD("Failed to open file: %d", ret);
        return ret;
    }

    ret = lsfs_write(&file, fullpath, strlen(fullpath));
    if (ret != strlen(fullpath)) {
        LOGD("Failed to write to file: %d", ret);
        return ret;
    }
    LOGD("Write to file: %s", fullpath);

    lsfs_close(&file);

    lsfs_file_t_init(&file);
    ret = lsfs_open(&file, fullpath, LSFS_O_READ);
    if (ret != 0) {
        LOGD("Failed to open file for reading: %d", ret);
        return ret;
    }

    ret = lsfs_read(&file, buffer, sizeof(buffer) - 1);
    if (ret <= 0) {
        LOGD("Failed to read from file: %d", ret);
        return ret;
    }

    buffer[ret] = '\0';
    LOGD("Read from file: %s", buffer);

    lsfs_close(&file);

    return 0;
}


int test_lsfs_init()
{
    lisa_sdmmc_probe(lisa_device_get("sdmmc0"));
    disk_init(NULL);
    lsfs_init();

    fs_mount(&sdmmc_lsfs_mnt);
    fs_write_read(SDMMC_FILE);
    list_dir(SDMMC_MOUNT_POINT "/");

    return 0;
}
```

## src/tusb_config.h
```c
/*
 * The MIT License (MIT)
 *
 * Copyright (c) 2019 Ha Thach (tinyusb.org)
 *
 * Permission is hereby granted, free of charge, to any person obtaining a copy
 * of this software and associated documentation files (the "Software"), to deal
 * in the Software without restriction, including without limitation the rights
 * to use, copy, modify, merge, publish, distribute, sublicense, and/or sell
 * copies of the Software, and to permit persons to whom the Software is
 * furnished to do so, subject to the following conditions:
 *
 * The above copyright notice and this permission notice shall be included in
 * all copies or substantial portions of the Software.
 *
 * THE SOFTWARE IS PROVIDED "AS IS", WITHOUT WARRANTY OF ANY KIND, EXPRESS OR
 * IMPLIED, INCLUDING BUT NOT LIMITED TO THE WARRANTIES OF MERCHANTABILITY,
 * FITNESS FOR A PARTICULAR PURPOSE AND NONINFRINGEMENT. IN NO EVENT SHALL THE
 * AUTHORS OR COPYRIGHT HOLDERS BE LIABLE FOR ANY CLAIM, DAMAGES OR OTHER
 * LIABILITY, WHETHER IN AN ACTION OF CONTRACT, TORT OR OTHERWISE, ARISING FROM,
 * OUT OF OR IN CONNECTION WITH THE SOFTWARE OR THE USE OR OTHER DEALINGS IN
 * THE SOFTWARE.
 *
 */

#ifndef _TUSB_CONFIG_H_
#define _TUSB_CONFIG_H_

// #include "tusb_pre_config.h"

#ifdef __cplusplus
 extern "C" {
#endif

//--------------------------------------------------------------------+
// Board Specific Configuration
//--------------------------------------------------------------------+

// RHPort number used for device can be defined by board.mk, default to port 0

#define CFG_TUSB_RHPORT0_MODE (OPT_MODE_DEVICE | OPT_MODE_HIGH_SPEED)
#define CFG_TUSB_MCU          OPT_MCU_ARCS
#define CFG_TUSB_OS           OPT_OS_FREERTOS
#define CFG_TUSB_DEBUG        1

// #define CFG_TUSB_DEBUG_PRINTF log_v
//--------------------------------------------------------------------+
// Common Configuration
//--------------------------------------------------------------------

// defined by compiler flags for flexibility
// CFG_TUSB_MCU is defined by compiler in command line
#ifndef CFG_TUSB_MCU
#error CFG_TUSB_MCU must be defined
#endif

// CFG_TUSB_OS is defined by compiler in command line
#ifndef CFG_TUSB_OS
#error CFG_TUSB_OS must be defined
#endif

// CFG_TUSB_DEBUG is defined by compiler in command line
#ifndef CFG_TUSB_DEBUG
#error CFG_TUSB_DEBUG must be defined
#endif

// Enable Device stack
#define CFG_TUD_ENABLED       1

// Default is max speed that hardware controller could support with on-chip PHY
#define CFG_TUD_MAX_SPEED     OPT_MODE_HIGH_SPEED

/* USB DMA on some MCUs can only access a specific SRAM region with restriction on alignment.
 * Tinyusb use follows macros to declare transferring memory so that they can be put
 * into those specific section.
 * e.g
 * - CFG_TUSB_MEM SECTION : __attribute__ (( section(".usb_ram") ))
 * - CFG_TUSB_MEM_ALIGN   : __attribute__ ((aligned(4)))
 */
#ifndef CFG_TUSB_MEM_SECTION
#define CFG_TUSB_MEM_SECTION
#endif

#ifndef CFG_TUSB_MEM_ALIGN
#define CFG_TUSB_MEM_ALIGN    __attribute__ ((aligned(4)))
#endif

//--------------------------------------------------------------------+
// DEVICE CONFIGURATION
//--------------------------------------------------------------------+

#ifndef CFG_TUD_ENDPOINT0_SIZE
#define CFG_TUD_ENDPOINT0_SIZE    64
#endif

//------------- CLASS -------------//
#define CFG_TUD_CDC              1
#define CFG_TUD_MSC              0
#define CFG_TUD_HID              0
#define CFG_TUD_MIDI             0
#define CFG_TUD_VENDOR           0

// CDC FIFO size of TX and RX
#define CFG_TUD_CDC_RX_BUFSIZE   (TUD_OPT_HIGH_SPEED ? 512 : 64)
#define CFG_TUD_CDC_TX_BUFSIZE   (TUD_OPT_HIGH_SPEED ? 512 : 64)

// CDC Endpoint transfer buffer size, more is faster
#define CFG_TUD_CDC_EP_BUFSIZE   (TUD_OPT_HIGH_SPEED ? 512 : 64)

// MSC Buffer size of Device Mass storage
#define CFG_TUD_MSC_EP_BUFSIZE   512
#define CFG_TUD_TASK_QUEUE_SZ 512

#ifdef __cplusplus
 }
#endif

#endif /* _TUSB_CONFIG_H_ */
```

## src/usb_descriptors.c
```c
#include "tusb.h"
#include "log_print.h"

tusb_desc_device_t const desc_device = {.bLength = sizeof(tusb_desc_device_t),
                                        .bDescriptorType = TUSB_DESC_DEVICE,
                                        .bcdUSB = 0x0200,
                                        .bDeviceClass = 0,
                                        .bDeviceSubClass = 0,
                                        .bDeviceProtocol = 0,
                                        .bMaxPacketSize0 = CFG_TUD_ENDPOINT0_SIZE,
                                        .idVendor = 0x12D1,
                                        .idProduct = 0x107e,
                                        .bcdDevice = 0x0100,
                                        .iManufacturer = 0x01,
                                        .iProduct = 0x02,
                                        .iSerialNumber = 0x03,
                                        .bNumConfigurations = 0x01};

char const *string_desc_arr[] = {
    (const char[]){0x09, 0x04}, // 0: is supported language is English (0x0409)
    "ListenAi",                 // 1: Manufacturer
    "ScanPen",                  // 2: Product
    "0123456789abcdef",         // 3: Serial
    "ADB Interface",            // 4: Interface
};

#define ADB_INTERFACE_INDEX 0
#define ADB_BULK_OUT_EP     0x02
#define ADB_BULK_IN_EP      0x83

#define ADB_DESCRIPTOR(_itfnum, _stridx, _epout, _epin, _epsize)                                                       \
    /* Interface */                                                                                                    \
    9, TUSB_DESC_INTERFACE, _itfnum, 0, 2, TUSB_CLASS_VENDOR_SPECIFIC, 0x42, 0x01, _stridx, /* Endpoint Out */         \
        7, TUSB_DESC_ENDPOINT, _epout, TUSB_XFER_BULK, U16_TO_U8S_LE(_epsize), 0,           /* Endpoint In */          \
        7, TUSB_DESC_ENDPOINT, _epin, TUSB_XFER_BULK, U16_TO_U8S_LE(_epsize), 0

#define CONFIG_TOTAL_LEN (TUD_CONFIG_DESC_LEN + TUD_VENDOR_DESC_LEN)
uint8_t const desc_fs_configuration[] = {
    TUD_CONFIG_DESCRIPTOR(1, 1, 0, CONFIG_TOTAL_LEN, TUSB_DESC_CONFIG_ATT_REMOTE_WAKEUP, 100),
    ADB_DESCRIPTOR(ADB_INTERFACE_INDEX, 4, ADB_BULK_OUT_EP, ADB_BULK_IN_EP, 64),
};

#if TUD_OPT_HIGH_SPEED
uint8_t const desc_hs_configuration[] = {
    TUD_CONFIG_DESCRIPTOR(1, 1, 0, CONFIG_TOTAL_LEN, TUSB_DESC_CONFIG_ATT_REMOTE_WAKEUP, 100),
    ADB_DESCRIPTOR(ADB_INTERFACE_INDEX, 4, ADB_BULK_OUT_EP, ADB_BULK_IN_EP, 512),
};
#endif

uint8_t const *tud_descriptor_configuration_cb(uint8_t index)
{
    (void)index;

#if TUD_OPT_HIGH_SPEED
    return (tud_speed_get() == TUSB_SPEED_HIGH) ? desc_hs_configuration : desc_fs_configuration;
#else
    return desc_fs_configuration;
#endif
}
uint8_t const *tud_descriptor_device_cb(void)
{
    return (uint8_t const *)&desc_device;
}

uint16_t const *tud_descriptor_string_cb(uint8_t index, uint16_t langid)
{
    (void)langid;
    static uint16_t desc_str[32];
    uint8_t chr_count;

    if (index == 0) {
        memcpy(&desc_str[1], string_desc_arr[0], 2);
        chr_count = 1;
    } else {
        if (index >= sizeof(string_desc_arr) / sizeof(string_desc_arr[0])) {
            return NULL;
        }

        const char *str = string_desc_arr[index];
        chr_count = strlen(str);
        if (chr_count > 31) {
            chr_count = 31;
        }

        // Convert ASCII to UTF-16
        for (uint8_t i = 0; i < chr_count; i++) {
            desc_str[1 + i] = str[i];
        }
    }

    // first byte is length (including header), second byte is string type
    desc_str[0] = (TUSB_DESC_STRING << 8) | (2 * chr_count + 2);
    return desc_str;
}
```
