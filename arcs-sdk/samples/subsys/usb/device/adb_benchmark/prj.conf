## CMakeLists.txt
```
cmake_minimum_required(VERSION 3.19)

set(CMAKE_EXPORT_COMPILE_COMMANDS ON)

find_package(listenai-cmake REQUIRED HINTS $ENV{ARCS_BASE})


project(arcs)

listenai_add_executable(${PROJECT_NAME})

target_sources(${PROJECT_NAME} PRIVATE
    src/main.c
    src/fs.c
    src/usb_descriptors.c
)

listenai_include_directories(
    src
)

listenai_link_libraries(lsfs)
listenai_link_libraries(disk)
listenai_link_libraries(elmfat)
```

## sample.yaml
```
tests:
  samples.usb.device.adb_benchmark:
    build_only: true
```

## prj.conf
```kconfig
# TinyUSB configuration
CONFIG_TINY_USB=y
CONFIG_TINY_USB_USE_CUSTOM_CONFIG_FILE=y
CONFIG_TINY_USB_CONFIG_FILE="tusb_config.h"

# File system configuration
CONFIG_FILE_SYSTEM=y
CONFIG_FATFS_FILESYSTEM=y
CONFIG_DISK_DRIVER=y
CONFIG_DISK_DRIVER_FLASH=y
CONFIG_DISK_DRIVER_SDMMC=y
CONFIG_DISK_FLASH_START_ADDR=0x100000
CONFIG_DISK_FLASH_MAX_RW_SIZE=4096
CONFIG_DISK_FLASH_ERASE_ALIGNMENT=4096
CONFIG_DISK_FLASH_ERASE_BLOCK_SIZE=4096
CONFIG_DISK_FLASH_SECTOR_SIZE=512
CONFIG_DISK_FLASH_VOLUME_SIZE=3145728

# LSFS configuration
CONFIG_LSFS=y
CONFIG_LSFS_FAT=y

# ADB configuration
CONFIG_TUSB_APP_CLASS=y
CONFIG_ADB_SYNC=y
CONFIG_ADB_PUSH_PULL_DEFAULT_ROOT="/NAND:/adb_bench/"
CONFIG_ADB_SHELL=y

# Shell configuration
CONFIG_SDK_MODULE_LETTER_SHELL=y
CONFIG_SDK_MODULE_LETTER_SHELL_CONFIG_FILE="shell_cfg_user.h"

# SDMMC public driver usage
CONFIG_LISA_DEVICE=y
CONFIG_LISA_SDMMC_DEVICE=y
CONFIG_LISA_SDMMC_CARD_TYPE_AUTO=y

# System configuration
CONFIG_LINK_OPTION_NOSYS_SPECS=y
CONFIG_DCACHE_ENABLE=y

# Memory configuration
CONFIG_PSRAM_HEAP_SIZE=0x300000
CONFIG_HEAP_SIZE=0x10000

# Logging configuration
CONFIG_EASYLOGGER_ASYNC_BUF_SIZE=102400
```

## src/main.c
```c
#define LOG_TAG "adb_bench"
#include <lisa_log.h>

#include "adb.h"
#include "adb_device.h"
#include "adb_shell.h"
#include "adb_sync.h"
#include "arcs_ap.h"
#include "tusb.h"

#include "FreeRTOS.h"
#include "task.h"

extern int adb_benchmark_fs_init(void);

static void usb_task(void *arg)
{
    (void)arg;

    IP_SYSCTRL->REG_PERI_CLK_CFG6.bit.ENA_USB_CLK = 0x01;
    IP_CMN_SYS->REG_USB_CTRL1.bit.USBPHY_OUTCLKSEL = 0x1;
    IP_CMN_SYS->REG_USB_CTRL1.bit.USBC_CFG_IDDIG = 0x1;
    IP_CMN_SYS->REG_USB_CTRL1.bit.UTMI_DATABUS16_8 = 0x1;

    adb_init();

#if CONFIG_ADB_SHELL
    adb_shell_init();
#endif

#if CONFIG_ADB_SYNC
    adb_sync_init();
#endif

    tud_disconnect();
    tusb_init();
    tud_connect();

    while (1) {
        tud_task();
    }
}

int main(int argc, char **argv)
{
    (void)argc;
    (void)argv;

    LOGI("adb benchmark sample starting");
    if (adb_benchmark_fs_init() != 0) {
        LOGE("adb benchmark: storage preparation incomplete");
    }

    xTaskCreate(usb_task, "usb_task", 1024, NULL, 5, NULL);

    while (1) {
        LOGI("adb benchmark sample running");
        vTaskDelay(pdMS_TO_TICKS(2000));
    }

    return 0;
}
```

## src/fs.c
```c
#include <stdbool.h>
#include <string.h>

#include "IOMuxManager.h"
#include "disk/disk_access.h"
#include "lisa_device.h"
#include "lisa_sdmmc.h"
#include "lsfs.h"
#include "log_print.h"

#define FLASHDISK_DEVICE      "NAND:"
#define FLASHDISK_MOUNT_POINT "/" FLASHDISK_DEVICE
#define FLASH_BENCH_ROOT      FLASHDISK_MOUNT_POINT "/adb_bench"

#define SDMMC_DEVICE          "SD:"
#define SDMMC_MOUNT_POINT     "/" SDMMC_DEVICE
#define SD_BENCH_ROOT         SDMMC_MOUNT_POINT "/adb_bench"

#define SDMMC_CLK_PAD         CSK_IOMUX_PAD_A
#define SDMMC_CLK_PIN         6
#define SDMMC_CMD_PAD         CSK_IOMUX_PAD_A
#define SDMMC_CMD_PIN         7
#define SDMMC_DAT0_PAD        CSK_IOMUX_PAD_A
#define SDMMC_DAT0_PIN        5
#define SDMMC_DAT1_PAD        CSK_IOMUX_PAD_A
#define SDMMC_DAT1_PIN        4
#define SDMMC_DAT2_PAD        CSK_IOMUX_PAD_A
#define SDMMC_DAT2_PIN        9
#define SDMMC_DAT3_PAD        CSK_IOMUX_PAD_A
#define SDMMC_DAT3_PIN        8
#define SDMMC_FUNC            CSK_IOMUX_FUNC_ALTER15

static struct lsfs_mount_t flash_lsfs_mnt = {
    .type = LSFS_FATFS,
    .mnt_point = FLASHDISK_MOUNT_POINT,
    .fs_data = NULL,
};

static struct lsfs_mount_t sdmmc_lsfs_mnt = {
    .type = LSFS_FATFS,
    .mnt_point = SDMMC_MOUNT_POINT,
    .fs_data = NULL,
};

#ifdef CONFIG_BOARD_ARCS_EVB
void lisa_sdio_pinmux(void)
{
    IOMuxManager_PinConfigure(SDMMC_CLK_PAD, SDMMC_CLK_PIN, SDMMC_FUNC);
    IOMuxManager_PinConfigure(SDMMC_CMD_PAD, SDMMC_CMD_PIN, SDMMC_FUNC);
    IOMuxManager_PinConfigure(SDMMC_DAT0_PAD, SDMMC_DAT0_PIN, SDMMC_FUNC);
    IOMuxManager_PinConfigure(SDMMC_DAT1_PAD, SDMMC_DAT1_PIN, SDMMC_FUNC);
    IOMuxManager_PinConfigure(SDMMC_DAT2_PAD, SDMMC_DAT2_PIN, SDMMC_FUNC);
    IOMuxManager_PinConfigure(SDMMC_DAT3_PAD, SDMMC_DAT3_PIN, SDMMC_FUNC);
}
#endif

static int fs_mount(struct lsfs_mount_t *mp)
{
    int ret = lsfs_mount(mp);

    if (ret != 0) {
        LOGW("mount %s failed ret=%d, try mkfs", mp->mnt_point, ret);
        ret = lsfs_mkfs(mp->type, &mp->mnt_point[1], NULL, 0);
        if (ret == 0) {
            ret = lsfs_mount(mp);
        }
    }

    if (ret != 0) {
        LOGE("mount %s failed ret=%d", mp->mnt_point, ret);
        return ret;
    }

    LOGI("%s mounted", mp->mnt_point);
    return 0;
}

static int ensure_dir(const char *path)
{
    struct lsfs_dirent entry = {0};
    int ret = lsfs_stat(path, &entry);

    if (ret == 0) {
        if (entry.type == LSFS_DIR_ENTRY_DIR) {
            return 0;
        }

        LOGE("path exists but is not a directory: %s", path);
        return -1;
    }

    ret = lsfs_mkdir(path);
    if (ret != 0) {
        LOGE("mkdir %s failed ret=%d", path, ret);
        return ret;
    }

    return 0;
}

static bool prepare_flash_target(void)
{
    if (fs_mount(&flash_lsfs_mnt) != 0) {
        LOGE("adb benchmark: flash target mount failed");
        return false;
    }

    if (ensure_dir(FLASH_BENCH_ROOT) != 0) {
        LOGE("adb benchmark: flash target root create failed");
        return false;
    }

    LOGI("adb benchmark: flash ready at /NAND:/adb_bench/");
    return true;
}

static bool prepare_sd_target(void)
{
    lisa_device_t *sdmmc = lisa_device_get("sdmmc0");
    int ret;

    if (sdmmc == NULL) {
        LOGW("adb benchmark: sd not ready (device lookup failed)");
        return false;
    }

    ret = lisa_sdmmc_probe(sdmmc);
    if (ret != LISA_DEVICE_OK) {
        LOGW("adb benchmark: sd not ready (probe ret=%d)", ret);
        return false;
    }

    if (lisa_sdmmc_status(sdmmc) != LISA_SDMMC_STATUS_OK) {
        LOGW("adb benchmark: sd not ready (status=%d)", lisa_sdmmc_status(sdmmc));
        return false;
    }

    if (fs_mount(&sdmmc_lsfs_mnt) != 0) {
        LOGW("adb benchmark: sd not ready (mount failed)");
        return false;
    }

    if (ensure_dir(SD_BENCH_ROOT) != 0) {
        LOGW("adb benchmark: sd not ready (root create failed)");
        return false;
    }

    LOGI("adb benchmark: sd ready at /SD:/adb_bench/");
    return true;
}

int adb_benchmark_fs_init(void)
{
    bool flash_ready;

    disk_init(NULL);
    lsfs_init();

    flash_ready = prepare_flash_target();
    (void)prepare_sd_target();

    return flash_ready ? 0 : -1;
}
```

## src/shell_cfg_user.h
```c
/**
 * @file shell_cfg_user.h
 * @author Letter (nevermindzzt@gmail.com)
 * @brief shell config
 * @version 3.0.0
 * @date 2019-12-31
 * 
 * @copyright (c) 2019 Letter
 * 
 */

#ifndef __SHELL_CFG_USER_H__
#define __SHELL_CFG_USER_H__

#include <stdint.h>
#include <stddef.h>
#include <stdlib.h>
#include "FreeRTOS.h"
#include "task.h"

#define     SHELL_SHOW_INFO             1

#define     SHELL_TASK_WHILE            0

/**
 * @brief 是否使用shell伴生对象
 *        一些扩展的组件(文件系统支持，日志工具等)需要使用伴生对象
 */
#define     SHELL_USING_COMPANION       0


/**
 * @brief 支持shell尾行模式
 */
#define     SHELL_SUPPORT_END_LINE      1


/**
 * @brief 使用LF作为命令行回车触发
 *        可以和SHELL_ENTER_CR同时开启
 */
#define     SHELL_ENTER_LF              0

/**
 * @brief 使用CR作为命令行回车触发
 *        可以和SHELL_ENTER_LF同时开启
 */
#define     SHELL_ENTER_CR              1

/**
 * @brief 使用CRLF作为命令行回车触发
 *        不可以和SHELL_ENTER_LF或SHELL_ENTER_CR同时开启
 */
#define     SHELL_ENTER_CRLF            0

/**
 * @brief shell格式化输入的缓冲大小
 *        为0时不使用shell格式化输入
 * @note shell格式化输入会阻塞shellTask, 仅适用于在有操作系统的情况下使用
 */
#define     SHELL_SCAN_BUFFER          128

/**
 * @brief 获取系统时间(ms)
 *        定义此宏为获取系统Tick，如`HAL_GetTick()`
 * @note 此宏不定义时无法使用双击tab补全命令help，无法使用shell超时锁定
 */
#define     SHELL_GET_TICK()            xTaskGetTickCount()

/**
 * @brief 使用锁
 * @note 使用shell锁时，需要对加锁和解锁进行实现
 */
#define     SHELL_USING_LOCK            0

/**
 * @brief shell内存分配
 *        shell本身不需要此接口，若使用shell伴生对象，需要进行定义
 */
#define     SHELL_MALLOC(size)         0

/**
 * @brief shell内存释放
 *        shell本身不需要此接口，若使用shell伴生对象，需要进行定义
 */
#define     SHELL_FREE(obj)             0

#endif
```
