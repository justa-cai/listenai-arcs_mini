## CMakeLists.txt
```
cmake_minimum_required(VERSION 3.19)

set(CMAKE_EXPORT_COMPILE_COMMANDS ON)

find_package(listenai-cmake REQUIRED HINTS $ENV{ARCS_BASE})


project(arcs)

listenai_add_executable(${PROJECT_NAME})

target_sources(${PROJECT_NAME} PRIVATE
    src/main.c
    src/fs.c
    src/app_usb.c
    src/usb_descriptors.c
)

listenai_include_directories(
    src
)

listenai_link_libraries(lsfs)
listenai_link_libraries(disk)
listenai_link_libraries(elmfat)
```

## Kconfig
```
# SPDX-License-Identifier: Apache-2.0

osource "$ARCS_BASE/Kconfig"
osource "../../../modules/fs/Kconfig"
```

## sample.yaml
```
tests:
  samples.usb.device.cherryusb_adb:
    build_only: true
```

## prj.conf
```kconfig
# 项目可根据需要在此文件中设置对应的配置

# CherryUSB 配置
CONFIG_CHERRYUSB=y
CONFIG_CHERRYUSB_DEVICE=y
CONFIG_CHERRYUSB_APP_CLASS=y
CONFIG_CHERRYUSB_DEVICE_MUSB_LISA=y
# CONFIG_CHERRYUSB_DEVICE_ADB is intentionally NOT set:
# usbd_adb.c is a full ADB protocol stack that conflicts with adb.c.
# adb_device.c implements a raw vendor-endpoint transport so that
# adb.c handles the entire ADB protocol itself.

# 文件系统配置
CONFIG_FILE_SYSTEM=y
CONFIG_FATFS_FILESYSTEM=y
CONFIG_DISK_DRIVER=y
CONFIG_DISK_DRIVER_SDMMC=y

# 抽象文件系统
CONFIG_LSFS=y
CONFIG_LSFS_FAT=y

# ADB 配置
CONFIG_ADB=y
CONFIG_ADB_SYNC=y
CONFIG_ADB_PUSH_PULL_DEFAULT_ROOT="/SD:/adb/"
CONFIG_ADB_SHELL=y
CONFIG_ADB_SHELL_BUFFER_SIZE=1024

# Shell 配置
CONFIG_SDK_MODULE_LETTER_SHELL=y
CONFIG_SDK_MODULE_LETTER_SHELL_CONFIG_FILE="shell_cfg_user.h"

# 系统配置
CONFIG_LINK_OPTION_NOSYS_SPECS=y
CONFIG_DCACHE_ENABLE=y

# 内存配置
CONFIG_PSRAM_HEAP_SIZE=0x300000
CONFIG_HEAP_SIZE=0x10000

# 日志配置
CONFIG_EASYLOGGER_ASYNC_BUF_SIZE=102400
```

## src/main.c
```c
#include "log_print.h"
#include "soc/chip.h"

#include "FreeRTOS.h"
#include "task.h"

#include <stdio.h>

#include "esp_heap_caps_init.h"
#include "esp_heap_caps.h"
#include "heap_memory_layout.h"
#include "heap_private.h"
#include "lisa_log.h"

extern int cherryusb_adb_start(void);

static void heap_travel_cb1(void *start, void *end, multi_heap_info_t *info)
{
    LOGI("%p %p %12d %12d %12d %12d %12d %12d %12d\r\n", start, end, info->allocated_blocks, info->free_blocks,
           info->total_blocks, info->largest_free_block, info->total_allocated_bytes, info->total_free_bytes,
           info->minimum_free_bytes);
}

static void usb_task(void *arg)
{
    (void)arg;
    cherryusb_adb_start();

    while (1) {
        vTaskDelay(pdMS_TO_TICKS(1000));
    }
}

int main(int argc, char **argv)
{
    LOGI("CherryUSB ADB example starting...\n");
    extern int test_lsfs_init(void);

    test_lsfs_init();

    xTaskCreate(usb_task, "usb_task", 1024 * 2, NULL, 5, NULL);
    while (1) {
        LOGI("CherryUSB ADB example running...\n");
        void heap_caps_travel(void (*callback)(void *, void *, multi_heap_info_t *));
        LOGI("%10s %10s %12s %12s %12s %12s %12s %12s %12s\r\n", "[Start]", "[End]", "[Alloc/BK]", "[Free/BK]",
             "[Total/BK]", "[MaxFree/BK]", "[Alloc/B]", "[Free/B]", "[MinFree/B]");
        heap_caps_travel(heap_travel_cb1);

        vTaskDelay(pdMS_TO_TICKS(1000));
    }

    return 0;
}
```

## src/app_usb.c
```c
#include "log_print.h"
#include "soc/chip.h"
#include "lisa_log.h"

#include "usbd_core.h"
#include "adb.h"
#include "adb_device.h"
#include "adb_shell.h"
#include "adb_sync.h"

#include "FreeRTOS.h"
#include "task.h"

extern const struct usb_descriptor cherryusb_adb_descriptor;
extern const uint8_t g_adb_in_ep;
extern const uint8_t g_adb_out_ep;

static uint8_t g_usb_busid;
static struct usbd_interface adb_intf;

static void usbd_event_handler(uint8_t busid, uint8_t event)
{
    (void)busid;
    switch (event) {
    case USBD_EVENT_RESET:
        LOGI("USB reset\n");
        break;
    case USBD_EVENT_CONNECTED:
        LOGI("USB connected\n");
        break;
    case USBD_EVENT_DISCONNECTED:
        LOGI("USB disconnected\n");
        break;
    case USBD_EVENT_CONFIGURED:
        LOGI("USB configured\n");
        break;
    default:
        break;
    }
}

int cherryusb_adb_start(void)
{
#if defined(CONFIG_SOC_ARCS) && (CONFIG_SOC_ARCS == 1)
    IP_SYSCTRL->REG_PERI_CLK_CFG6.bit.ENA_USB_CLK = 0x01;
#elif defined(CONFIG_SOC_VENUSA) && (CONFIG_SOC_VENUSA == 1)
    IP_CMN_SYSCFG->REG_PERI_CLK_CFG7.bit.ENA_USB_CLK = 0x01;
#endif
    IP_CMN_SYS->REG_USB_CTRL1.bit.USBPHY_OUTCLKSEL = 0x1;
    IP_CMN_SYS->REG_USB_CTRL1.bit.USBC_CFG_IDDIG = 0x1;
    IP_CMN_SYS->REG_USB_CTRL1.bit.UTMI_DATABUS16_8 = 0x1;

    usbd_desc_register(g_usb_busid, &cherryusb_adb_descriptor);
    usbd_add_interface(g_usb_busid,
                       adb_dev_init_intf(g_usb_busid, &adb_intf,
                                         g_adb_in_ep, g_adb_out_ep));

    adb_init();
#if CONFIG_ADB_SHELL
    adb_shell_init();
#endif
#if CONFIG_ADB_SYNC
    adb_sync_init();
#endif

    usbd_initialize(g_usb_busid, USBC_BASE, usbd_event_handler);
    LOGI("CherryUSB ADB initialized\n");
    return 0;
}
```

## src/usb_config.h
```c
/*
 * Copyright (c) 2026, LISTENAI
 *
 * SPDX-License-Identifier: Apache-2.0
 */
#ifndef CHERRYUSB_ADB_SAMPLE_USB_CONFIG_H
#define CHERRYUSB_ADB_SAMPLE_USB_CONFIG_H

#include <stdio.h>

#define CONFIG_USB_PRINTF(...) printf(__VA_ARGS__)

#ifndef CONFIG_USB_DBG_LEVEL
#define CONFIG_USB_DBG_LEVEL USB_DBG_WARNING
#endif

#define CONFIG_USB_PRINTF_COLOR_ENABLE

#ifndef CONFIG_USB_ALIGN_SIZE
#define CONFIG_USB_ALIGN_SIZE 4
#endif

#define USB_NOCACHE_RAM_SECTION __attribute__((section(".fast.bss")))

#ifndef CONFIG_USBDEV_REQUEST_BUFFER_LEN
#define CONFIG_USBDEV_REQUEST_BUFFER_LEN 512
#endif

#ifndef CONFIG_USBDEV_EPX_BUFFER_MINLEN
#define CONFIG_USBDEV_EPX_BUFFER_MINLEN 64
#endif

#define CONFIG_USBDEV_EP0_INDATA_NO_COPY
#define CONFIG_USBDEV_ADVANCE_DESC

#define CONFIG_USBDEV_MAX_BUS  1
#define CONFIG_USBDEV_EP_NUM   8
#define CONFIG_USB_MUSB_EP_NUM 8

#define CONFIG_USB_HS

#endif
```

## src/usb_descriptors.c
```c
#include "usbd_core.h"
#include "usbd_adb.h"

#include <string.h>

#define ADB_IN_EP  0x83
#define ADB_OUT_EP 0x02

#ifdef CONFIG_USB_HS
#define ADB_EP_MPS 512
#else
#define ADB_EP_MPS 64
#endif

#define USB_VID 0x12D1
#define USB_PID 0x107e
#define ADB_DESC_SIZE 23
#define USB_CONFIG_SIZE_ADB (9 + ADB_DESC_SIZE)

enum {
    ITF_ADB = 0,
    ITF_ADB_TOTAL,
};

static const uint8_t device_descriptor[] = {
    USB_DEVICE_DESCRIPTOR_INIT(USB_2_0,
                               0x00, 0x00, 0x00,
                               USB_VID, USB_PID,
                               0x0100,
                               0x01)
};

static const uint8_t config_descriptor[] = {
    USB_CONFIG_DESCRIPTOR_INIT(USB_CONFIG_SIZE_ADB,
                               ITF_ADB_TOTAL,
                               0x01,
                               USB_CONFIG_BUS_POWERED,
                               100),
    ADB_DESCRIPTOR_INIT(ITF_ADB, ADB_IN_EP, ADB_OUT_EP, ADB_EP_MPS),
};

static const uint8_t device_quality_descriptor[] = {
    USB_DEVICE_QUALIFIER_DESCRIPTOR_INIT(USB_2_0, 0x00, 0x00, 0x00, 0x01),
};

static const char *string_descriptors[] = {
    (const char[]){ 0x09, 0x04 },
    "ListenAi",
    "ScanPen",
    "0123456789abcdef",
    "ADB Interface",
};

#define STRING_DESC_COUNT (sizeof(string_descriptors) / sizeof(string_descriptors[0]))

static const uint8_t *device_descriptor_callback(uint8_t speed)
{
    (void)speed;
    return device_descriptor;
}

static const uint8_t *config_descriptor_callback(uint8_t speed)
{
    (void)speed;
    return config_descriptor;
}

static const uint8_t *device_quality_descriptor_callback(uint8_t speed)
{
    (void)speed;
    return device_quality_descriptor;
}

static const char *string_descriptor_callback(uint8_t speed, uint8_t index)
{
    (void)speed;

    if (index >= STRING_DESC_COUNT) {
        return NULL;
    }

    return string_descriptors[index];
}

const struct usb_descriptor cherryusb_adb_descriptor = {
    .device_descriptor_callback = device_descriptor_callback,
    .config_descriptor_callback = config_descriptor_callback,
    .device_quality_descriptor_callback = device_quality_descriptor_callback,
    .string_descriptor_callback = string_descriptor_callback,
};

const uint8_t g_adb_in_ep = ADB_IN_EP;
const uint8_t g_adb_out_ep = ADB_OUT_EP;
```
