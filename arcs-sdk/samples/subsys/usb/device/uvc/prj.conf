## CMakeLists.txt
```
cmake_minimum_required(VERSION 3.19)

set(CMAKE_EXPORT_COMPILE_COMMANDS ON)

find_package(listenai-cmake REQUIRED HINTS $ENV{ARCS_BASE})

project(arcs)

listenai_add_executable(${PROJECT_NAME})

# Main source files
target_sources(${PROJECT_NAME} PRIVATE 
    src/main.c
    src/camera/video_camera.c
    src/uvc/uvc_stream.c
    src/uvc/usb_descriptors.c
)

# Include directories
listenai_include_directories(
    ./
    src
    src/camera
    src/uvc
)

# Compiler optimizations
target_compile_options(${PROJECT_NAME} PRIVATE
    -Os
    -Wall
)
```

## Kconfig
```
# Copyright (c) 2025, LISTENAI
# SPDX-License-Identifier: Apache-2.0

osource "$ARCS_BASE/Kconfig"

config IMAGE_WIDTH
	int "iamge width"
	default 640

config IMAGE_HEIGHT
	int "image height"
	default 480

config IMAGE_FPS
	int "image fps"
	default 15
```

## prj.conf
```kconfig
# 项目可根据需要在此文件中设置对应的配置

# 内存配置
CONFIG_PSRAM_HEAP_SIZE=0x700000

# LISA 设备配置
CONFIG_LISA_DEVICE=y
CONFIG_LISA_GPIO_DEVICE=y
CONFIG_LISA_GPIOA=y
CONFIG_LISA_GPIOB=y
CONFIG_LISA_I2C=y
CONFIG_LISA_I2C0=y
CONFIG_LISA_SPI_DEVICE=y
CONFIG_LISA_SPI0=y

# 摄像头配置
CONFIG_LISA_CAMERA_DEVICE=y
CONFIG_LISA_CAMERA_BUS_DVP=y
CONFIG_LISA_CAMERA_SENSOR_GC0328=y

# TinyUSB 配置
CONFIG_TINY_USB=y
CONFIG_TINY_USB_USE_CUSTOM_CONFIG_FILE=y
CONFIG_TINY_USB_CONFIG_FILE="tusb_config.h"

# 工作队列配置
CONFIG_WORK_QUEUE=y

# 日志配置
CONFIG_LOG=y

# 系统配置
CONFIG_LINK_OPTION_NOSYS_SPECS=y
```

## src/main.c
```c
/*
 * Copyright (c) 2025, LISTENAI
 *
 * SPDX-License-Identifier: Apache-2.0
 */

/**
 * @file main.c
 * @brief Camera to UVC streaming demo
 *
 */

#include <stdbool.h>
#include <stdint.h>

#include "FreeRTOS.h"
#include "task.h"

#include "camera/video_camera.h"
#include "uvc/uvc_stream.h"

#define TAG "main"
#include <lisa_log.h>

static void on_frame_captured(camera_frame_t *frame, void *user_data)
{
    (void)user_data;
    
    LISA_LOGD(TAG, "camera buf:0x%p, len: %d, w:%d, h:%d, f:%d", 
                    frame->buffer, 
                    frame->length,
                    frame->width,
                    frame->height,
                    frame->format);

    uvc_stream_send_data((video_info_t *)frame);
}

int main(void)
{
    int ret;

    LISA_LOGI(TAG, "=== Camera UVC Streaming Demo");
    LISA_LOGI(TAG, "Resolution: %dx%d @ %d fps", CONFIG_IMAGE_WIDTH, CONFIG_IMAGE_HEIGHT, CONFIG_IMAGE_FPS);

    /* Step 1: Initialize Camera */
    camera_config_t config = {
        .width = CONFIG_IMAGE_WIDTH,
        .height = CONFIG_IMAGE_HEIGHT,
        .format = LISA_CAMERA_PIXFMT_YUV422,
    };
    ret = video_camera_init(&config);
    if (ret != 0) {
        LISA_LOGE(TAG, "Camera init failed");
        return -1;
    }

    /* Step 2: Initialize UVC */
    ret = uvc_stream_init();
    if (ret != 0) {
        LISA_LOGE(TAG, "UVC init failed");
        return -1;
    }
    
    video_camera_register_callback(on_frame_captured, NULL);

    ret = video_camera_start_capture();
    if (ret != 0) {
        LISA_LOGE(TAG, "Camera start failed");
        return -1;
    }

    LISA_LOGI(TAG, "Camera capture started");

    while (1) {
        vTaskDelay(pdMS_TO_TICKS(5000));
    }

    return 0;
}
```
