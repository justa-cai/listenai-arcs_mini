## CMakeLists.txt
```
cmake_minimum_required(VERSION 3.19)

set(CMAKE_EXPORT_COMPILE_COMMANDS ON)

find_package(listenai-cmake REQUIRED HINTS $ENV{ARCS_BASE})

project(arcs)

listenai_add_executable(${PROJECT_NAME})

target_sources(${PROJECT_NAME} PRIVATE
    src/ec801e_usb_at.c
    src/ec801e_usb_at_parse.c
    src/main.c
    src/net_probe.c
    src/net_probe_checks.c
)

listenai_include_directories(
    src
)

target_compile_options(${PROJECT_NAME} PRIVATE
    -Os
)
listenai_code_relocate(LIBRARY chryusb LOCATION PSRAM)
```

## sample.yaml
```
tests:
  samples.usb.host.cherryusb_ec801e_ecm:
    build_only: true
```

## prj.conf
```kconfig
# CherryUSB Host EC801E ECM Sample Configuration

CONFIG_MEM_IPC_ISOLATED=n
CONFIG_MEM_LUNA_SHARED_SIZE=0x0

# CherryUSB 配置
CONFIG_CHERRYUSB=y
CONFIG_CHERRYUSB_HOST=y
CONFIG_CHERRYUSB_HOST_MUSB_LISA=y
CONFIG_CHERRYUSB_HOST_CDC_ECM=y
CONFIG_CHERRYUSB_HOST_GSM=y

# lwIP
CONFIG_LWIP=y
CONFIG_LWIP_OPTION_LWIP_DNS=y
CONFIG_LWIP_OPTION_SO_REUSE=y

# 日志配置
CONFIG_LOG=y

# 系统配置
CONFIG_LINK_OPTION_NOSYS_SPECS=y

# Debug
CONFIG_BACK_TRACE=y
```

## src/main.c
```c
/*
 * Copyright (c) 2026, ListenAI
 *
 * SPDX-License-Identifier: Apache-2.0
 */

#include <stdio.h>

#include "ClockManager.h"
#include "arcs_ap.h"

#include "FreeRTOS.h"
#include "task.h"

#include "lwip/tcpip.h"

#include "sys_init.h"
#include "usbh_core.h"

#include "ec801e_usb_at.h"
#include "net_probe.h"
#include "usb_config.h"

static const char *usb_event_name(uint8_t event)
{
    switch (event) {
    case 1:
        return "CONNECTED";
    case 2:
        return "DISCONNECTED";
    case 3:
        return "REMOVED";
    default:
        return "OTHER";
    }
}

static void usbh_event_handler(uint8_t busid, uint8_t hub_index, uint8_t hub_port,
                               uint8_t intf, uint8_t event)
{
    printf("[USB] bus=%u hub=%u port=%u intf=%u event=%u (%s)\r\n",
           busid, hub_index, hub_port, intf, event, usb_event_name(event));
}

int main(void)
{
    printf("\r\n");
    printf("========================================\r\n");
    printf("  CherryUSB Host EC801E ECM Example\r\n");
    printf("========================================\r\n");
    printf("[INFO] Expected modem USB ID: 2c7c:0903\r\n");
    printf("[INFO] USB AT recovery target: intf=3 (vendor AT interface)\r\n");
    printf("[INFO] Required PDP precondition: CGDCONT(cid=1,APN) is already valid\r\n");
    printf("[INFO] Initializing lwIP core...\r\n");

    tcpip_init(NULL, NULL);

    printf("[INFO] Initializing USB Host...\r\n");
    usbh_initialize(0, 0x41000000UL, usbh_event_handler);

    printf("[INFO] USB Host initialized\r\n");
    printf("[INFO] Connect EC801E to the USB_ARCS host port\r\n");

    printf("[INFO] Preparing EC801E over USB AT interface...\r\n");
    if (ec801e_usb_prepare_for_ecm() < 0) {
        printf("[ERROR] Failed to prepare EC801E USB ECM mode\r\n");
        while (1) {
            vTaskDelay(pdMS_TO_TICKS(3000));
        }
    }

    ec801e_net_probe_start();

    while (1) {
        vTaskDelay(pdMS_TO_TICKS(5000));
    }

    return 0;
}

static int usb_host_init(void)
{
    printf("[INIT] Configuring USB PHY for Host mode...\r\n");

    IP_CMN_SYS->REG_USB_CTRL1.bit.USBPHY_OUTCLKSEL = 0x1;
    IP_SYSCTRL->REG_PERI_CLK_CFG6.bit.ENA_USB_CLK = 0x1;
    IP_CMN_SYS->REG_USB_CTRL1.bit.USBC_CFG_IDDIG = 0x0;
    IP_CMN_SYS->REG_USB_CTRL1.bit.UTMI_DATABUS16_8 = 0x1;

    printf("[INIT] USB Host PHY configured:\r\n");
    printf("       - IDDIG = 0 (Host mode)\r\n");
    printf("       - Clock enabled\r\n");
    printf("       - 16-bit data bus\r\n");
    return 0;
}

SYS_INIT(usb_host_init, SYS_INIT_LEVEL_PRE_DEVICES_INIT, 0);
```

## src/ec801e_usb_at.c
```c
/*
 * Copyright (c) 2026, ListenAI
 *
 * SPDX-License-Identifier: Apache-2.0
 */

#include "ec801e_usb_at.h"

#include <stdbool.h>
#include <stdio.h>
#include <string.h>

#include "FreeRTOS.h"
#include "task.h"

#include "usbh_core.h"
#include "usbh_serial.h"

#include "ec801e_usb_at_parse.h"

#define EC801E_USB_VID                  0x2c7c
#define EC801E_USB_PID_ECM              0x0903
#define EC801E_USB_AT_INTF_NUM          3
#define EC801E_USB_AT_MAX_TTYS          4
#define EC801E_USB_AT_CMD_BUF_SIZE      64
#define EC801E_USB_AT_RESP_BUF_SIZE     512
#define EC801E_USB_AT_BOOT_DELAY_MS     3000
#define EC801E_USB_AT_SCAN_DELAY_MS     500
#define EC801E_USB_AT_POLL_INTERVAL_MS  20
#define EC801E_USB_AT_CMD_TIMEOUT_MS    3000
#define EC801E_USB_AT_LINK_TIMEOUT_MS   15000

struct ec801e_usb_at_port {
    struct usbh_serial *serial;
    char devname[16];
};

static void ec801e_usb_at_close(struct ec801e_usb_at_port *port)
{
    if (port->serial != NULL) {
        usbh_serial_close(port->serial);
        port->serial = NULL;
    }
    port->devname[0] = '\0';
}

static int ec801e_usb_at_configure(struct usbh_serial *serial)
{
    struct usbh_serial_termios termios;

    memset(&termios, 0, sizeof(termios));
    termios.baudrate = 115200;
    termios.stopbits = USBH_SERIAL_STOPBITS_1;
    termios.parity = USBH_SERIAL_PARITY_NONE;
    termios.databits = USBH_SERIAL_DATABITS_8;
    termios.rtscts = false;
    termios.rx_timeout = EC801E_USB_AT_POLL_INTERVAL_MS;
    return usbh_serial_control(serial, USBH_SERIAL_CMD_SET_ATTR, &termios);
}

static int ec801e_usb_at_try_open(struct ec801e_usb_at_port *port)
{
    char devname[16];

    for (int i = 0; i < EC801E_USB_AT_MAX_TTYS; ++i) {
        struct usbh_serial *serial;

        (void)snprintf(devname, sizeof(devname), "/dev/ttyUSB%d", i);
        serial = usbh_serial_open(devname, USBH_SERIAL_O_RDWR | USBH_SERIAL_O_NONBLOCK);
        if (serial == NULL) {
            continue;
        }

        if (serial->hport->device_desc.idVendor != EC801E_USB_VID ||
            serial->hport->device_desc.idProduct != EC801E_USB_PID_ECM ||
            serial->intf != EC801E_USB_AT_INTF_NUM) {
            usbh_serial_close(serial);
            continue;
        }

        if (ec801e_usb_at_configure(serial) < 0) {
            usbh_serial_close(serial);
            continue;
        }

        port->serial = serial;
        strncpy(port->devname, devname, sizeof(port->devname) - 1);
        port->devname[sizeof(port->devname) - 1] = '\0';
        printf("[AT] Using USB AT interface %u via %s\r\n", serial->intf, port->devname);
        return 0;
    }

    return -1;
}

static int ec801e_usb_at_open_wait(struct ec801e_usb_at_port *port)
{
    bool announced = false;

    while (1) {
        if (ec801e_usb_at_try_open(port) == 0) {
            return 0;
        }

        if (!announced) {
            printf("[AT] Waiting for EC801E USB AT interface (intf=%u)...\r\n", EC801E_USB_AT_INTF_NUM);
            announced = true;
        }
        vTaskDelay(pdMS_TO_TICKS(EC801E_USB_AT_SCAN_DELAY_MS));
    }
}

static void ec801e_usb_at_drain(struct usbh_serial *serial)
{
    char scratch[64];

    while (usbh_serial_read(serial, scratch, sizeof(scratch)) > 0) {
    }
}

static bool ec801e_usb_at_response_has_ok(const char *response)
{
    return strstr(response, "\r\nOK\r\n") != NULL ||
           strstr(response, "\nOK\r\n") != NULL ||
           strcmp(response, "OK\r\n") == 0;
}

static bool ec801e_usb_at_response_has_error(const char *response)
{
    return strstr(response, "ERROR") != NULL;
}

static int ec801e_usb_at_command(struct usbh_serial *serial, const char *command,
                                 char *response, size_t response_size, uint32_t timeout_ms)
{
    TickType_t start;
    char txbuf[EC801E_USB_AT_CMD_BUF_SIZE];
    char rxbuf[64];
    size_t used = 0;
    int len;

    if (serial == NULL || command == NULL || response == NULL || response_size == 0) {
        return -1;
    }

    ec801e_usb_at_drain(serial);

    len = snprintf(txbuf, sizeof(txbuf), "%s\r\n", command);
    if (len <= 0 || (size_t)len >= sizeof(txbuf)) {
        return -1;
    }

    len = usbh_serial_write(serial, txbuf, (uint32_t)len);
    if (len <= 0 || (size_t)len != strlen(txbuf)) {
        return -1;
    }

    response[0] = '\0';
    start = xTaskGetTickCount();
    while ((uint32_t)((xTaskGetTickCount() - start) * portTICK_PERIOD_MS) < timeout_ms) {
        int ret;

        ret = usbh_serial_read(serial, rxbuf, sizeof(rxbuf) - 1);
        if (ret > 0) {
            size_t copy_len = (size_t)ret;

            rxbuf[ret] = '\0';
            if ((used + copy_len) >= (response_size - 1)) {
                copy_len = (response_size - 1) - used;
            }
            memcpy(&response[used], rxbuf, copy_len);
            used += copy_len;
            response[used] = '\0';

            if (ec801e_usb_at_response_has_ok(response)) {
                return 0;
            }
            if (ec801e_usb_at_response_has_error(response)) {
                return -1;
            }
        } else if (ret < 0) {
            return -1;
        }

        vTaskDelay(pdMS_TO_TICKS(EC801E_USB_AT_POLL_INTERVAL_MS));
    }

    return -1;
}

static int ec801e_usb_at_expect_ok(struct usbh_serial *serial, const char *command)
{
    char response[EC801E_USB_AT_RESP_BUF_SIZE];
    int ret;

    printf("[AT] >> %s\r\n", command);
    ret = ec801e_usb_at_command(serial, command, response, sizeof(response), EC801E_USB_AT_CMD_TIMEOUT_MS);
    if (ret < 0) {
        printf("[AT] Command failed: %s\r\n[AT] Response: %s\r\n", command, response);
        return ret;
    }
    return 0;
}

static int ec801e_usb_at_query_qcfg(struct usbh_serial *serial, const char *key, int *value)
{
    char command[32];
    char response[EC801E_USB_AT_RESP_BUF_SIZE];
    int ret;

    snprintf(command, sizeof(command), "AT+QCFG=\"%s\"", key);
    printf("[AT] >> %s\r\n", command);
    ret = ec801e_usb_at_command(serial, command, response, sizeof(response), EC801E_USB_AT_CMD_TIMEOUT_MS);
    if (ret < 0) {
        printf("[AT] Query failed: %s\r\n[AT] Response: %s\r\n", command, response);
        return ret;
    }

    ret = ec801e_parse_qcfg_value(response, key, value);
    if (ret < 0) {
        printf("[AT] Failed to parse %s response: %s\r\n", key, response);
        return ret;
    }
    printf("[AT] %s=%d\r\n", key, *value);
    return 0;
}

static int ec801e_usb_at_query_qnetdevctl(struct usbh_serial *serial,
                                          struct ec801e_qnetdevctl_status *status)
{
    char response[EC801E_USB_AT_RESP_BUF_SIZE];
    int ret;

    printf("[AT] >> AT+QNETDEVCTL?\r\n");
    ret = ec801e_usb_at_command(serial, "AT+QNETDEVCTL?", response, sizeof(response), EC801E_USB_AT_CMD_TIMEOUT_MS);
    if (ret < 0) {
        printf("[AT] Query failed: AT+QNETDEVCTL?\r\n[AT] Response: %s\r\n", response);
        return ret;
    }

    ret = ec801e_parse_qnetdevctl(response, status);
    if (ret < 0) {
        printf("[AT] Failed to parse QNETDEVCTL response: %s\r\n", response);
        return ret;
    }

    printf("[AT] QNETDEVCTL type=%d cid=%d urc=%d state=%d\r\n",
           status->type, status->cid, status->urc_enabled, status->state);
    return 0;
}

static int ec801e_usb_at_session_ready(struct usbh_serial *serial)
{
    if (ec801e_usb_at_expect_ok(serial, "AT") < 0) {
        return -1;
    }
    if (ec801e_usb_at_expect_ok(serial, "ATE0") < 0) {
        return -1;
    }
    return 0;
}

static int ec801e_usb_at_fix_usb_mode(struct usbh_serial *serial, bool *needs_reboot)
{
    int usbnet = -1;
    int nat = -1;

    *needs_reboot = false;

    if (ec801e_usb_at_query_qcfg(serial, "usbnet", &usbnet) < 0) {
        return -1;
    }
    if (ec801e_usb_at_query_qcfg(serial, "nat", &nat) < 0) {
        return -1;
    }

    if (usbnet != 1) {
        if (ec801e_usb_at_expect_ok(serial, "AT+QCFG=\"usbnet\",1") < 0) {
            return -1;
        }
        *needs_reboot = true;
    }

    if (nat != 1) {
        if (ec801e_usb_at_expect_ok(serial, "AT+QCFG=\"nat\",1") < 0) {
            return -1;
        }
        *needs_reboot = true;
    }

    return 0;
}

static int ec801e_usb_at_connect_netcard(struct usbh_serial *serial)
{
    TickType_t start;
    struct ec801e_qnetdevctl_status status = { 0 };

    if (ec801e_usb_at_query_qnetdevctl(serial, &status) == 0 &&
        status.type == 3 && status.cid == 1 && status.urc_enabled == 1 && status.state == 1) {
        return 0;
    }

    if (ec801e_usb_at_expect_ok(serial, "AT+QNETDEVCTL=3,1,1") < 0) {
        return -1;
    }

    start = xTaskGetTickCount();
    while ((uint32_t)((xTaskGetTickCount() - start) * portTICK_PERIOD_MS) < EC801E_USB_AT_LINK_TIMEOUT_MS) {
        if (ec801e_usb_at_query_qnetdevctl(serial, &status) == 0 &&
            status.type == 3 && status.cid == 1 && status.urc_enabled == 1 && status.state == 1) {
            return 0;
        }
        vTaskDelay(pdMS_TO_TICKS(1000));
    }

    return -1;
}

int ec801e_usb_prepare_for_ecm(void)
{
    struct ec801e_usb_at_port port = { 0 };
    bool rebooted = false;

    while (1) {
        bool needs_reboot = false;

        ec801e_usb_at_open_wait(&port);

        if (ec801e_usb_at_session_ready(port.serial) < 0) {
            ec801e_usb_at_close(&port);
            vTaskDelay(pdMS_TO_TICKS(EC801E_USB_AT_SCAN_DELAY_MS));
            continue;
        }

        if (ec801e_usb_at_fix_usb_mode(port.serial, &needs_reboot) < 0) {
            ec801e_usb_at_close(&port);
            return -1;
        }

        if (needs_reboot) {
            if (rebooted) {
                printf("[AT] USB mode still requires reboot after one recovery cycle\r\n");
                ec801e_usb_at_close(&port);
                return -1;
            }

            if (ec801e_usb_at_expect_ok(port.serial, "AT+CFUN=1,1") < 0) {
                ec801e_usb_at_close(&port);
                return -1;
            }

            printf("[AT] USB mode updated, waiting for module reboot...\r\n");
            rebooted = true;
            ec801e_usb_at_close(&port);
            vTaskDelay(pdMS_TO_TICKS(EC801E_USB_AT_BOOT_DELAY_MS));
            continue;
        }

        if (ec801e_usb_at_connect_netcard(port.serial) < 0) {
            printf("[AT] Failed to bring up USB netcard with QNETDEVCTL\r\n");
            ec801e_usb_at_close(&port);
            return -1;
        }

        ec801e_usb_at_close(&port);
        printf("[AT] EC801E USB AT preparation complete\r\n");
        return 0;
    }
}
```

## src/ec801e_usb_at.h
```c
/*
 * Copyright (c) 2026, ListenAI
 *
 * SPDX-License-Identifier: Apache-2.0
 */

#ifndef EC801E_USB_AT_H
#define EC801E_USB_AT_H

int ec801e_usb_prepare_for_ecm(void);

#endif
```

## src/ec801e_usb_at_parse.c
```c
/*
 * Copyright (c) 2026, ListenAI
 *
 * SPDX-License-Identifier: Apache-2.0
 */

#include "ec801e_usb_at_parse.h"

#include <stdio.h>
#include <string.h>

int ec801e_parse_qcfg_value(const char *text, const char *key, int *out_value)
{
    const char *line;
    char parsed_key[32];
    int value;

    if (text == NULL || key == NULL || out_value == NULL) {
        return -1;
    }

    line = strstr(text, "+QCFG:");
    if (line == NULL) {
        return -1;
    }

    if (sscanf(line, "+QCFG: \"%31[^\"]\",%d", parsed_key, &value) != 2) {
        return -1;
    }

    if (strcmp(parsed_key, key) != 0) {
        return -1;
    }

    *out_value = value;
    return 0;
}

int ec801e_parse_qnetdevctl(const char *text, struct ec801e_qnetdevctl_status *out_status)
{
    const char *line;
    struct ec801e_qnetdevctl_status status;

    if (text == NULL || out_status == NULL) {
        return -1;
    }

    line = strstr(text, "+QNETDEVCTL:");
    if (line == NULL) {
        return -1;
    }

    if (sscanf(line, "+QNETDEVCTL: %d,%d,%d,%d",
               &status.type, &status.cid, &status.urc_enabled, &status.state) != 4) {
        return -1;
    }

    *out_status = status;
    return 0;
}
```

## src/ec801e_usb_at_parse.h
```c
/*
 * Copyright (c) 2026, ListenAI
 *
 * SPDX-License-Identifier: Apache-2.0
 */

#ifndef EC801E_USB_AT_PARSE_H
#define EC801E_USB_AT_PARSE_H

struct ec801e_qnetdevctl_status {
    int type;
    int cid;
    int urc_enabled;
    int state;
};

int ec801e_parse_qcfg_value(const char *text, const char *key, int *out_value);
int ec801e_parse_qnetdevctl(const char *text, struct ec801e_qnetdevctl_status *out_status);

#endif
```

## src/net_probe.c
```c
/*
 * Copyright (c) 2026, ListenAI
 *
 * SPDX-License-Identifier: Apache-2.0
 */

#include <stdbool.h>
#include <stdio.h>
#include <string.h>

#include "FreeRTOS.h"
#include "task.h"

#include "lwip/dhcp.h"
#include "lwip/dns.h"
#include "lwip/inet.h"
#include "lwip/netdb.h"
#include "lwip/netif.h"
#include "lwip/sockets.h"

#include "net_probe_checks.h"
#include "net_probe.h"

#define ECM_PUBLIC_DNS_IP           "223.5.5.5"
#define ECM_DNS_PORT                53
#define ECM_NTP_PORT                123
#define ECM_HTTP_PORT               80
#define ECM_PROBE_DOMAIN            "www.baidu.com"
#define ECM_NTP_HOST                "ntp1.aliyun.com"
#define ECM_HTTP_HOST               "www.baidu.com"
#define ECM_PROBE_RETRY_DELAY_MS    5000
#define ECM_PROBE_TX_ID             0x1234

struct ec801e_probe_state {
    bool udp_dns_passed;
    bool udp_ntp_passed;
    bool tcp_connect_passed;
    bool http_get_passed;
};

static bool g_probe_task_started;

static size_t encode_dns_name(uint8_t *buf, size_t buf_size, const char *domain)
{
    size_t used = 0;
    const char *label = domain;
    const char *dot;

    while (*label != '\0') {
        size_t label_len;

        dot = strchr(label, '.');
        label_len = dot ? (size_t)(dot - label) : strlen(label);
        if (label_len == 0 || label_len > 63 || (used + label_len + 1) >= buf_size) {
            return 0;
        }

        buf[used++] = (uint8_t)label_len;
        memcpy(&buf[used], label, label_len);
        used += label_len;

        if (dot == NULL) {
            break;
        }
        label = dot + 1;
    }

    if (used >= buf_size) {
        return 0;
    }

    buf[used++] = 0x00;
    return used;
}

static void reset_probe_state(struct ec801e_probe_state *state)
{
    memset(state, 0, sizeof(*state));
}

static void log_probe_summary(const struct ec801e_probe_state *state)
{
    printf("[NET] Summary UDP_DNS=%s UDP_NTP=%s TCP_CONNECT=%s HTTP_GET=%s\r\n",
           state->udp_dns_passed ? "PASS" : "PENDING",
           state->udp_ntp_passed ? "PASS" : "PENDING",
           state->tcp_connect_passed ? "PASS" : "PENDING",
           state->http_get_passed ? "PASS" : "PENDING");
}

static void log_dns_servers(void)
{
    for (uint8_t i = 0; i < DNS_MAX_SERVERS; i++) {
        const ip_addr_t *dns_server = dns_getserver(i);

        if (dns_server != NULL && !ip_addr_isany(dns_server)) {
            printf("[NET] DNS[%u]       : %s\r\n", i, ipaddr_ntoa(dns_server));
        } else {
            printf("[NET] DNS[%u]       : <unset>\r\n", i);
        }
    }
}

static void log_netif_info(const struct netif *netif)
{
    printf("[NET] IPv4 Address : %s\r\n", ipaddr_ntoa(&netif->ip_addr));
    printf("[NET] IPv4 Netmask : %s\r\n", ipaddr_ntoa(&netif->netmask));
    printf("[NET] IPv4 Gateway : %s\r\n", ipaddr_ntoa(&netif->gw));
    printf("[NET] MAC          : %02x:%02x:%02x:%02x:%02x:%02x\r\n",
           netif->hwaddr[0], netif->hwaddr[1], netif->hwaddr[2],
           netif->hwaddr[3], netif->hwaddr[4], netif->hwaddr[5]);
    log_dns_servers();
}

static int run_udp_dns_probe(const char *dns_ip)
{
    int sock = -1;
    int ret = -1;
    uint8_t query[64];
    uint8_t response[256];
    size_t query_len;
    struct timeval timeout = {
        .tv_sec = 5,
        .tv_usec = 0,
    };
    struct sockaddr_in server_addr;
    struct sockaddr_in from_addr;
    socklen_t from_len = sizeof(from_addr);

    memset(query, 0, sizeof(query));
    query[0] = (uint8_t)(ECM_PROBE_TX_ID >> 8);
    query[1] = (uint8_t)(ECM_PROBE_TX_ID & 0xff);
    query[2] = 0x01;
    query[5] = 0x01;

    query_len = 12;
    query_len += encode_dns_name(&query[query_len], sizeof(query) - query_len, ECM_PROBE_DOMAIN);
    if (query_len == 12 || (query_len + 4) > sizeof(query)) {
        printf("[NET] Failed to encode DNS query for %s\r\n", ECM_PROBE_DOMAIN);
        return -1;
    }

    query[query_len++] = 0x00;
    query[query_len++] = 0x01;
    query[query_len++] = 0x00;
    query[query_len++] = 0x01;

    sock = socket(AF_INET, SOCK_DGRAM, 0);
    if (sock < 0) {
        printf("[NET] socket create failed: %d\r\n", sock);
        return -1;
    }

    setsockopt(sock, SOL_SOCKET, SO_RCVTIMEO, &timeout, sizeof(timeout));
    setsockopt(sock, SOL_SOCKET, SO_SNDTIMEO, &timeout, sizeof(timeout));

    memset(&server_addr, 0, sizeof(server_addr));
    server_addr.sin_family = AF_INET;
    server_addr.sin_port = htons(ECM_DNS_PORT);
    server_addr.sin_addr.s_addr = inet_addr(dns_ip);

    printf("[NET] Sending UDP DNS probe to %s:%d for %s ...\r\n",
           dns_ip, ECM_DNS_PORT, ECM_PROBE_DOMAIN);
    ret = sendto(sock, query, query_len, 0, (struct sockaddr *)&server_addr, sizeof(server_addr));
    if (ret < 0) {
        printf("[NET] sendto failed: %d\r\n", ret);
        close(sock);
        return -1;
    }

    ret = recvfrom(sock, response, sizeof(response), 0, (struct sockaddr *)&from_addr, &from_len);
    if (ret > 0 && ec801e_validate_dns_response(response, (size_t)ret, ECM_PROBE_TX_ID) == 0) {
        printf("[NET] UDP DNS probe succeeded, received %d bytes from %s:%d\r\n",
               ret, inet_ntoa(from_addr.sin_addr), ntohs(from_addr.sin_port));
        close(sock);
        return 0;
    }

    printf("[NET] recvfrom failed or invalid DNS response: %d\r\n", ret);
    close(sock);
    return -1;
}

static int resolve_host_ipv4(const char *host, char *ip_buf, size_t ip_buf_size)
{
    struct addrinfo hints;
    struct addrinfo *result = NULL;
    struct addrinfo *it;
    int ret;

    if (host == NULL || ip_buf == NULL || ip_buf_size == 0) {
        return -1;
    }

    memset(&hints, 0, sizeof(hints));
    hints.ai_family = AF_INET;
    hints.ai_socktype = SOCK_STREAM;

    ret = getaddrinfo(host, NULL, &hints, &result);
    if (ret != 0 || result == NULL) {
        printf("[NET] getaddrinfo failed for %s: %d\r\n", host, ret);
        return -1;
    }

    for (it = result; it != NULL; it = it->ai_next) {
        const struct sockaddr_in *addr = (const struct sockaddr_in *)it->ai_addr;
        const char *ip = inet_ntoa(addr->sin_addr);

        if (ip != NULL) {
            strncpy(ip_buf, ip, ip_buf_size - 1);
            ip_buf[ip_buf_size - 1] = '\0';
            freeaddrinfo(result);
            printf("[NET] Resolved %s -> %s\r\n", host, ip_buf);
            return 0;
        }
    }

    freeaddrinfo(result);
    return -1;
}

static int run_udp_ntp_probe(const char *ip)
{
    int sock;
    int ret;
    uint8_t request[48] = { 0 };
    uint8_t response[48] = { 0 };
    uint32_t unix_time = 0;
    struct timeval timeout = {
        .tv_sec = 5,
        .tv_usec = 0,
    };
    struct sockaddr_in server_addr;

    sock = socket(AF_INET, SOCK_DGRAM, 0);
    if (sock < 0) {
        printf("[NET] NTP socket create failed: %d\r\n", sock);
        return -1;
    }

    setsockopt(sock, SOL_SOCKET, SO_RCVTIMEO, &timeout, sizeof(timeout));
    setsockopt(sock, SOL_SOCKET, SO_SNDTIMEO, &timeout, sizeof(timeout));

    request[0] = 0x1b;

    memset(&server_addr, 0, sizeof(server_addr));
    server_addr.sin_family = AF_INET;
    server_addr.sin_port = htons(ECM_NTP_PORT);
    server_addr.sin_addr.s_addr = inet_addr(ip);

    printf("[NET] Sending UDP NTP probe to %s:%u ...\r\n", ip, ECM_NTP_PORT);
    ret = sendto(sock, request, sizeof(request), 0, (struct sockaddr *)&server_addr, sizeof(server_addr));
    if (ret < 0) {
        printf("[NET] NTP sendto failed: %d\r\n", ret);
        close(sock);
        return -1;
    }

    ret = recvfrom(sock, response, sizeof(response), 0, NULL, NULL);
    if (ret > 0 && ec801e_validate_ntp_response(response, (size_t)ret, &unix_time) == 0) {
        printf("[NET] UDP NTP probe succeeded, unix_time=%u\r\n", unix_time);
        close(sock);
        return 0;
    }

    printf("[NET] UDP NTP probe failed: %d\r\n", ret);
    close(sock);
    return -1;
}

static int run_tcp_connect_probe(const char *ip, uint16_t port)
{
    int sock;
    int ret;
    struct timeval timeout = {
        .tv_sec = 5,
        .tv_usec = 0,
    };
    struct sockaddr_in server_addr;

    sock = socket(AF_INET, SOCK_STREAM, 0);
    if (sock < 0) {
        printf("[NET] TCP socket create failed: %d\r\n", sock);
        return -1;
    }

    setsockopt(sock, SOL_SOCKET, SO_RCVTIMEO, &timeout, sizeof(timeout));
    setsockopt(sock, SOL_SOCKET, SO_SNDTIMEO, &timeout, sizeof(timeout));

    memset(&server_addr, 0, sizeof(server_addr));
    server_addr.sin_family = AF_INET;
    server_addr.sin_port = htons(port);
    server_addr.sin_addr.s_addr = inet_addr(ip);

    printf("[NET] Sending TCP connect probe to %s:%u ...\r\n", ip, port);
    ret = connect(sock, (struct sockaddr *)&server_addr, sizeof(server_addr));
    if (ret == 0) {
        printf("[NET] TCP connect probe succeeded: %s:%u\r\n", ip, port);
        close(sock);
        return 0;
    }

    printf("[NET] TCP connect probe failed: %d\r\n", ret);
    close(sock);
    return -1;
}

static int run_http_get_probe(const char *host, const char *ip, uint16_t port)
{
    int sock;
    int ret;
    int status = 0;
    char request[192];
    char response[256];
    struct timeval timeout = {
        .tv_sec = 5,
        .tv_usec = 0,
    };
    struct sockaddr_in server_addr;

    sock = socket(AF_INET, SOCK_STREAM, 0);
    if (sock < 0) {
        printf("[NET] HTTP socket create failed: %d\r\n", sock);
        return -1;
    }

    setsockopt(sock, SOL_SOCKET, SO_RCVTIMEO, &timeout, sizeof(timeout));
    setsockopt(sock, SOL_SOCKET, SO_SNDTIMEO, &timeout, sizeof(timeout));

    memset(&server_addr, 0, sizeof(server_addr));
    server_addr.sin_family = AF_INET;
    server_addr.sin_port = htons(port);
    server_addr.sin_addr.s_addr = inet_addr(ip);

    printf("[NET] Sending HTTP GET probe to %s (%s:%u) ...\r\n", host, ip, port);
    ret = connect(sock, (struct sockaddr *)&server_addr, sizeof(server_addr));
    if (ret != 0) {
        printf("[NET] HTTP connect failed: %d\r\n", ret);
        close(sock);
        return -1;
    }

    ret = snprintf(request, sizeof(request),
                   "GET / HTTP/1.1\r\n"
                   "Host: %s\r\n"
                   "Connection: close\r\n"
                   "User-Agent: ec801e-ecm-probe/1.0\r\n"
                   "\r\n",
                   host);
    if (ret <= 0 || (size_t)ret >= sizeof(request)) {
        close(sock);
        return -1;
    }

    ret = send(sock, request, (size_t)ret, 0);
    if (ret < 0) {
        printf("[NET] HTTP send failed: %d\r\n", ret);
        close(sock);
        return -1;
    }

    ret = recv(sock, response, sizeof(response) - 1, 0);
    if (ret <= 0) {
        printf("[NET] HTTP recv failed: %d\r\n", ret);
        close(sock);
        return -1;
    }

    response[ret] = '\0';
    if (ec801e_parse_http_status(response, &status) == 0 &&
        (status == 200 || status == 301 || status == 302)) {
        printf("[NET] HTTP GET probe succeeded with status %d\r\n", status);
        close(sock);
        return 0;
    }

    printf("[NET] HTTP GET probe failed, invalid status line: %.32s\r\n", response);
    close(sock);
    return -1;
}

static int run_udp_dns_stage(void)
{
    bool have_dhcp_dns = false;

    for (uint8_t i = 0; i < DNS_MAX_SERVERS; i++) {
        const ip_addr_t *dns_server = dns_getserver(i);

        if (dns_server == NULL || ip_addr_isany(dns_server) || !IP_IS_V4(dns_server)) {
            continue;
        }

        have_dhcp_dns = true;
        if (run_udp_dns_probe(ipaddr_ntoa(dns_server)) == 0) {
            return 0;
        }
    }

    printf("[NET] %s, trying AliDNS fallback\r\n",
           have_dhcp_dns ? "DHCP-provided DNS servers did not answer"
                         : "No DHCP DNS server available");
    return run_udp_dns_probe(ECM_PUBLIC_DNS_IP);
}

static int run_udp_ntp_stage(void)
{
    char ntp_ip[16];

    if (resolve_host_ipv4(ECM_NTP_HOST, ntp_ip, sizeof(ntp_ip)) < 0) {
        return -1;
    }
    return run_udp_ntp_probe(ntp_ip);
}

static int run_tcp_connect_stage(void)
{
    char http_ip[16];

    if (resolve_host_ipv4(ECM_HTTP_HOST, http_ip, sizeof(http_ip)) < 0) {
        return -1;
    }
    return run_tcp_connect_probe(http_ip, ECM_HTTP_PORT);
}

static int run_http_get_stage(void)
{
    char http_ip[16];

    if (resolve_host_ipv4(ECM_HTTP_HOST, http_ip, sizeof(http_ip)) < 0) {
        return -1;
    }
    return run_http_get_probe(ECM_HTTP_HOST, http_ip, ECM_HTTP_PORT);
}

static void net_probe_task(void *arg)
{
    struct netif *netif;
    bool announced_waiting = false;
    bool link_ready = false;
    bool probe_ok = false;
    struct ec801e_probe_state state;

    (void)arg;
    reset_probe_state(&state);

    while (1) {
        netif = netif_default;

        if (netif == NULL || !netif_is_up(netif) || !dhcp_supplied_address(netif)) {
            if (!announced_waiting) {
                printf("[NET] Waiting for ECM netif and DHCP lease...\r\n");
                announced_waiting = true;
            }
            if (link_ready) {
                printf("[NET] ECM netif lost, waiting for reconnect...\r\n");
                link_ready = false;
                probe_ok = false;
                reset_probe_state(&state);
            }
            vTaskDelay(pdMS_TO_TICKS(1000));
            continue;
        }

        if (!link_ready) {
            printf("[NET] ECM netif is ready\r\n");
            log_netif_info(netif);
            announced_waiting = false;
            link_ready = true;
        }

        if (!state.udp_dns_passed) {
            state.udp_dns_passed = (run_udp_dns_stage() == 0);
            printf("[NET] UDP_DNS=%s\r\n", state.udp_dns_passed ? "PASS" : "FAIL");
            if (!state.udp_dns_passed) {
                printf("[NET] Probe failed, retrying in 5 seconds\r\n");
                vTaskDelay(pdMS_TO_TICKS(ECM_PROBE_RETRY_DELAY_MS));
                continue;
            }
            log_probe_summary(&state);
        }

        if (!state.udp_ntp_passed) {
            state.udp_ntp_passed = (run_udp_ntp_stage() == 0);
            printf("[NET] UDP_NTP=%s\r\n", state.udp_ntp_passed ? "PASS" : "FAIL");
            if (!state.udp_ntp_passed) {
                printf("[NET] Probe failed, retrying in 5 seconds\r\n");
                vTaskDelay(pdMS_TO_TICKS(ECM_PROBE_RETRY_DELAY_MS));
                continue;
            }
            log_probe_summary(&state);
        }

        if (!state.tcp_connect_passed) {
            state.tcp_connect_passed = (run_tcp_connect_stage() == 0);
            printf("[NET] TCP_CONNECT=%s\r\n", state.tcp_connect_passed ? "PASS" : "FAIL");
            if (!state.tcp_connect_passed) {
                printf("[NET] Probe failed, retrying in 5 seconds\r\n");
                vTaskDelay(pdMS_TO_TICKS(ECM_PROBE_RETRY_DELAY_MS));
                continue;
            }
            log_probe_summary(&state);
        }

        if (!state.http_get_passed) {
            state.http_get_passed = (run_http_get_stage() == 0);
            printf("[NET] HTTP_GET=%s\r\n", state.http_get_passed ? "PASS" : "FAIL");
            if (!state.http_get_passed) {
                printf("[NET] Probe failed, retrying in 5 seconds\r\n");
                vTaskDelay(pdMS_TO_TICKS(ECM_PROBE_RETRY_DELAY_MS));
                continue;
            }
            log_probe_summary(&state);
        }

        if (!probe_ok) {
            probe_ok = true;
            printf("[NET] ECM internet probe passed\r\n");
        }

        vTaskDelay(pdMS_TO_TICKS(5000));
    }
}

void ec801e_net_probe_start(void)
{
    if (g_probe_task_started) {
        return;
    }

    g_probe_task_started = true;
    xTaskCreate(net_probe_task, "ecm_probe", 4096, NULL, CONFIG_USBHOST_PSC_PRIO + 1, NULL);
}
```

## src/net_probe.h
```c
/*
 * Copyright (c) 2026, ListenAI
 *
 * SPDX-License-Identifier: Apache-2.0
 */
#ifndef EC801E_NET_PROBE_H
#define EC801E_NET_PROBE_H

void ec801e_net_probe_start(void);

#endif
```

## src/net_probe_checks.c
```c
/*
 * Copyright (c) 2026, ListenAI
 *
 * SPDX-License-Identifier: Apache-2.0
 */

#include "net_probe_checks.h"

#include <stdio.h>

#define DNS_HEADER_SIZE            12
#define NTP_PACKET_SIZE            48
#define NTP_UNIX_EPOCH_DELTA_SEC   2208988800UL

static uint16_t read_be16(const uint8_t *buf)
{
    return (uint16_t)(((uint16_t)buf[0] << 8) | buf[1]);
}

static uint32_t read_be32(const uint8_t *buf)
{
    return ((uint32_t)buf[0] << 24) |
           ((uint32_t)buf[1] << 16) |
           ((uint32_t)buf[2] << 8) |
           (uint32_t)buf[3];
}

int ec801e_validate_dns_response(const uint8_t *response, size_t response_len, uint16_t transaction_id)
{
    uint16_t flags;
    uint16_t qdcount;
    uint16_t ancount;

    if (response == NULL || response_len < DNS_HEADER_SIZE) {
        return -1;
    }

    if (read_be16(response) != transaction_id) {
        return -1;
    }

    flags = read_be16(&response[2]);
    if ((flags & 0x8000U) == 0U) {
        return -1;
    }
    if ((flags & 0x000fU) != 0U) {
        return -1;
    }

    qdcount = read_be16(&response[4]);
    ancount = read_be16(&response[6]);
    if (qdcount == 0U || ancount == 0U) {
        return -1;
    }

    return 0;
}

int ec801e_validate_ntp_response(const uint8_t *response, size_t response_len, uint32_t *unix_time)
{
    uint8_t mode;
    uint32_t ntp_seconds;

    if (response == NULL || unix_time == NULL || response_len < NTP_PACKET_SIZE) {
        return -1;
    }

    mode = response[0] & 0x07U;
    if (mode != 4U && mode != 5U) {
        return -1;
    }

    ntp_seconds = read_be32(&response[40]);
    if (ntp_seconds <= NTP_UNIX_EPOCH_DELTA_SEC) {
        return -1;
    }

    *unix_time = ntp_seconds - NTP_UNIX_EPOCH_DELTA_SEC;
    return 0;
}

int ec801e_parse_http_status(const char *response, int *status_code)
{
    int status;

    if (response == NULL || status_code == NULL) {
        return -1;
    }

    if (sscanf(response, "HTTP/%*u.%*u %d", &status) != 1) {
        return -1;
    }

    if (status < 100 || status > 599) {
        return -1;
    }

    *status_code = status;
    return 0;
}
```

## src/net_probe_checks.h
```c
/*
 * Copyright (c) 2026, ListenAI
 *
 * SPDX-License-Identifier: Apache-2.0
 */

#ifndef EC801E_NET_PROBE_CHECKS_H
#define EC801E_NET_PROBE_CHECKS_H

#include <stddef.h>
#include <stdint.h>

int ec801e_validate_dns_response(const uint8_t *response, size_t response_len, uint16_t transaction_id);
int ec801e_validate_ntp_response(const uint8_t *response, size_t response_len, uint32_t *unix_time);
int ec801e_parse_http_status(const char *response, int *status_code);

#endif
```

## src/usb_config.h
```c
/*
 * Copyright (c) 2026, ListenAI
 *
 * SPDX-License-Identifier: Apache-2.0
 */
#ifndef CHERRYUSB_CONFIG_H
#define CHERRYUSB_CONFIG_H

/* ================ USB common Configuration ================ */

#define CONFIG_USB_PRINTF(...) printf(__VA_ARGS__)

#ifndef CONFIG_USB_DBG_LEVEL
#define CONFIG_USB_DBG_LEVEL USB_DBG_INFO
#endif

#define CONFIG_USBHOST_DEBUG
#define CONFIG_USB_PRINTF_COLOR_ENABLE
#define CONFIG_USB_DCACHE_ENABLE

#ifdef CONFIG_USB_DCACHE_ENABLE
#define CONFIG_USB_ALIGN_SIZE 32
#else
#define CONFIG_USB_ALIGN_SIZE 4
#endif

#define USB_NOCACHE_RAM_SECTION

/* ================ USB HOST Stack Configuration ================== */

#define CONFIG_USBHOST_MAX_RHPORTS          1
#define CONFIG_USBHOST_MAX_EXTHUBS          8
#define CONFIG_USBHOST_MAX_EHPORTS          10
#define CONFIG_USBHOST_MAX_INTERFACES       8
#define CONFIG_USBHOST_MAX_INTF_ALTSETTINGS 2
#define CONFIG_USBHOST_MAX_ENDPOINTS        6

#define CONFIG_USBHOST_MAX_SERIAL_CLASS  4
#define CONFIG_USBHOST_MAX_HID_CLASS     1
#define CONFIG_USBHOST_MAX_MSC_CLASS     1
#define CONFIG_USBHOST_MAX_AUDIO_CLASS   1
#define CONFIG_USBHOST_MAX_VIDEO_CLASS   1

#define CONFIG_USBHOST_DEV_NAMELEN 16

#ifndef CONFIG_USBHOST_PSC_PRIO
#define CONFIG_USBHOST_PSC_PRIO 0
#endif

#ifndef CONFIG_USBHOST_PSC_STACKSIZE
#define CONFIG_USBHOST_PSC_STACKSIZE 2048
#endif

#ifndef CONFIG_USBHOST_NET_RX_STACKSIZE
#define CONFIG_USBHOST_NET_RX_STACKSIZE 4096
#endif

#define CONFIG_USBHOST_GET_STRING_DESC

#ifndef CONFIG_USBHOST_REQUEST_BUFFER_LEN
#define CONFIG_USBHOST_REQUEST_BUFFER_LEN 512
#endif

#ifndef CONFIG_USBHOST_CONTROL_TRANSFER_TIMEOUT
#define CONFIG_USBHOST_CONTROL_TRANSFER_TIMEOUT 500
#endif

/* ================ USB Host Port Configuration ================== */

#ifndef CONFIG_USBHOST_MAX_BUS
#define CONFIG_USBHOST_MAX_BUS 1
#endif

/* ---------------- MUSB Configuration ---------------- */

#define CONFIG_USB_MUSB_PIPE_NUM 8

#endif
```
