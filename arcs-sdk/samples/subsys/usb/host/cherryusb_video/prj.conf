## CMakeLists.txt
```
cmake_minimum_required(VERSION 3.19)

set(CMAKE_EXPORT_COMPILE_COMMANDS ON)

find_package(listenai-cmake REQUIRED HINTS $ENV{ARCS_BASE})

project(arcs)

listenai_add_executable(${PROJECT_NAME})

target_sources(${PROJECT_NAME} PRIVATE
    src/main.c
    src/video_display.c
)

listenai_include_directories(
    src
)

target_compile_options(${PROJECT_NAME} PRIVATE
    -Os
)
listenai_code_relocate(LIBRARY chryusb LOCATION PSRAM)
```

## sample.yaml
```
tests:
  samples.usb.host.cherryusb_video:
    build_only: true
```

## prj.conf
```kconfig
# CherryUSB Host Video Sample Configuration

CONFIG_MEM_IPC_ISOLATED=n
CONFIG_MEM_LUNA_SHARED_SIZE=0x0

# CherryUSB 配置
CONFIG_CHERRYUSB=y
CONFIG_CHERRYUSB_HOST=y
CONFIG_HEAP_SIZE=0x3400
# USB Host 控制器
CONFIG_CHERRYUSB_HOST_MUSB_LISA=y

# USB Video 设备支持
CONFIG_CHERRYUSB_HOST_VIDEO=y

# 日志配置
CONFIG_LOG=y
CONFIG_SYSLOG_PRINTK_REDIRECT=y

# 系统配置
CONFIG_LINK_OPTION_NOSYS_SPECS=y

# Debug
CONFIG_BACK_TRACE=y

#heap
CONFIG_PSRAM_HEAP=y
CONFIG_PSRAM_HEAP_SIZE=0x500000

# GPIO / SPI / PWM（显示屏硬件）
CONFIG_LISA_DEVICE=y
CONFIG_LISA_GPIO_DEVICE=y
CONFIG_LISA_GPIOA=y
CONFIG_LISA_GPIOB=y
CONFIG_LISA_SPI_DEVICE=y
CONFIG_LISA_SPI1=y
CONFIG_LISA_PWM=y

# 显示屏：ST7789P3 via SPI 4-wire
CONFIG_LISA_DISPLAY_DEVICE=y
CONFIG_LISA_DISPLAY_PANEL_ST7789P3=y
CONFIG_LISA_DISPLAY_BUS_SPI_4WIRE=y
CONFIG_LISA_DISPLAY_COLOR_INVERT=y
CONFIG_PANEL_ST7789P3_WIDTH=240
CONFIG_PANEL_ST7789P3_HEIGHT=320
CONFIG_PANEL_ST7789P3_X_OFFSET=0

# Touch（仅用于满足 lv_port_indev.c 的编译依赖，本示例不初始化触摸）
CONFIG_LISA_TOUCH_DEVICE=y
CONFIG_LISA_TOUCH_ARCS_CST328=y
CONFIG_LISA_I2C=y
CONFIG_LISA_I2C0=y

# LVGL8
CONFIG_SDK_MODULE_LVGL8=y
CONFIG_LV_USE_SJPG=y
CONFIG_LV_DEMO_SYS_HEAP=y
CONFIG_LV_DRIVER_PIXEL_ALIGN_SIZE=16
CONFIG_LV_USE_GPU_CSK_DMA2D=y
CONFIG_LV_DOUBLE_VDB=y
CONFIG_LV_DRIVER_FULL_REFRESH=y
CONFIG_LV_DRIVER_ROTATE_270=y
CONFIG_LV_ATTRIBUTE_FAST_MEM_USE_IRAM=y

# workqueue（显示更新异步派发）
CONFIG_WORK_QUEUE=y
```

## src/main.c
```c
/*
 * Copyright (c) 2024, ListenAI
 *
 * SPDX-License-Identifier: Apache-2.0
 */

#include <stdio.h>
#include <string.h>

#include "ClockManager.h"
#include "arcs_ap.h"

#include "FreeRTOS.h"
#include "task.h"

#include "usbh_core.h"
#include "usbh_video.h"

#include "sys_init.h"
#include "sysheap.h"
#include "video_display.h"
#include "usb_config.h"

/*
 * 首选视频格式：优先尝试此格式；若摄像头不支持，自动退回其他可用格式
 */
#define VIDEO_FORMAT_PREF    USBH_VIDEO_FORMAT_MJPEG

/* 最大同时支持的设备数，与 usb_config.h 保持一致 */
#define MAX_VIDEO_DEVICES CONFIG_USBHOST_MAX_VIDEO_CLASS

/* ------------------------------------------------------------------ */
/*  每设备上下文                                                        */
/* ------------------------------------------------------------------ */
struct video_dev_ctx {
    struct usbh_video *video_class;     /* CherryUSB 设备句柄，NULL 表示槽位空闲 */
    uint8_t           *frame_buf;       /* PSRAM 帧组装缓冲区 */
    uint8_t           *chunk_buf;       /* PSRAM DMA chunk 缓冲区 */
    volatile bool      running;         /* 采集任务正在运行 */
    volatile bool      disconnected;    /* 已收到断开信号 */
    TaskHandle_t       task_handle;     /* 采集任务句柄，用于 stop 时快速唤醒 */
    uint32_t           frame_count;
    uint32_t           total_bytes;
    uint16_t           width;           /* 实际协商的视频宽度（像素） */
    uint16_t           height;          /* 实际协商的视频高度（像素） */
};

static struct video_dev_ctx g_devs[MAX_VIDEO_DEVICES];

/* ------------------------------------------------------------------ */
/*  遍历设备格式表，找到首选格式的第一帧；不支持则退回任意可用格式     */
/* ------------------------------------------------------------------ */
static bool find_best_format(struct usbh_video *vc, uint8_t pref_fmt,
                              uint8_t *out_fmt, uint16_t *out_w, uint16_t *out_h)
{
    /* 优先找首选格式，取其第一帧 */
    for (uint8_t i = 0; i < vc->num_of_formats; i++) {
        if (vc->format[i].format_type == pref_fmt && vc->format[i].num_of_frames > 0) {
            *out_fmt = pref_fmt;
            *out_w   = vc->format[i].frame[0].wWidth;
            *out_h   = vc->format[i].frame[0].wHeight;
            return true;
        }
    }
    /* 退回：取任意格式的第一帧 */
    for (uint8_t i = 0; i < vc->num_of_formats; i++) {
        if (vc->format[i].num_of_frames > 0) {
            *out_fmt = vc->format[i].format_type;
            *out_w   = vc->format[i].frame[0].wWidth;
            *out_h   = vc->format[i].frame[0].wHeight;
            return true;
        }
    }
    return false;
}

/* ------------------------------------------------------------------ */
/*  帧回调：每收到一帧完整图像时被调用（从 USB 任务上下文触发）        */
/* ------------------------------------------------------------------ */
static void on_video_frame(struct usbh_video *video_class,
                           uint8_t *frame_buf,
                           uint32_t frame_size,
                           void *arg)
{
    struct video_dev_ctx *ctx = (struct video_dev_ctx *)arg;

    ctx->frame_count++;
    ctx->total_bytes += frame_size;

    if (ctx->frame_count % 30 == 0) {
        printf("[VIDEO%u] frame #%lu  size=%lu B  total=%lu KB\r\n",
               (unsigned)video_class->minor,
               (unsigned long)ctx->frame_count,
               (unsigned long)frame_size,
               (unsigned long)(ctx->total_bytes / 1024));
    }

    if (ctx->frame_count == 1 && frame_size >= 4) {
        printf("[VIDEO%u] first frame header: %02X %02X %02X %02X\r\n",
               (unsigned)video_class->minor,
               frame_buf[0], frame_buf[1], frame_buf[2], frame_buf[3]);
    }

    /* 送显示：使用实际协商的分辨率（CAM0→左半，CAM1→右半） */
    video_display_update(video_class->minor,
                         frame_buf, frame_size,
                         ctx->width, ctx->height,
                         video_class->current_format);
}

/* ------------------------------------------------------------------ */
/*  视频采集任务（每个设备独立一个任务）                                */
/* ------------------------------------------------------------------ */
static void video_stream_task(void *arg)
{
    struct video_dev_ctx *ctx = (struct video_dev_ctx *)arg;
    struct usbh_video    *video_class = ctx->video_class;
    int ret;
    uint8_t dev_idx = video_class->minor;

    /* 保存任务句柄，供 usbh_video_stop 快速唤醒 */
    ctx->task_handle = xTaskGetCurrentTaskHandle();

    /* 从设备描述符中动态选择最佳格式和分辨率，不依赖硬编码宽高 */
    uint8_t  actual_fmt;
    uint16_t actual_w, actual_h;
    if (!find_best_format(video_class, VIDEO_FORMAT_PREF, &actual_fmt, &actual_w, &actual_h)) {
        printf("[VIDEO%u] No valid format/frame in device descriptor\r\n", (unsigned)dev_idx);
        goto out_no_stream;
    }

    printf("[VIDEO%u] Opening device (format=%s %ux%u)...\r\n",
           (unsigned)dev_idx,
           (actual_fmt == USBH_VIDEO_FORMAT_MJPEG) ? "MJPEG" : "UNCOMPRESSED",
           (unsigned)actual_w, (unsigned)actual_h);

    /* ISO 模式下自动选择 MPS 最大的 altsetting */
    uint8_t altsetting = 0;
    if (!video_class->is_bulk && video_class->num_of_intf_altsettings > 1) {
        uint16_t best_mps = 0;
        for (uint8_t i = 1; i < video_class->num_of_intf_altsettings; i++) {
            struct usb_endpoint_descriptor *ep =
                &video_class->hport->config.intf[video_class->data_intf].altsetting[i].ep[0].ep_desc;
            uint16_t mps = USB_GET_MAXPACKETSIZE(ep->wMaxPacketSize) *
                           (USB_GET_MULT(ep->wMaxPacketSize) + 1);
            if (mps > best_mps) {
                best_mps = mps;
                altsetting = i;
            }
        }
        printf("[VIDEO%u] ISO mode: selected altsetting %u (mps=%u)\r\n",
               (unsigned)dev_idx, (unsigned)altsetting, (unsigned)best_mps);
    }

    ret = usbh_video_open(video_class, actual_fmt, actual_w, actual_h, altsetting);
    if (ret < 0) {
        printf("[VIDEO%u] Open failed: %d\r\n", (unsigned)dev_idx, ret);
        goto out_no_stream;
    }

    /* 保存协商到的实际分辨率，供帧回调传递给显示模块 */
    ctx->width  = actual_w;
    ctx->height = actual_h;

    /* 根据协商后的实际分辨率和格式动态分配帧缓冲区：
     * UNCOMPRESSED(YUY2): width * height * 2 B
     * MJPEG: 按 UNCOMPRESSED 同等大小预留（MJPEG 压缩后一般更小，此为上限）
     */
    uint32_t frame_bufsize = (uint32_t)actual_w * actual_h * 2;
    ctx->frame_buf = psram_malloc_align(CONFIG_USB_ALIGN_SIZE, frame_bufsize);
    if (!ctx->frame_buf) {
        printf("[VIDEO%u] Failed to alloc frame_buf (%lu B)\r\n",
               (unsigned)dev_idx, (unsigned long)frame_bufsize);
        usbh_video_close(video_class);
        goto out_no_stream;
    }
    printf("[VIDEO%u] frame_buf allocated: %lu B (%ux%u)\r\n",
           (unsigned)dev_idx, (unsigned long)frame_bufsize,
           (unsigned)actual_w, (unsigned)actual_h);

    /* Bulk 模式需要从 PSRAM 分配 chunk 缓冲区；ISO 模式由驱动内部分配 */
    uint32_t chunk_size = 0;
    if (video_class->is_bulk) {
        chunk_size = video_class->probe.dwMaxPayloadTransferSize;
        if (chunk_size == 0) {
            chunk_size = CONFIG_USBH_VIDEO_BULK_CHUNK_SIZE;
        }
        ctx->chunk_buf = psram_malloc_align(CONFIG_USB_ALIGN_SIZE, chunk_size);
        if (!ctx->chunk_buf) {
            printf("[VIDEO%u] Failed to allocate chunk_buf (%lu B)\r\n",
                   (unsigned)dev_idx, (unsigned long)chunk_size);
            usbh_video_close(video_class);
            goto out_no_stream;
        }
        printf("[VIDEO%u] chunk_buf allocated: %lu B\r\n",
               (unsigned)dev_idx, (unsigned long)chunk_size);
    }

    printf("[VIDEO%u] Starting %s streaming...\r\n",
           (unsigned)dev_idx, video_class->is_bulk ? "bulk" : "ISO");

    ctx->frame_count = 0;
    ctx->total_bytes = 0;

    ret = usbh_video_start_streaming(video_class,
                                     ctx->frame_buf,
                                     frame_bufsize,
                                     ctx->chunk_buf,
                                     chunk_size,
                                     on_video_frame,
                                     ctx);
    if (ret < 0) {
        printf("[VIDEO%u] start_streaming failed: %d\r\n", (unsigned)dev_idx, ret);
        if (ctx->chunk_buf) {
            psram_free(ctx->chunk_buf);
            ctx->chunk_buf = NULL;
        }
        usbh_video_close(video_class);
        goto out_no_stream;
    }

    printf("[VIDEO%u] Streaming started\r\n", (unsigned)dev_idx);

    /*
     * 等待设备断开通知。
     * usbh_video_stop() 会先调用 usbh_video_stop_streaming() 杀掉 URB，
     * 再调用 xTaskNotifyGive() 唤醒本任务，然后才返回给 usbh_video_class_free()。
     * 因此本任务被唤醒时 struct usbh_video 仍然有效，且 streaming 已停止。
     *
     * ulTaskNotifyTake 带超时用于定期打印统计信息；
     * 收到通知后若 disconnected 为真则立即退出循环。
     *
     * 若 streaming 因连续 URB 错误自动停止（设备从 Hub 拔出但 Hub 断开事件
     * 尚未到达），则静默等待 usbh_video_stop() 发出通知后再清理，
     * 避免打印混乱的统计信息。
     */
    while (!ctx->disconnected) {
        ulTaskNotifyTake(pdTRUE, pdMS_TO_TICKS(1000));
        if (ctx->disconnected) {
            break;
        }
        if (!video_class->streaming) {
            /* streaming 因连续 URB 错误停止，等待 Hub 驱动发出断开通知 */
            printf("[VIDEO%u] Streaming stopped (device error), waiting for disconnect...\r\n",
                   (unsigned)dev_idx);
            ulTaskNotifyTake(pdTRUE, portMAX_DELAY);
            break;
        }
        printf("[VIDEO%u] Running: %lu frames, %lu KB total\r\n",
               (unsigned)dev_idx,
               (unsigned long)ctx->frame_count,
               (unsigned long)(ctx->total_bytes / 1024));
    }

    printf("[VIDEO%u] Device disconnected, cleaning up...\r\n", (unsigned)dev_idx);

    /*
     * streaming 已由 usbh_video_stop() 停止（URB 已 kill）。
     * Bulk 模式释放 chunk_buf；ISO 模式 chunk_buf 为 NULL（驱动内部已释放 ISO URB）。
     * usbh_video_close() 因 hport 可能已被清零而跳过。
     */
    psram_free(ctx->chunk_buf);
    ctx->chunk_buf = NULL;
    goto out;

out_no_stream:
    /* 没有进入 streaming 循环，chunk_buf 不需要额外处理 */
    ;

out:
    psram_free(ctx->frame_buf);
    ctx->frame_buf    = NULL;
    ctx->task_handle  = NULL;
    ctx->video_class  = NULL;
    ctx->running      = false;
    vTaskDelete(NULL);
}

/* ------------------------------------------------------------------ */
/*  弱符号覆盖：摄像头插入时由 CherryUSB 枚举框架调用                  */
/* ------------------------------------------------------------------ */
void usbh_video_run(struct usbh_video *video_class)
{
    uint8_t idx = video_class->minor;

    if (idx >= MAX_VIDEO_DEVICES) {
        printf("[VIDEO] minor=%u exceeds MAX_VIDEO_DEVICES=%d, ignored\r\n",
               (unsigned)idx, MAX_VIDEO_DEVICES);
        return;
    }

    struct video_dev_ctx *ctx = &g_devs[idx];

    if (ctx->running) {
        printf("[VIDEO%u] Already running, ignoring hot-plug\r\n", (unsigned)idx);
        return;
    }

    printf("[VIDEO%u] Camera connected: %s\r\n",
           (unsigned)idx,
           video_class->hport->config.intf[video_class->ctrl_intf].devname);
    usbh_video_list_info(video_class);

    ctx->video_class  = video_class;
    ctx->frame_buf    = NULL;
    ctx->chunk_buf    = NULL;
    ctx->task_handle  = NULL;
    ctx->running      = true;
    ctx->disconnected = false;
    ctx->frame_count  = 0;
    ctx->total_bytes  = 0;

    char task_name[16];
    snprintf(task_name, sizeof(task_name), "video%u", (unsigned)idx);

    xTaskCreate(video_stream_task, task_name, 4096, ctx,
                CONFIG_USBHOST_PSC_PRIO + 1, NULL);
}

/* ------------------------------------------------------------------ */
/*  弱符号覆盖：摄像头拔出时由 CherryUSB 枚举框架调用                  */
/*                                                                      */
/*  调用链：usbh_video_ctrl_disconnect()                                */
/*            → usbh_video_stop()       ← 本函数                       */
/*            → usbh_video_class_free() ← memset(video_class, 0)       */
/*                                                                      */
/*  必须在本函数返回前完成 URB kill，否则 usbh_video_class_free 清零     */
/*  URB（含回调指针）后 MUSB 硬件触发中断会访问 NULL 回调 → crash        */
/* ------------------------------------------------------------------ */
void usbh_video_stop(struct usbh_video *video_class)
{
    uint8_t idx = video_class->minor;

    if (idx >= MAX_VIDEO_DEVICES) {
        return;
    }

    printf("[VIDEO%u] Camera disconnected, stopping streaming\r\n", (unsigned)idx);

    /*
     * 关键步骤：立即终止 URB。
     * 必须在本函数返回前完成，确保 usbh_video_class_free() 清零 struct 时
     * MUSB 硬件已不再持有对 bulkin_urb 的引用。
     */
    usbh_video_stop_streaming(video_class);

    /*
     * 通知采集任务退出循环并释放资源。
     * 任务被唤醒时 streaming 已停止，可安全释放 chunk_buf。
     */
    struct video_dev_ctx *ctx = &g_devs[idx];
    ctx->disconnected = true;
    if (ctx->task_handle) {
        xTaskNotifyGive(ctx->task_handle);
    }

    /*
     * 短暂等待任务完成 PSRAM 资源释放（ctx->running → false）。
     * 无需等待太久，因为任务被立即唤醒且只做 psram_free 操作。
     */
    vTaskDelay(pdMS_TO_TICKS(50));
}

/* ------------------------------------------------------------------ */
/*  USB 事件回调（可选）                                                */
/* ------------------------------------------------------------------ */
static void usbh_event_handler(uint8_t busid, uint8_t hub_index, uint8_t hub_port,
                               uint8_t intf, uint8_t event)
{
    (void)busid;
    (void)hub_index;
    (void)hub_port;
    (void)intf;
    (void)event;
}

/* ------------------------------------------------------------------ */
/*  main                                                                */
/* ------------------------------------------------------------------ */
int main(void)
{
    printf("\r\n");
    printf("========================================\r\n");
    printf("  CherryUSB Host Video Example\r\n");
    printf("  Preferred format: %s (auto-negotiated from device)\r\n",
           (VIDEO_FORMAT_PREF == USBH_VIDEO_FORMAT_MJPEG) ? "MJPEG" : "UNCOMPRESSED");
    printf("  Max devices: %d\r\n", MAX_VIDEO_DEVICES);
    printf("========================================\r\n\r\n");

    printf("[INFO] Initializing display...\r\n");
    video_display_init();

    printf("[INFO] Initializing USB Host...\r\n");
    usbh_initialize(0, 0x41000000UL, usbh_event_handler);
    printf("[INFO] USB Host initialized, please connect USB cameras\r\n\r\n");

    int count = 0;
    while (1) {
        vTaskDelay(pdMS_TO_TICKS(5000));
        count++;

        int active = 0;
        for (int i = 0; i < MAX_VIDEO_DEVICES; i++) {
            if (g_devs[i].running) {
                active++;
            }
        }
        if (active == 0) {
            printf("[%d] Waiting for USB camera...\r\n", count);
        }
    }

    return 0;
}

/* ------------------------------------------------------------------ */
/*  USB PHY 硬件初始化（Host 模式）                                     */
/* ------------------------------------------------------------------ */
static int usb_host_init(void)
{
    IP_CMN_SYS->REG_USB_CTRL1.bit.USBPHY_OUTCLKSEL = 0x1;
    IP_SYSCTRL->REG_PERI_CLK_CFG6.bit.ENA_USB_CLK = 0x1;

    IP_CMN_SYS->REG_USB_CTRL1.bit.USBC_CFG_IDDIG = 0x0;    /* Host 模式 (ID=0) */
    IP_CMN_SYS->REG_USB_CTRL1.bit.UTMI_DATABUS16_8 = 0x1;  /* 16 位模式 */

    return 0;
}

SYS_INIT(usb_host_init, SYS_INIT_LEVEL_PRE_DEVICES_INIT, 0);
```

## src/usb_config.h
```c
/*
 * Copyright (c) 2024, ListenAI
 *
 * SPDX-License-Identifier: Apache-2.0
 */
#ifndef CHERRYUSB_CONFIG_H
#define CHERRYUSB_CONFIG_H

/* ================ USB common Configuration ================ */

#define CONFIG_USB_PRINTF(...) printf(__VA_ARGS__)

#ifndef CONFIG_USB_DBG_LEVEL
#define CONFIG_USB_DBG_LEVEL USB_DBG_INFO
#endif

/* Enable USB Host debug */
#define CONFIG_USBHOST_DEBUG

/* Enable print with color */
#define CONFIG_USB_PRINTF_COLOR_ENABLE

#define CONFIG_USB_DCACHE_ENABLE

/* data align size when use dma or use dcache */
#ifdef CONFIG_USB_DCACHE_ENABLE
#define CONFIG_USB_ALIGN_SIZE 32 // 32 or 64
#else
#define CONFIG_USB_ALIGN_SIZE 4
#endif

/* attribute data into no cache ram */
#define USB_NOCACHE_RAM_SECTION

/* ================ USB HOST Stack Configuration ================== */

#define CONFIG_USBHOST_MAX_RHPORTS          1
#define CONFIG_USBHOST_MAX_EXTHUBS          8
#define CONFIG_USBHOST_MAX_EHPORTS          10
#define CONFIG_USBHOST_MAX_INTERFACES       16
#define CONFIG_USBHOST_MAX_INTF_ALTSETTINGS 2
#define CONFIG_USBHOST_MAX_ENDPOINTS        6

#define CONFIG_USBHOST_MAX_SERIAL_CLASS  1
#define CONFIG_USBHOST_MAX_HID_CLASS     1
#define CONFIG_USBHOST_MAX_MSC_CLASS     1
#define CONFIG_USBHOST_MAX_AUDIO_CLASS   1
#define CONFIG_USBHOST_MAX_VIDEO_CLASS   2

#define CONFIG_USBHOST_DEV_NAMELEN 16

#ifndef CONFIG_USBHOST_PSC_PRIO
#define CONFIG_USBHOST_PSC_PRIO 0
#endif
#ifndef CONFIG_USBHOST_PSC_STACKSIZE
#define CONFIG_USBHOST_PSC_STACKSIZE 2048
#endif

#define CONFIG_USBHOST_GET_STRING_DESC

/* Ep0 max transfer buffer */
#ifndef CONFIG_USBHOST_REQUEST_BUFFER_LEN
#define CONFIG_USBHOST_REQUEST_BUFFER_LEN 512
#endif

#ifndef CONFIG_USBHOST_CONTROL_TRANSFER_TIMEOUT
#define CONFIG_USBHOST_CONTROL_TRANSFER_TIMEOUT 500
#endif

/* ================ USB Host Port Configuration ==================*/
#ifndef CONFIG_USBHOST_MAX_BUS
#define CONFIG_USBHOST_MAX_BUS 1
#endif

/* ---------------- MUSB Configuration ---------------- */
#define CONFIG_USB_MUSB_PIPE_NUM 8

/* ---------------- Video Configuration ---------------- */
/* Bulk chunk size: one URB receive per chunk */
#define CONFIG_USBH_VIDEO_BULK_CHUNK_SIZE 512

#endif
```

## src/video_display.c
```c
/*
 * Copyright (c) 2024, ListenAI
 *
 * SPDX-License-Identifier: Apache-2.0
 */

#include <stdio.h>
#include <string.h>

#include "FreeRTOS.h"
#include "task.h"

#include "lisa_device.h"
#include "lisa_display.h"
#include "lv_port_disp.h"
#include "lvgl.h"
#include "IOMuxManager.h"
#include "pinmux.h"
#include "sysheap.h"
#include "workqueue.h"

#include "video_display.h"

/* TJpgDec：通过 LVGL8 sjpg 模块提供的 Tiny JPEG 解码器 */
#if defined(CONFIG_LV_USE_SJPG) && CONFIG_LV_USE_SJPG
#include "extra/libs/sjpg/tjpgd.h"
#endif

/* arcs_evb LCD SPI CS 引脚（pinmux.h 中未定义，参考 face_detect/display.c） */
#ifndef LCD_CS_PIN
#define LCD_CS_PIN 5
#endif

/* ------------------------------------------------------------------ */
/*  显示尺寸                                                            */
/*  ST7789P3 物理分辨率 240×320，LVGL 旋转 270° 后逻辑分辨率 320×240   */
/* ------------------------------------------------------------------ */
#define PREVIEW_W 320
#define PREVIEW_H 240

/* 每路摄像头占半屏宽度 */
#define HALF_W (PREVIEW_W / 2)   /* 160 */

/* ------------------------------------------------------------------ */
/*  预览帧缓冲（RGB565，放 PSRAM 避免占用 SRAM）                        */
/* ------------------------------------------------------------------ */
static __attribute__((section(".psram.bss"))) uint16_t preview_buf[PREVIEW_W * PREVIEW_H];

/* ------------------------------------------------------------------ */
/*  LVGL 对象                                                           */
/* ------------------------------------------------------------------ */
static lv_obj_t     *preview_obj;
static lv_img_dsc_t  preview_img_dsc;
static lv_obj_t     *info_label[2];   /* 每路摄像头各一个状态标签 */

/* ------------------------------------------------------------------ */
/*  显示更新 workqueue                                                  */
/* ------------------------------------------------------------------ */
static workqueue_t *display_wq;

typedef struct {
    uint8_t  dev_idx;
    uint8_t  *frame_buf;
    uint32_t  frame_size;
    uint16_t  width;
    uint16_t  height;
    uint8_t   format;
} display_msg_t;

/* ------------------------------------------------------------------ */
/*  YUY2 → RGB565 内联转换（BT.601）                                   */
/* ------------------------------------------------------------------ */
static inline uint16_t yuyv_to_rgb565(uint8_t y, uint8_t u, uint8_t v)
{
    int c = y - 16;
    int d = u - 128;
    int e = v - 128;

    int r = (298 * c + 409 * e + 128) >> 8;
    int g = (298 * c - 100 * d - 208 * e + 128) >> 8;
    int b = (298 * c + 516 * d + 128) >> 8;

    r = r < 0 ? 0 : (r > 255 ? 255 : r);
    g = g < 0 ? 0 : (g > 255 ? 255 : g);
    b = b < 0 ? 0 : (b > 255 ? 255 : b);

    return ((r & 0xF8) << 8) | ((g & 0xFC) << 3) | (b >> 3);
}

/* ------------------------------------------------------------------ */
/*  YUYV422 → RGB565，缩放并写入 preview_buf 的指定半屏（x_off 列起始） */
/* ------------------------------------------------------------------ */
static void yuyv_to_preview_half(uint8_t *yuyv, uint16_t src_w, uint16_t src_h, int x_off)
{
    for (int dy = 0; dy < PREVIEW_H; dy++) {
        int sy = dy * src_h / PREVIEW_H;
        for (int dx = 0; dx < HALF_W; dx++) {
            int sx = dx * src_w / HALF_W;
            /* YUYV 每 2 个像素共用一对 U/V，以 4 字节为一组：Y0 U0 Y1 V0 */
            int pair_base = (sy * src_w + (sx & ~1)) * 2;
            uint8_t Y = yuyv[pair_base + (sx & 1) * 2];
            uint8_t U = yuyv[pair_base + 1];
            uint8_t V = yuyv[pair_base + 3];
            preview_buf[dy * PREVIEW_W + x_off + dx] = yuyv_to_rgb565(Y, U, V);
        }
    }
}

/* ------------------------------------------------------------------ */
/*  MJPEG → RGB565 解码并写入 preview_buf 半屏（TJpgDec，JD_FORMAT=0） */
/* ------------------------------------------------------------------ */
#if defined(CONFIG_LV_USE_SJPG) && CONFIG_LV_USE_SJPG

/* JPEG 解码工作内存池大小（字节）：包含 Huffman 表、量化表、MCU 工作缓冲 */
#define JPEG_WORK_POOL_SIZE 4096

typedef struct {
    const uint8_t *data;
    uint32_t       size;
    uint32_t       pos;
    int            x_off;
    uint16_t       src_w;
    uint16_t       src_h;
} jpeg_dec_ctx_t;

static size_t jpeg_infunc(JDEC *jd, uint8_t *buf, size_t nbyte)
{
    jpeg_dec_ctx_t *ctx = (jpeg_dec_ctx_t *)jd->device;
    uint32_t remain = ctx->size - ctx->pos;
    if ((uint32_t)nbyte > remain) {
        nbyte = (size_t)remain;
    }
    if (buf) {
        memcpy(buf, ctx->data + ctx->pos, nbyte);
    }
    ctx->pos += (uint32_t)nbyte;
    return nbyte;
}

/* outfunc 接收 RGB888 tile（JD_FORMAT=0），按比例缩放写入半屏 preview_buf */
static int jpeg_outfunc(JDEC *jd, void *bitmap, JRECT *rect)
{
    jpeg_dec_ctx_t *ctx = (jpeg_dec_ctx_t *)jd->device;
    uint8_t *rgb = (uint8_t *)bitmap;
    uint16_t tile_w = rect->right - rect->left + 1;

    /* 计算当前 tile 对应的目标半屏像素范围（避免遍历整个目标区域） */
    int dy0 = (int)rect->top      * PREVIEW_H / ctx->src_h;
    int dy1 = ((int)rect->bottom + 1) * PREVIEW_H / ctx->src_h;
    int dx0 = (int)rect->left     * HALF_W    / ctx->src_w;
    int dx1 = ((int)rect->right  + 1) * HALF_W    / ctx->src_w;

    if (dy1 > PREVIEW_H) dy1 = PREVIEW_H;
    if (dx1 > HALF_W)    dx1 = HALF_W;

    for (int dy = dy0; dy < dy1; dy++) {
        int sy = dy * ctx->src_h / PREVIEW_H;
        int ty = sy - (int)rect->top;
        for (int dx = dx0; dx < dx1; dx++) {
            int sx = dx * ctx->src_w / HALF_W;
            int tx = sx - (int)rect->left;
            uint8_t *px = rgb + (ty * (int)tile_w + tx) * 3;
            uint8_t r = px[0], g = px[1], b = px[2];
            preview_buf[dy * PREVIEW_W + ctx->x_off + dx] =
                (uint16_t)(((r & 0xF8u) << 8) | ((g & 0xFCu) << 3) | (b >> 3));
        }
    }
    return 1; /* 继续解码 */
}

static void mjpeg_to_preview_half(const uint8_t *mjpeg, uint32_t size, int x_off)
{
    void *pool = psram_malloc(JPEG_WORK_POOL_SIZE);
    if (!pool) {
        return;
    }

    jpeg_dec_ctx_t jctx = {
        .data  = mjpeg,
        .size  = size,
        .pos   = 0,
        .x_off = x_off,
        .src_w = 0,
        .src_h = 0,
    };

    JDEC jdec;
    JRESULT res = jd_prepare(&jdec, jpeg_infunc, pool, JPEG_WORK_POOL_SIZE, &jctx);
    if (res != JDR_OK) {
        psram_free(pool);
        return;
    }

    /* 保存图像实际尺寸供 outfunc 计算缩放比例 */
    jctx.src_w = jdec.width;
    jctx.src_h = jdec.height;

    jd_decomp(&jdec, jpeg_outfunc, 0 /* scale=1:1 */);
    psram_free(pool);
}

#endif /* CONFIG_LV_USE_SJPG */

/* ------------------------------------------------------------------ */
/*  workqueue 处理函数（在 display_wq 任务上下文中执行）                */
/* ------------------------------------------------------------------ */
static void display_wq_handler(void *param)
{
    display_msg_t *msg = (display_msg_t *)param;
    int x_off = (msg->dev_idx == 0) ? 0 : HALF_W;

    if (msg->format == VIDEO_DISPLAY_FORMAT_UNCOMPRESSED) {
        yuyv_to_preview_half(msg->frame_buf, msg->width, msg->height, x_off);
        lv_img_set_src(preview_obj, &preview_img_dsc);
        lv_label_set_text_fmt(info_label[msg->dev_idx], "CAM%u", (unsigned)msg->dev_idx);
    }
#if defined(CONFIG_LV_USE_SJPG) && CONFIG_LV_USE_SJPG
    else if (msg->format == VIDEO_DISPLAY_FORMAT_MJPEG) {
        mjpeg_to_preview_half(msg->frame_buf, msg->frame_size, x_off);
        lv_img_set_src(preview_obj, &preview_img_dsc);
        lv_label_set_text_fmt(info_label[msg->dev_idx], "CAM%u(MJPEG)", (unsigned)msg->dev_idx);
    }
#endif

    psram_free(msg);
}

/* ------------------------------------------------------------------ */
/*  公共 API：从 USB 帧回调提交显示更新                                 */
/* ------------------------------------------------------------------ */
void video_display_update(uint8_t dev_idx,
                          uint8_t *frame_buf, uint32_t frame_size,
                          uint16_t width, uint16_t height, uint8_t format)
{
    if (!display_wq || dev_idx >= 2) {
        return;
    }

    /*
     * MJPEG 帧需要拷贝数据，因为 frame_buf 在回调返回后会被 USB 立即覆盖。
     * UNCOMPRESSED(YUY2) 也存在同样问题，一并拷贝。
     */
    uint32_t alloc_size = sizeof(display_msg_t) + frame_size;
    display_msg_t *msg = psram_malloc(alloc_size);
    if (!msg) {
        return;
    }

    uint8_t *data_copy = (uint8_t *)msg + sizeof(display_msg_t);
    memcpy(data_copy, frame_buf, frame_size);

    msg->dev_idx    = dev_idx;
    msg->frame_buf  = data_copy;
    msg->frame_size = frame_size;
    msg->width      = width;
    msg->height     = height;
    msg->format     = format;

    if (workqueue_submit(display_wq, display_wq_handler, msg) == 0) {
        psram_free(msg);
    }
}

/* ------------------------------------------------------------------ */
/*  LVGL 屏幕创建                                                       */
/* ------------------------------------------------------------------ */
static lv_obj_t *screen_create(void)
{
    lv_obj_t *screen = lv_obj_create(NULL);
    lv_obj_set_scrollbar_mode(screen, LV_SCROLLBAR_MODE_OFF);
    lv_obj_set_style_bg_color(screen, lv_color_black(), LV_PART_MAIN);

    /* 全屏图像（两路摄像头共用同一 preview_buf，左右各半） */
    preview_img_dsc.header.cf   = LV_IMG_CF_TRUE_COLOR;
    preview_img_dsc.header.w    = PREVIEW_W;
    preview_img_dsc.header.h    = PREVIEW_H;
    preview_img_dsc.data        = (uint8_t *)preview_buf;
    preview_img_dsc.data_size   = sizeof(preview_buf);

    preview_obj = lv_img_create(screen);
    lv_obj_set_pos(preview_obj, 0, 0);
    lv_obj_set_size(preview_obj, PREVIEW_W, PREVIEW_H);

    /* 竖向分隔线 */
    lv_obj_t *divider = lv_obj_create(screen);
    lv_obj_set_style_bg_color(divider, lv_color_hex(0x444444), LV_PART_MAIN);
    lv_obj_set_style_border_width(divider, 0, LV_PART_MAIN);
    lv_obj_set_style_radius(divider, 0, LV_PART_MAIN);
    lv_obj_set_pos(divider, HALF_W, 0);
    lv_obj_set_size(divider, 1, PREVIEW_H);

    /* 左半标签（CAM0） */
    info_label[0] = lv_label_create(screen);
    lv_obj_set_style_text_color(info_label[0], lv_color_hex(0xFFFF00), LV_PART_MAIN);
    lv_obj_set_pos(info_label[0], 4, 4);
    lv_label_set_text(info_label[0], "CAM0: waiting...");

    /* 右半标签（CAM1） */
    info_label[1] = lv_label_create(screen);
    lv_obj_set_style_text_color(info_label[1], lv_color_hex(0x00FFFF), LV_PART_MAIN);
    lv_obj_set_pos(info_label[1], HALF_W + 4, 4);
    lv_label_set_text(info_label[1], "CAM1: waiting...");

    return screen;
}

/* ------------------------------------------------------------------ */
/*  LVGL 任务                                                           */
/* ------------------------------------------------------------------ */
static void task_ui(void *pv)
{
    lv_obj_t *screen = screen_create();
    lv_scr_load(screen);

    while (1) {
        lv_task_handler();
        vTaskDelay(pdMS_TO_TICKS(10));
    }
}

/* ------------------------------------------------------------------ */
/*  公共 API：初始化显示子系统                                           */
/* ------------------------------------------------------------------ */
void video_display_init(void)
{
    lv_init();

    lisa_device_t *gpioa_dev = lisa_device_get("gpioa");
    lisa_device_t *gpiob_dev = lisa_device_get("gpiob");

    lisa_display_config_t display_config = {
        .bus_type = LISA_DISPLAY_BUS_SPI_4WIRE,
        .bus_config = {
            .spi_4wire = {
                .spi_dev = lisa_device_get("spi1"),
                .cs_gpio = gpiob_dev,
                .cs_pin  = LCD_CS_PIN,
                .dc_gpio = gpiob_dev,
                .dc_pin  = LCD_CD_PIN,
                .spi_freq = 50 * 1000 * 1000,
            }
        },
        .backlight = {
            .type               = LISA_DISPLAY_BACKLIGHT_TYPE_PWM,
            .blacklight_polarity = LISA_DISPLAY_BLACKLIGHT_POLARITY_LOW,
            .config.pwm = {
                .channel = 0,
                .dev     = lisa_device_get("pwm0"),
                .freq    = 2000,
            }
        },
        .rst_gpio = gpioa_dev,
        .rst_pin  = LCD_RST_PIN,
    };

    lisa_device_t *display_dev = lisa_device_get("display");
    if (!display_dev) {
        printf("[DISP] Failed to get display device\r\n");
        return;
    }

    lisa_display_attach_bus(display_dev, &display_config);
    lv_port_disp_init(display_dev);
    lisa_display_blanking_off(display_dev);

    display_wq = workqueue_create("disp_wq", 9, 10, 8192);
    if (!display_wq) {
        printf("[DISP] Failed to create display workqueue\r\n");
    }

    xTaskCreate(task_ui, "task_ui", 4 * 1024, NULL, configMAX_PRIORITIES - 2, NULL);
}
```

## src/video_display.h
```c
/*
 * Copyright (c) 2024, ListenAI
 *
 * SPDX-License-Identifier: Apache-2.0
 */
#ifndef VIDEO_DISPLAY_H
#define VIDEO_DISPLAY_H

#include <stdint.h>

/* 与 USBH_VIDEO_FORMAT_* 保持一致，避免在 display 模块中引入 CherryUSB 头文件 */
#define VIDEO_DISPLAY_FORMAT_UNCOMPRESSED 0
#define VIDEO_DISPLAY_FORMAT_MJPEG        1

/**
 * 初始化显示子系统（LVGL + ST7789P3 + LVGL 任务）。
 * 必须在 USB 初始化之前调用。
 */
void video_display_init(void);

/**
 * 将一帧图像更新到屏幕对应摄像头区域。
 * 屏幕左右各半：dev_idx=0 → 左半，dev_idx=1 → 右半。
 * 可在 USB 任务上下文（帧回调）中调用，内部通过 workqueue 异步处理。
 *
 * @param dev_idx     设备索引（0 或 1）
 * @param frame_buf   帧数据缓冲区
 * @param frame_size  帧数据字节数
 * @param width       图像宽度（像素）
 * @param height      图像高度（像素）
 * @param format      VIDEO_DISPLAY_FORMAT_UNCOMPRESSED 或 VIDEO_DISPLAY_FORMAT_MJPEG
 */
void video_display_update(uint8_t dev_idx,
                          uint8_t *frame_buf, uint32_t frame_size,
                          uint16_t width, uint16_t height, uint8_t format);

#endif /* VIDEO_DISPLAY_H */
```
