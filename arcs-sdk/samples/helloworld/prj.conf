## CMakeLists.txt
```
cmake_minimum_required(VERSION 3.19)

set(CMAKE_EXPORT_COMPILE_COMMANDS ON)

find_package(listenai-cmake REQUIRED HINTS $ENV{ARCS_BASE})

project(helloworld)

listenai_add_executable(${PROJECT_NAME})

target_sources(${PROJECT_NAME} PRIVATE src/main.c)
```

## Kconfig
```
osource "$LISTENAI_MODULES"
```

## sample.yaml
```
tests:
  samples.helloworld:
    platform:
      - arcs_evb
    log_analyzer:
      type: "regex"
      pattern: "Hello, world!"
```

## prj.conf
```kconfig
# 项目可根据需要在此文件中设置对应的配置
CONFIG_ARCS_AP_CORE=y
```

## src/main.c
```c
/* 定义 LOG_TAG (必须在包含 lisa_log.h 之前) */
#define LOG_TAG "logger_sample"

/* 日志头文件 */
#include <lisa_log.h>

#include "stdio.h"

int main(int argc, char **argv)
{
    LOGI("Hello, world! \n");

    return 0;
}
```
