## CMakeLists.txt
```
cmake_minimum_required(VERSION 3.13)

set(CMAKE_EXPORT_COMPILE_COMMANDS ON)

find_package(listenai-cmake REQUIRED HINTS $ENV{ARCS_BASE})


project(arcs)

listenai_add_executable(${PROJECT_NAME})

target_sources(${PROJECT_NAME} PRIVATE
    src/main.c
    src/fs.c
    src/usb_descriptors.c
)

listenai_include_directories(
    src
)

listenai_link_libraries(lsfs)
listenai_link_libraries(disk)
listenai_link_libraries(elmfat)
```

## Kconfig
```
osource "$ARCS_BASE/Kconfig"
osource "../../../modules/fs/Kconfig"
```

## sample.yaml
```
tests:
  samples.usb.device.adb:
    build_only: true
```

## prj.conf
```kconfig
# 项目可根据需要在此文件中设置对应的配置

# TinyUSB 配置
CONFIG_TINY_USB=y
CONFIG_TINY_USB_USE_CUSTOM_CONFIG_FILE=y
CONFIG_TINY_USB_CONFIG_FILE="tusb_config.h"

# 文件系统配置
CONFIG_FILE_SYSTEM=y
CONFIG_FATFS_FILESYSTEM=y
CONFIG_DISK_DRIVER=y
CONFIG_DISK_DRIVER_SDMMC=y

# 抽象文件系统
CONFIG_LSFS=y
CONFIG_LSFS_FAT=y

# ADB 配置
CONFIG_TUSB_APP_CLASS=y
CONFIG_ADB_SYNC=y
CONFIG_ADB_PUSH_PULL_DEFAULT_ROOT="/SD:/adb/"
CONFIG_ADB_SHELL=y

# Shell 配置
CONFIG_SDK_MODULE_LETTER_SHELL=y
CONFIG_SDK_MODULE_LETTER_SHELL_CONFIG_FILE="shell_cfg_user.h"

# 系统配置
CONFIG_SYSLOG_UART_BAUDRATE=921600
CONFIG_LINK_OPTION_NOSYS_SPECS=y
CONFIG_DCACHE_ENABLE=y

# 内存配置
CONFIG_PSRAM_HEAP_SIZE=0x300000
CONFIG_HEAP_SIZE=0x10000

# 日志配置
CONFIG_EASYLOGGER_ASYNC_BUF_SIZE=102400
```

## src/main.c
```c
#include "log_print.h"
#include "tusb.h"
#include "arcs_ap.h"

#include "adb.h"
#include "tusb.h"
#include "adb_device.h"
#include "adb_shell.h"
#include "adb_sync.h"

#include "FreeRTOS.h"
#include "task.h"

#include <stdio.h>

#include "esp_heap_caps_init.h"
#include "esp_heap_caps.h"
#include "heap_memory_layout.h"
#include "heap_private.h"
#include "lisa_log.h"

static void heap_travel_cb1(void *start, void *end, multi_heap_info_t *info)
{
    LOGI("%p %p %12d %12d %12d %12d %12d %12d %12d\r\n", start, end, info->allocated_blocks, info->free_blocks,
           info->total_blocks, info->largest_free_block, info->total_allocated_bytes, info->total_free_bytes,
           info->minimum_free_bytes);
}

void usb_task(void *arg)
{
    // enable usb clock
    IP_SYSCTRL->REG_PERI_CLK_CFG6.bit.ENA_USB_CLK = 0x01;
    IP_CMN_SYS->REG_USB_CTRL1.bit.USBPHY_OUTCLKSEL = 0x1;
    IP_CMN_SYS->REG_USB_CTRL1.bit.USBC_CFG_IDDIG = 0x1;   // Config "B" device
    IP_CMN_SYS->REG_USB_CTRL1.bit.UTMI_DATABUS16_8 = 0x1; // 16bit mode

    adb_init();

#if CONFIG_ADB_SHELL
    adb_shell_init();
#endif

#if CONFIG_ADB_SYNC
    adb_sync_init();
#endif

    tud_disconnect(); // soft-disconnect from host
    // Initialize TinyUSB
    tusb_init();
    tud_connect(); // soft-connect to host

    while (1) {
        tud_task();
    }
}

int main(int argc, char **argv)
{
    LOGI("USB CDC Echo example starting...\n");
    extern int test_lsfs_init(void);

    test_lsfs_init();

    LOGI("TinyUSB initialized");
    xTaskCreate(usb_task, "usb_task", 1024 * 1, NULL, 5, NULL);
    while (1) {
        LOGI("USB ADB example running...\n");
        void heap_caps_travel(void (*callback)(void *, void *, multi_heap_info_t *));
        LOGI("%10s %10s %12s %12s %12s %12s %12s %12s %12s\r\n", "[Start]", "[End]", "[Alloc/BK]", "[Free/BK]",
             "[Total/BK]", "[MaxFree/BK]", "[Alloc/B]", "[Free/B]", "[MinFree/B]");
        heap_caps_travel(heap_travel_cb1);

        vTaskDelay(1000);
    }

    return 0;
}
```

## src/fs.c
```c
#include <string.h>
#include "lsfs.h"
#include "disk/disk_access.h"
#include "log_print.h"

#define LOGD(format, ...) CLOG(format, ##__VA_ARGS__)

#define RAMDISK_DEVICE      "RAM:"
#define RAMDISK_MOUNT_POINT "/" RAMDISK_DEVICE
#define RAMDISK_FILE        RAMDISK_MOUNT_POINT "/ram.txt"

#define FLASHDISK_DEVICE      "NAND:"
#define FLASHDISK_MOUNT_POINT "/" FLASHDISK_DEVICE
#define FLASHDISK_FILE        FLASHDISK_MOUNT_POINT "/flash.txt"

#define SDMMC_DEVICE      "SD:"
#define SDMMC_MOUNT_POINT "/" SDMMC_DEVICE
#define SDMMC_FILE        SDMMC_MOUNT_POINT "/sdmmc.txt"

static struct lsfs_mount_t ram_lsfs_mnt = {
    .type = LSFS_FATFS,
    .mnt_point = RAMDISK_MOUNT_POINT,
    .fs_data = NULL,
};

static struct lsfs_mount_t flash_lsfs_mnt = {
    .type = LSFS_FATFS,
    .mnt_point = FLASHDISK_MOUNT_POINT,
    .fs_data = NULL,
};

static struct lsfs_mount_t sdmmc_lsfs_mnt = {
    .type = LSFS_FATFS,
    .mnt_point = SDMMC_MOUNT_POINT,
    .fs_data = NULL,
};

static int fs_mount(struct lsfs_mount_t *mp)
{
    int ret;

    ret = lsfs_mount(mp);
    if (ret != 0) {
        LOGD("No file system reformatting");
        ret = lsfs_mkfs(mp->type, &mp->mnt_point[1], NULL, 0);
        if (ret == 0) {
            LOGD("mkfs success");
            ret = lsfs_mount(mp);
        } else {
            LOGD("mkfs failed,fr:%d", ret);
        }
    }

    if (ret != 0) {
        LOGD("Failed to mount filesystem: %d", ret);
        return ret;
    }
    LOGD("%s mounted successfully", mp->mnt_point);
}

static int fs_unmount(struct lsfs_mount_t *mp)
{
    int ret;

    ret = lsfs_unmount(mp);
    if (ret != 0) {
        LOGD("%s unmount failed!\n", mp->mnt_point);
        return ret;
    }
    LOGD("%s unmount success!\n", mp->mnt_point);
    return 0;
}

static int list_dir(const char *path)
{
    struct lsfs_dir_t dir;
    struct lsfs_dirent entry;
    int ret;
    int nfile = 0, ndir = 0;
    /* 初始化目录对象 */
    lsfs_dir_t_init(&dir);

    ret = lsfs_opendir(&dir, path);
    LOGD("%s opendir: %d", path, ret);
    if (ret == 0) {

        while (1) {
            ret = lsfs_readdir(&dir, &entry);
            if (ret != 0 || entry.name[0] == 0) {
                break; /* Error or end of dir */
            }

            if (entry.type == LSFS_DIR_ENTRY_DIR) {
                /* Directory */
                LOGD("   <DIR>   %s", entry.name);
                ndir++;
            } else {
                /* File */
                LOGD("%10lu %s", entry.size, entry.name);
                nfile++;
            }
        }
        lsfs_closedir(&dir);
        LOGD("%d dirs, %d files.", ndir, nfile);
    } else {
        LOGD("Failed to open \"%s\". (%u)", path, ret);
    }
    return ret;
}

int fs_write_read(const char *fullpath)
{
    struct lsfs_file_t file;
    int ret;
    char buffer[64];

    lsfs_file_t_init(&file);
    ret = lsfs_open(&file, fullpath, LSFS_O_CREATE | LSFS_O_TRUNC | LSFS_O_WRITE);
    if (ret != 0) {
        LOGD("Failed to open file: %d", ret);
        return ret;
    }

    ret = lsfs_write(&file, fullpath, strlen(fullpath));
    if (ret != strlen(fullpath)) {
        LOGD("Failed to write to file: %d", ret);
        return ret;
    }
    LOGD("Write to file: %s", fullpath);

    lsfs_close(&file);

    lsfs_file_t_init(&file);
    ret = lsfs_open(&file, fullpath, LSFS_O_READ);
    if (ret != 0) {
        LOGD("Failed to open file for reading: %d", ret);
        return ret;
    }

    ret = lsfs_read(&file, buffer, sizeof(buffer) - 1);
    if (ret <= 0) {
        LOGD("Failed to read from file: %d", ret);
        return ret;
    }

    buffer[ret] = '\0';
    LOGD("Read from file: %s", buffer);

    lsfs_close(&file);

    return 0;
}

extern int sdmmc_hard_init(void);
int test_lsfs_init()
{
    sdmmc_hard_init();
    disk_init(NULL);
    lsfs_init();

    fs_mount(&sdmmc_lsfs_mnt);
    fs_write_read(SDMMC_FILE);
    list_dir(SDMMC_MOUNT_POINT "/");

    return 0;
}
```
