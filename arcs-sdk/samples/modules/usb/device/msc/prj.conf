## CMakeLists.txt
```
cmake_minimum_required(VERSION 3.13)

set(CMAKE_EXPORT_COMPILE_COMMANDS ON)

find_package(listenai-cmake REQUIRED HINTS $ENV{ARCS_BASE})

project(arcs)

listenai_add_executable(${PROJECT_NAME})

target_sources(${PROJECT_NAME} PRIVATE 
    src/main.c
    src/usb_descriptors.c
)

listenai_include_directories(
    src
)

target_compile_options(${PROJECT_NAME} PRIVATE
    -Os
)
```

## sample.yaml
```
tests:
  samples.usb.device.msc:
    programmer: arcs
    runner: uart
    log_analyzer:
      type: "regex"
      pattern: "Device mounted"
```

## prj.conf
```kconfig
# 项目可根据需要在此文件中设置对应的配置

# TinyUSB 配置
CONFIG_TINY_USB=y
CONFIG_TINY_USB_USE_CUSTOM_CONFIG_FILE=y
CONFIG_TINY_USB_CONFIG_FILE="tusb_config.h"

# 日志配置
CONFIG_LOG=y
CONFIG_SYSLOG_PRINTK_REDIRECT=y

# 磁盘驱动配置
CONFIG_DISK_DRIVER=y
CONFIG_DISK_DRIVER_SDMMC=y

# 系统配置
CONFIG_LINK_OPTION_NOSYS_SPECS=y
```

## src/main.c
```c
/*
 * Copyright (c) 2023, LISTENAI
 *
 * SPDX-License-Identifier: Apache-2.0
 */

#define LOG_TAG    "main"
#if CONFIG_LOG
#include "lisa_log.h"
#endif

#if CFG_TUSB_OS == OPT_OS_FREERTOS
#include "FreeRTOS.h"
#include "task.h"
#endif
#include "ClockManager.h"
#include "log_print.h"
#include "tusb.h"
#include "arcs_ap.h"
#include "disk/disk_access.h"
#include <disk/disk.h>
#include "lisa_device.h"
#include "lisa_sdmmc.h"

#include <stdio.h>
#include <string.h>
#include <stdlib.h>

#define MAIN_TASK_STACK_SIZE 1024
#define MAIN_TASK_PRIORITY   configMAX_PRIORITIES - 1

#define USBD_STACK_SIZE (3*configMINIMAL_STACK_SIZE)

// Block size (in bytes)
#define DISK_BLOCK_SIZE    512

// Whether the disk is ejected
static bool ejected = false;

// SCSI Commands that are not in tusb_msc.h
#define SCSI_CMD_MODE_SENSE_10 0x5A

// Invoked when device is mounted
void tud_mount_cb(void)
{
    LOGI("[%s] Device mounted", __func__);
    ejected = false;
}

// Invoked when device is unmounted
void tud_umount_cb(void)
{
    LOGI("[%s] Device unmounted", __func__);
}

// Invoked when usb bus is suspended
void tud_suspend_cb(bool remote_wakeup_en)
{
    (void) remote_wakeup_en;
    LOGI("[%s] Device suspended", __func__);
}

// Invoked when usb bus is resumed
void tud_resume_cb(void)
{
    LOGD("[%s] Device resumed", __func__);
}

// Invoked when received SCSI_CMD_INQUIRY
// Application fill vendor id, product id and revision with string up to 8, 16, 4 characters respectively
void tud_msc_inquiry_cb(uint8_t lun, uint8_t vendor_id[8], uint8_t product_id[16], uint8_t product_rev[4])
{
    (void) lun;

    const char vid[] = "TinyUSB";
    const char pid[] = "Mass Storage";
    const char rev[] = "1.0";

    memcpy(vendor_id  , vid, strlen(vid));
    memcpy(product_id , pid, strlen(pid));
    memcpy(product_rev, rev, strlen(rev));
}



// Invoked when received Test Unit Ready command.
// return true allowing host to read/write this LUN e.g SD card inserted
bool tud_msc_test_unit_ready_cb(uint8_t lun)
{
    (void) lun;

    // RAM disk is ready until ejected
    if (ejected) {
        // Additional Sense 3A-00 is NOT_FOUND
        tud_msc_set_sense(lun, SCSI_SENSE_NOT_READY, 0x3a, 0x00);
        return false;
    }

    return true;
}

// Invoked when received SCSI_CMD_READ_CAPACITY_10 and SCSI_CMD_READ_FORMAT_CAPACITY to determine the disk size
// Application update block count and block size
void tud_msc_capacity_cb(uint8_t lun, uint32_t* block_count, uint16_t* block_size)
{
    (void) lun;

    const char *pdrv = CONFIG_DISK_SDMMC_VOLUME_NAME;
    uint32_t sector_count = 0;
    uint32_t sector_size = 0;

    // Get disk capacity
    if (disk_access_ioctl(pdrv, DISK_IOCTL_GET_SECTOR_COUNT, &sector_count) != 0 ||
        disk_access_ioctl(pdrv, DISK_IOCTL_GET_SECTOR_SIZE, &sector_size) != 0) {
        // If failed to get disk info, use default values
        sector_count = 0x0001000; // 4MB
        sector_size = DISK_BLOCK_SIZE;
    }

    *block_count = sector_count;
    *block_size  = sector_size;

    LOGD("[%s] block_count: %lu, block_size: %u", __func__, *block_count, *block_size);
}

// Invoked when received Start Stop Unit command
// - Start = 0 : stopped power mode, if load_eject = 1 : unload disk storage
// - Start = 1 : active mode, if load_eject = 1 : load disk storage
bool tud_msc_start_stop_cb(uint8_t lun, uint8_t power_condition, bool start, bool load_eject)
{
    (void) lun;
    (void) power_condition;

    LOGD("[%s] power:%d, start:%d, load_eject:%d", __func__, power_condition, start, load_eject);

    if (load_eject)
    {
        if (!start)  // Eject
        {
            const char *pdrv = CONFIG_DISK_SDMMC_VOLUME_NAME;
            int status = disk_access_status(pdrv);
            LOGD("[%s] disk status before eject: %d", __func__, status);

            if (status == DISK_STATUS_OK)
            {
                ejected = true;
                LOGD("[%s] disk ejected", __func__);
            }
            else
            {
                LOGD("[%s] disk not ready for eject", __func__);
                return false;
            }
        }
        else  // Load
        {
            ejected = false;
            LOGD("[%s] disk loaded", __func__);
        }
    }
    else  // Start/Stop power
    {
        if (!start)
        {
            LOGD("[%s] stopped power mode", __func__);
        }
        else
        {
            LOGD("[%s] active mode", __func__);
        }
    }

    return true;
}

// Callback invoked when received READ10 command.
// Copy disk's data to buffer (up to bufsize) and return number of copied bytes.
int32_t tud_msc_read10_cb(uint8_t lun, uint32_t lba, uint32_t offset, void* buffer, uint32_t bufsize)
{
    (void) lun;

    const char *pdrv = CONFIG_DISK_SDMMC_VOLUME_NAME;

    int status = disk_access_status(pdrv);
    
    if (status != DISK_STATUS_OK) {
        LOGD("[%s] disk not ready", __func__);
        tud_msc_set_sense(lun, SCSI_SENSE_NOT_READY, 0x3A, 0x00);
        return -1;
    }

    int ret = disk_access_read(pdrv, buffer, lba, bufsize / DISK_BLOCK_SIZE);
    if (ret != 0) {
        LOGD("[%s] disk_access_read failed with error %d", __func__, ret);
        tud_msc_set_sense(lun, SCSI_SENSE_MEDIUM_ERROR, 0x03, 0x00);
        return -1;
    }

    return bufsize;
}

// Callback invoked when received WRITE10 command.
// Process data in buffer to disk's storage and return number of written bytes
int32_t tud_msc_write10_cb(uint8_t lun, uint32_t lba, uint32_t offset, uint8_t* buffer, uint32_t bufsize)
{
    (void) lun;
    // LOGD("[%s]: lba:%lu, offset:%lu, bufsize:%lu", __func__, lba, offset, bufsize);

    const char *pdrv = CONFIG_DISK_SDMMC_VOLUME_NAME;
    
    int status = disk_access_status(pdrv);
    // LOGD("[%s] disk status: %d", __func__, status);
    
    if (status != DISK_STATUS_OK) {
        LOGD("[%s] disk not ready", __func__);
        tud_msc_set_sense(lun, SCSI_SENSE_NOT_READY, 0x3A, 0x00);
        return -1;
    }

    int ret = disk_access_write(pdrv, buffer, lba, bufsize / DISK_BLOCK_SIZE);
    if (ret != 0) {
        LOGD("[%s] disk_access_write failed with error %d", __func__, ret);
        tud_msc_set_sense(lun, SCSI_SENSE_MEDIUM_ERROR, 0x03, 0x00);
        return -1;
    }

    return bufsize;
}

bool tud_msc_is_writable_cb (uint8_t lun)
{
    (void) lun;
    bool writable = true;

    const char *pdrv = CONFIG_DISK_SDMMC_VOLUME_NAME;
    int status = disk_access_status(pdrv);

    if (status == DISK_STATUS_OK) {
        writable = true;
    } else {
        writable = false;
    }
    LOGD("[%s] writable: %d", __func__, writable);

    return writable;
}


// Callback invoked when received an SCSI command not in built-in list below
// - READ_CAPACITY10, READ_FORMAT_CAPACITY, INQUIRY, MODE_SENSE6, REQUEST_SENSE
// - READ10 and WRITE10 has their own callbacks
int32_t tud_msc_scsi_cb(uint8_t lun, uint8_t const scsi_cmd[16], void* buffer, uint16_t bufsize)
{
// read10 & write10 has their own callback and MUST not be handled here

  void const* response = NULL;
  int32_t resplen = 0;

  // most scsi handled is input
  bool in_xfer = true;

  switch (scsi_cmd[0])
  {
    default:
      // Set Sense = Invalid Command Operation
      tud_msc_set_sense(lun, SCSI_SENSE_ILLEGAL_REQUEST, 0x20, 0x00);

      // negative means error -> tinyusb could stall and/or response with failed status
      resplen = -1;
    break;
  }

  // return resplen must not larger than bufsize
  if ( resplen > bufsize ) resplen = bufsize;

  if ( response && (resplen > 0) )
  {
    if(in_xfer)
    {
      memcpy(buffer, response, (size_t) resplen);
    }else
    {
      // SCSI output
    }
  }

  return (int32_t) resplen;
}

// USB Device Driver task
static void usb_device_task(void *param)
{
    (void) param;

    // init device stack on configured roothub port
    tud_init(BOARD_TUD_RHPORT);

    // RTOS forever loop
    while (1)
    {
        tud_task();
    }
}

static void user_usbd_msc_init(void)
{
    //enable usb clock
    __HAL_CRM_USB_CLK_ENABLE();
    IP_CMN_SYS->REG_USB_CTRL1.bit.USBC_CFG_IDDIG = 0x1; //Config "B" device
    IP_CMN_SYS->REG_USB_CTRL1.bit.UTMI_DATABUS16_8 = 0x1; //16bit mode

    tud_disconnect(); // soft-disconnect from host
    tusb_init();
    tud_connect(); // soft-connect to host

    LOGD("TinyUSB MSC class ready\n");
}

static int user_disk_init(void)
{
    lisa_sdmmc_probe(lisa_device_get("sdmmc0"));

    disk_init(NULL);

    return 0;
}


int main(int argc, char **argv)
{
    int ret = 0;
#if CFG_TUSB_OS == OPT_OS_FREERTOS
    
    LOGI("Start usb device msc sample\n");

    ret = user_disk_init();
    if(ret < 0){
        LOGE("user_disk_init failed");
        return ret;
    }

    LOGI("user_disk_init success");

    user_usbd_msc_init();

    xTaskCreate(usb_device_task, "usbd", USBD_STACK_SIZE, NULL, configMAX_PRIORITIES - 1, NULL);

#else
    lisa_log_init();
    
    log_i("Start usb device msc sample\n");

    user_usbd_msc_init();

    while (1) {
        tud_task(); // tinyusb device task
    }
#endif

    return 0;
}
```

## src/usb_descriptors.c
```c
#include "tusb.h"
#include "log_print.h"

//--------------------------------------------------------------------+
// Device Descriptor
//--------------------------------------------------------------------+
// Define USB version based on speed mode
#if (BOARD_TUD_MAX_SPEED == OPT_MODE_HIGH_SPEED)
  #define USB_BCD    0x0200  // USB 2.0
#else
  #define USB_BCD    0x0110  // USB 1.1
#endif

tusb_desc_device_t const desc_device = {
    .bLength            = sizeof(tusb_desc_device_t),
    .bDescriptorType    = TUSB_DESC_DEVICE,
    .bcdUSB             = USB_BCD,
    .bDeviceClass       = 0x00,  // Each interface specifies its own class
    .bDeviceSubClass    = 0x00,
    .bDeviceProtocol    = 0x00,
    .bMaxPacketSize0    = CFG_TUD_ENDPOINT0_SIZE,
    .idVendor           = 0xCAFE,
    .idProduct          = 0x4323,  // Different PID for MSC
    .bcdDevice          = 0x0100,
    .iManufacturer      = 0x01,
    .iProduct           = 0x02,
    .iSerialNumber      = 0x03,
    .bNumConfigurations = 0x01
};

//--------------------------------------------------------------------+
// String Descriptors
//--------------------------------------------------------------------+
char const* string_desc_arr[] = {
    (const char[]) { 0x09, 0x04 },  // 0: is supported language is English (0x0409)
    "TinyUSB",                      // 1: Manufacturer
    "TinyUSB MSC Device",           // 2: Product
    "123456",                       // 3: Serial
};

//--------------------------------------------------------------------+
// Configuration Descriptor
//--------------------------------------------------------------------+
enum
{
    ITF_NUM_MSC = 0,
    ITF_NUM_TOTAL
};

#define EPNUM_MSC_OUT    0x01
#define EPNUM_MSC_IN     0x81

#if (BOARD_TUD_MAX_SPEED == OPT_MODE_HIGH_SPEED)
  #define EP_BULK_MAX_SIZE    512
#else
  #define EP_BULK_MAX_SIZE    64
#endif

#define CONFIG_TOTAL_LEN    (TUD_CONFIG_DESC_LEN + TUD_MSC_DESC_LEN)

// Full-speed Configuration Descriptor
uint8_t const desc_fs_configuration[] = {
    // Config number, interface count, string index, total length, attribute, power in mA
    TUD_CONFIG_DESCRIPTOR(1, ITF_NUM_TOTAL, 0, CONFIG_TOTAL_LEN, TUSB_DESC_CONFIG_ATT_REMOTE_WAKEUP, 100),

    // MSC Interface
    TUD_MSC_DESCRIPTOR(ITF_NUM_MSC, 0, EPNUM_MSC_OUT, EPNUM_MSC_IN, EP_BULK_MAX_SIZE)
};

//--------------------------------------------------------------------+
// Configuration Descriptor
//--------------------------------------------------------------------+
uint8_t const * tud_descriptor_device_cb(void)
{
    return (uint8_t const *) &desc_device;
}

uint8_t const * tud_descriptor_configuration_cb(uint8_t index)
{
    (void) index;
    return desc_fs_configuration;
}

// Invoked when received GET STRING DESCRIPTOR request
// Application return pointer to descriptor, whose contents must exist long enough for transfer to complete
uint16_t const* tud_descriptor_string_cb(uint8_t index, uint16_t langid)
{
    (void) langid;
    static uint16_t desc_str[32];
    uint8_t chr_count;

    if (index == 0) {
        memcpy(&desc_str[1], string_desc_arr[0], 2);
        chr_count = 1;
    } else {
        if (index >= sizeof(string_desc_arr)/sizeof(string_desc_arr[0])) return NULL;
        
        const char* str = string_desc_arr[index];
        chr_count = strlen(str);
        if (chr_count > 31) chr_count = 31;
        
        // Convert ASCII to UTF-16
        for (uint8_t i = 0; i < chr_count; i++) {
            desc_str[1+i] = str[i];
        }
    }

    // first byte is length (including header), second byte is string type
    desc_str[0] = (TUSB_DESC_STRING << 8) | (2 * chr_count + 2);
    return desc_str;
}
```
