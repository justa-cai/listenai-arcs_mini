## CMakeLists.txt
```
cmake_minimum_required(VERSION 3.13)

set(CMAKE_EXPORT_COMPILE_COMMANDS ON)

find_package(listenai-cmake REQUIRED HINTS $ENV{ARCS_BASE})


include_directories(
    ${CMAKE_SOURCE_DIR}/modules/libpng/libpng16
    ${CMAKE_SOURCE_DIR}/modules/zlib/include
)

project(arcs)

listenai_add_executable(${PROJECT_NAME})

target_sources(${PROJECT_NAME} PRIVATE src/main.c)
```

## prj.conf
```kconfig
# 项目可根据需要在此文件中设置对应的配置
CONFIG_MEM_CONFIG=y

CONFIG_SDK_MODULE_LIBPNG=y
```

## src/main.c
```c
/*
 * PNG to RGB565 conversion sample from memory buffer
 * Uses libpng to decompress PNG and convert to RGB565 format
 */

#include "lisa_log.h"

#include <stdio.h>
#include <stdint.h>
#include <stdlib.h>
#include <string.h>
#include <setjmp.h>

/* Include libpng library header */
#include "libpng16/png.h"  
#include "pngconf.h"  // 添加这个


typedef struct {
	int32_t width;
	int32_t height;
	uint8_t *rgb_data;
	int32_t rgb_data_len;
} png_convert_info;

// 定义用于内存读取的结构体
typedef struct {
    const uint8_t *data;
    size_t size;
    size_t offset;
} png_memory_buffer;

// 从内存中读取 PNG 数据的回调函数
static void png_read_memory(png_structp png_ptr, png_bytep data, size_t length)
{
    png_memory_buffer *buffer = (png_memory_buffer*)png_get_io_ptr(png_ptr);    

    // 检查指针和大小的有效性
    if (!buffer || !buffer->data) {
        png_error(png_ptr, "Invalid buffer");
        return;
    }    
    
    // 检查是否有足够的数据可读
    if (buffer->offset + length > buffer->size) {
        png_error(png_ptr, "Read beyond end of buffer");
        return;
    }
    
    // 复制数据
    memcpy(data, buffer->data + buffer->offset, length);
    buffer->offset += length;
}


int png_convert_2_rgb(const uint8_t *png_data, int32_t png_data_len, png_convert_info *info)
{
    // 添加输入参数检查
    if (!png_data || png_data_len <= 8) {  // PNG 至少需要 8 字节的签名
        LOGI("Invalid input parameters\n");
        return -1;
    }

    // 检查 PNG 签名
    if (png_sig_cmp(png_data, 0, 8) != 0) {
        LOGI("Invalid PNG signature\n");
        return -1;
    }

    png_structp png_ptr;
    png_infop info_ptr;
    png_bytep *row_pointers;
    int ret = -1;

    // 初始化内存读取缓冲区，确保所有字段都被正确初始化
    png_memory_buffer buffer;
    memset(&buffer, 0, sizeof(buffer));  // 清零所有字段
    buffer.data = png_data;
    buffer.size = png_data_len;
    buffer.offset = 0;

    // Initialize PNG structures
    png_ptr = png_create_read_struct(PNG_LIBPNG_VER_STRING, NULL, NULL, NULL);
    if (!png_ptr) {
        return -1;
    }

    info_ptr = png_create_info_struct(png_ptr);
    if (!info_ptr) {
        png_destroy_read_struct(&png_ptr, NULL, NULL);
        return -1;
    }

    // Error handling
    if (setjmp(png_jmpbuf(png_ptr))) {
        LOGI("PNG error occurred\n");
        if (row_pointers) {
            free(row_pointers);
        }
        png_destroy_read_struct(&png_ptr, &info_ptr, NULL);
        return -1;
    }

    // 设置自定义读取函数
    png_set_read_fn(png_ptr, &buffer, png_read_memory);
    // Read PNG header
    png_read_info(png_ptr, info_ptr);

    // Get image info
    info->width = png_get_image_width(png_ptr, info_ptr);
    info->height = png_get_image_height(png_ptr, info_ptr);
    int bit_depth = png_get_bit_depth(png_ptr, info_ptr);
    int color_type = png_get_color_type(png_ptr, info_ptr);

    LOGI("Image info: width=%d, height=%d, bit_depth=%d, color_type=%d\n",
         info->width, info->height, bit_depth, color_type);

    // 检查图像尺寸是否合理
    if (info->width <= 0 || info->height <= 0 || 
        info->width > 4096 || info->height > 4096) {
        LOGI("Invalid image dimensions\n");
        png_destroy_read_struct(&png_ptr, &info_ptr, NULL);
        return -1;
    }

    // 设置转换选项
    if (bit_depth == 16)
        png_set_strip_16(png_ptr);
    if (color_type == PNG_COLOR_TYPE_PALETTE)
        png_set_palette_to_rgb(png_ptr);
    if (color_type == PNG_COLOR_TYPE_GRAY && bit_depth < 8)
        png_set_expand_gray_1_2_4_to_8(png_ptr);
    if (png_get_valid(png_ptr, info_ptr, PNG_INFO_tRNS))
        png_set_tRNS_to_alpha(png_ptr);
    if (color_type == PNG_COLOR_TYPE_RGB ||
        color_type == PNG_COLOR_TYPE_GRAY ||
        color_type == PNG_COLOR_TYPE_PALETTE)
        png_set_filler(png_ptr, 0xFF, PNG_FILLER_AFTER);
    if (color_type == PNG_COLOR_TYPE_GRAY ||
        color_type == PNG_COLOR_TYPE_GRAY_ALPHA)
        png_set_gray_to_rgb(png_ptr);

    png_read_update_info(png_ptr, info_ptr);

    // 获取图像信息
    size_t rowbytes = png_get_rowbytes(png_ptr, info_ptr);
    LOGI("Row bytes: %zu\n", rowbytes);
    

    // 分配一行的输入缓冲区
    png_bytep row = (png_bytep)malloc(rowbytes + 16);  // 添加一些安全余量
    if (!row) {
        LOGI("Failed to allocate row buffer\n");
        png_destroy_read_struct(&png_ptr, &info_ptr, NULL);
        return -1;
    }

    // 分配一行的输出缓冲区 (RGB565格式，每像素2字节)
    size_t out_rowbytes = info->width * 2;
    uint8_t *out_row = (uint8_t*)malloc(out_rowbytes + 16);  // 添加一些安全余量
    if (!out_row) {
        LOGI("Failed to allocate output row buffer\n");
        free(row);
        png_destroy_read_struct(&png_ptr, &info_ptr, NULL);
        return -1;
    }

    // 设置回调函数来处理每一行
    int last_processed_row = -1;
    for (int y = 0; y < info->height; y++) {
        // 检查行号连续性
        if (y != last_processed_row + 1) {
            LOGI("Warning: Row discontinuity. Expected %d, processing %d\n", 
                 last_processed_row + 1, y);
        }
        last_processed_row = y;

        // 清空缓冲区，避免脏数据
        memset(row, 0, rowbytes + 16);
        memset(out_row, 0, out_rowbytes + 16);

        // 读取一行
        png_read_row(png_ptr, row, NULL);

        // 转换这一行到 RGB565
        uint8_t *dst = out_row;
        for (int x = 0; x < info->width; x++) {
            // 边界检查
            if ((x * 3 + 2) >= rowbytes) {
                LOGI("Error: Buffer overflow at row %d, column %d\n", y, x);
                break;
            }

            png_byte *px = &(row[x * 3]);
            uint16_t r = px[0];
            uint16_t g = px[1];
            uint16_t b = px[2];
            
            // 边界检查
            if ((dst - out_row + 1) >= out_rowbytes) {
                LOGI("Error: Output buffer overflow at row %d\n", y);
                break;
            }

            // RGB888 转 RGB565
            uint16_t rgb565 = ((r & 0xF8) << 8) | ((g & 0xFC) << 3) | (b >> 3);
            
            // 存储为小端格式
            *dst++ = rgb565 & 0xFF;
            *dst++ = (rgb565 >> 8) & 0xFF;
        }
    }


    // 清理
    free(out_row);
    free(row);
    png_destroy_read_struct(&png_ptr, &info_ptr, NULL);

    return 0;
}


/* This is a minimal PNG image in binary form */

const unsigned char rgb8_png_data[] = {
    0x89, 0x50, 0x4E, 0x47, 0x0D, 0x0A, 0x1A, 0x0A, 0x00, 0x00, 0x00, 0x0D, 0x49, 0x48, 0x44, 0x52, 
    0x00, 0x00, 0x01, 0x00, 0x00, 0x00, 0x01, 0x00, 0x08, 0x02, 0x00, 0x00, 0x00, 0xD3, 0x10, 0x3F, 
    0x31, 0x00, 0x00, 0x00, 0x2C, 0x74, 0x45, 0x58, 0x74, 0x43, 0x6F, 0x70, 0x79, 0x72, 0x69, 0x67, 
    0x68, 0x74, 0x00, 0xA9, 0x20, 0x32, 0x30, 0x31, 0x33, 0x2C, 0x32, 0x30, 0x31, 0x35, 0x20, 0x4A, 
    0x6F, 0x68, 0x6E, 0x20, 0x43, 0x75, 0x6E, 0x6E, 0x69, 0x6E, 0x67, 0x68, 0x61, 0x6D, 0x20, 0x42, 
    0x6F, 0x77, 0x6C, 0x65, 0x72, 0x7D, 0x74, 0x73, 0xFE, 0x00, 0x00, 0x00, 0x74, 0x69, 0x54, 0x58, 
    0x74, 0x4C, 0x69, 0x63, 0x65, 0x6E, 0x73, 0x69, 0x6E, 0x67, 0x00, 0x01, 0x00, 0x65, 0x6E, 0x00, 
    0x00, 0x08, 0xD7, 0x2D, 0x8C, 0x4D, 0x0E, 0x83, 0x20, 0x10, 0x85, 0xAF, 0xF2, 0xE2, 0x01, 0x1C, 
    0xBB, 0x6D, 0x97, 0x78, 0x11, 0x84, 0x97, 0x4A, 0x22, 0x0C, 0x81, 0xB1, 0x0B, 0x4F, 0xAF, 0x09, 
    0x5D, 0x7F, 0x3F, 0x2B, 0x63, 0x0A, 0xDE, 0x18, 0x61, 0x0A, 0xDB, 0x89, 0x7A, 0x6E, 0x47, 0x0A, 
    0x88, 0x9A, 0x7D, 0x2A, 0xA8, 0x6C, 0x70, 0x8D, 0xDE, 0xD2, 0x8F, 0x70, 0x9A, 0xB3, 0x96, 0x8E, 
    0x87, 0xB3, 0x74, 0x62, 0x72, 0x6E, 0xC1, 0x6B, 0x5E, 0xA6, 0x0F, 0x76, 0xB3, 0xDA, 0xDF, 0x22, 
    0xE1, 0xEF, 0x86, 0xA1, 0xCE, 0xDA, 0xBE, 0x32, 0x8E, 0x63, 0x28, 0x17, 0x9B, 0xCA, 0xD3, 0xC8, 
    0x0D, 0x33, 0x32, 0x2A, 0x82, 0xD8, 0x98, 0xAD, 0x26, 0x00, 0x00, 0x02, 0x06, 0x49, 0x44, 0x41, 
    0x54, 0x78, 0xDA, 0xED, 0xD3, 0x01, 0x0D, 0x00, 0x20, 0x0C, 0x03, 0xC1, 0x6E, 0x80, 0x7F, 0xCB, 
    0x28, 0x98, 0x82, 0x5D, 0x73, 0x0A, 0x9A, 0x7C, 0x25, 0x29, 0xB3, 0xAD, 0xEB, 0x3A, 0x0F, 0xD6, 
    0xEA, 0xF4, 0x85, 0xB5, 0x04, 0x80, 0x00, 0x40, 0x00, 0x20, 0x00, 0x10, 0x00, 0x08, 0x00, 0x04, 
    0x00, 0x02, 0x00, 0x01, 0x80, 0x00, 0x40, 0x00, 0x20, 0x00, 0x10, 0x00, 0x08, 0x00, 0x04, 0x00, 
    0x02, 0x00, 0x01, 0x80, 0x00, 0x40, 0x00, 0x20, 0x00, 0x10, 0x00, 0x08, 0x00, 0x04, 0x00, 0x02, 
    0x00, 0x01, 0x80, 0x00, 0x40, 0x00, 0x20, 0x00, 0x10, 0x00, 0x08, 0x00, 0x04, 0x00, 0x02, 0x00, 
    0x01, 0x80, 0x00, 0x40, 0x00, 0x20, 0x00, 0x10, 0x00, 0x08, 0x00, 0x04, 0x00, 0x02, 0x00, 0x01, 
    0x80, 0x00, 0x40, 0x00, 0x20, 0x00, 0x10, 0x00, 0x08, 0x00, 0x04, 0x00, 0x02, 0x00, 0x01, 0x80, 
    0x00, 0x40, 0x00, 0x20, 0x00, 0x04, 0xE0, 0x05, 0x04, 0x00, 0x02, 0x00, 0x01, 0x80, 0x00, 0x40, 
    0x00, 0x20, 0x00, 0x10, 0x00, 0x08, 0x00, 0x04, 0x00, 0x02, 0x00, 0x01, 0x80, 0x00, 0x40, 0x00, 
    0x20, 0x00, 0x10, 0x00, 0x08, 0x00, 0x04, 0x00, 0x02, 0x00, 0x01, 0x80, 0x00, 0x40, 0x00, 0x20, 
    0x00, 0x10, 0x00, 0x08, 0x00, 0x04, 0x00, 0x02, 0x00, 0x01, 0x80, 0x00, 0x40, 0x00, 0x20, 0x00, 
    0x10, 0x00, 0x08, 0x00, 0x04, 0x00, 0x02, 0x00, 0x01, 0x80, 0x00, 0x40, 0x00, 0x20, 0x00, 0x10, 
    0x00, 0x08, 0x00, 0x04, 0x00, 0x02, 0x00, 0x01, 0x80, 0x00, 0x40, 0x00, 0x20, 0x00, 0x10, 0x00, 
    0x08, 0x00, 0x04, 0x00, 0x02, 0x00, 0x01, 0x20, 0x00, 0x10, 0x00, 0x08, 0x00, 0x04, 0x00, 0x02, 
    0x00, 0x01, 0x80, 0x00, 0x40, 0x00, 0x20, 0x00, 0x10, 0x00, 0x08, 0x00, 0x04, 0x00, 0x02, 0x00, 
    0x01, 0x80, 0x00, 0x40, 0x00, 0x20, 0x00, 0x10, 0x00, 0x08, 0x00, 0x04, 0x00, 0x02, 0x00, 0x01, 
    0x80, 0x00, 0x40, 0x00, 0x20, 0x00, 0x10, 0x00, 0x08, 0x00, 0x04, 0x00, 0x02, 0x00, 0x01, 0x80, 
    0x00, 0x40, 0x00, 0x20, 0x00, 0x10, 0x00, 0x08, 0x00, 0x04, 0x00, 0x02, 0x00, 0x01, 0x80, 0x00, 
    0x40, 0x00, 0x20, 0x00, 0x10, 0x00, 0x08, 0x00, 0x04, 0x00, 0x02, 0x00, 0x01, 0x80, 0x00, 0x40, 
    0x00, 0x20, 0x00, 0x10, 0x00, 0x08, 0x00, 0x01, 0xB8, 0x00, 0x01, 0x80, 0x00, 0x40, 0x00, 0x20, 
    0x00, 0x10, 0x00, 0x08, 0x00, 0x04, 0x00, 0x02, 0x00, 0x01, 0x80, 0x00, 0x40, 0x00, 0x20, 0x00, 
    0x10, 0x00, 0x08, 0x00, 0x04, 0x00, 0x02, 0x00, 0x01, 0x80, 0x00, 0x40, 0x00, 0x20, 0x00, 0x10, 
    0x00, 0x08, 0x00, 0x04, 0x00, 0x02, 0x00, 0x01, 0x80, 0x00, 0x40, 0x00, 0x20, 0x00, 0x10, 0x00, 
    0x08, 0x00, 0x04, 0x00, 0x02, 0x00, 0x01, 0x80, 0x00, 0x40, 0x00, 0x20, 0x00, 0x10, 0x00, 0x08, 
    0x00, 0x04, 0x00, 0x02, 0x00, 0x01, 0x80, 0x00, 0x40, 0x00, 0x20, 0x00, 0x10, 0x00, 0x08, 0x00, 
    0x04, 0x00, 0x02, 0x00, 0x01, 0x80, 0x00, 0x40, 0x00, 0x08, 0xC0, 0x0B, 0x08, 0x00, 0x04, 0x00, 
    0x02, 0x00, 0x01, 0x80, 0x00, 0x40, 0x00, 0x20, 0x00, 0x10, 0x00, 0x08, 0x00, 0x04, 0x00, 0x02, 
    0x00, 0x01, 0x80, 0x00, 0x40, 0x00, 0x20, 0x00, 0x10, 0x00, 0x08, 0x00, 0x04, 0x00, 0x02, 0x00, 
    0x01, 0x80, 0x00, 0x40, 0x00, 0x20, 0x00, 0x10, 0x00, 0x08, 0x00, 0x04, 0x00, 0x02, 0x00, 0x01, 
    0x80, 0x00, 0x40, 0x00, 0x20, 0x00, 0x10, 0x00, 0x08, 0x00, 0x04, 0x00, 0x02, 0x00, 0x01, 0x80, 
    0x00, 0x40, 0x00, 0x20, 0x00, 0x10, 0x00, 0x08, 0x00, 0x04, 0x00, 0x02, 0x00, 0x01, 0x80, 0x00, 
    0x60, 0xF4, 0x01, 0x5F, 0xE1, 0x02, 0x57, 0xFB, 0x5D, 0x1C, 0xBA, 0x00, 0x00, 0x00, 0x00, 0x49, 
    0x45, 0x4E, 0x44, 0xAE, 0x42, 0x60, 0x82
};
int main(int argc, char **argv)
{
    LOGI("PNG (from memory) to RGB565 converter sample\n");

    // 打印 PNG 数据的大小
    LOGI("PNG data size: %zu bytes\n", sizeof(rgb8_png_data));
    
    png_convert_info info = {0}; 

    /* Convert JPEG to RGB565 */
    int result = png_convert_2_rgb(rgb8_png_data, sizeof(rgb8_png_data), &info);
    
    if (result == 0) {
        LOGI("Conversion completed successfully\n");
        LOGI("Image dimensions: %d x %d\n", info.width, info.height);
        
        /* Don't forget to free the memory when done */
        if (info.rgb_data) {
            free(info.rgb_data);
        }        

    } else {
        LOGI("Conversion failed\n");
    }
    
    return 0;
}
```
