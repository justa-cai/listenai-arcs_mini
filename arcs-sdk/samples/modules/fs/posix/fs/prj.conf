## CMakeLists.txt
```
cmake_minimum_required(VERSION 3.13)

set(CMAKE_EXPORT_COMPILE_COMMANDS ON)

find_package(listenai-cmake REQUIRED HINTS $ENV{ARCS_BASE})

project(arcs)

listenai_include_directories(
    ./
)

listenai_add_executable(${PROJECT_NAME})

target_sources(${PROJECT_NAME} PRIVATE src/main.c)
```

## sample.yaml
```
tests:
  samples.posix.fs:
    programmer: arcs
    runner: uart
    log_analyzer:
      type: "regex"
      pattern: "LVFS sample"
```

## prj.conf
```kconfig
# 项目可根据需要在此文件中设置对应的配置
CONFIG_ARCS_HAL_WARNING_DISABLE=y
# CONFIG_ARCS_HAL_DEBUG=y
CONFIG_MODULE_FREERTOS=y
CONFIG_MODULE_HEAP=y
CONFIG_LINK_OPTION_NOSYS_SPECS=y
CONFIG_SDK_MODULE_EASYLOGGER=n

# 文件系统配置
CONFIG_FILE_SYSTEM=y
CONFIG_FATFS_FILESYSTEM=y

# DISK驱动使能
CONFIG_DISK_DRIVER=y

# DISK RAM驱动使能及配置
CONFIG_DISK_DRIVER_RAM=y


# 抽象文件系统
CONFIG_LSFS=y
CONFIG_LSFS_FAT=y
CONFIG_LSFS_REGISTER_VFS=y

# 虚拟文件系统
CONFIG_LVFS=y
CONFIG_LVFS_POSIX_API=y
CONFIG_LVFS_POSIX_API_ALIAS=y

CONFIG_SYSFS_EMPTY_IMPL=n
```

## src/main.c
```c
#include <string.h>
#include <stdio.h>
#include <fcntl.h>
#include <unistd.h>
#include "lsfs.h"
#include "lvfs.h"
#include "disk/disk_access.h"
#include "lisa_log.h"

#define RAMDISK_DEVICE      "RAM:"
#define RAMDISK_MOUNT_POINT "/"RAMDISK_DEVICE
#define RAMDISK_FILE RAMDISK_MOUNT_POINT"/ram.txt"

static struct lsfs_mount_t ram_lsfs_mnt = {
    .type = LSFS_FATFS,
    .mnt_point = RAMDISK_MOUNT_POINT,
    .fs_data = NULL,
};

static int fs_mount(struct lsfs_mount_t* mp)
{
    int ret;

    ret = lsfs_mount(mp);
    if(ret != 0){
        LOGD("No file system reformatting");
        ret = lsfs_mkfs(mp->type,&mp->mnt_point[1],NULL,0);
        if(ret == 0){
            LOGD("mkfs success");
            ret = lsfs_mount(mp);
        }
        else{
            LOGE("mkfs failed,fr:%d", ret);
        }
    }

    if (ret != 0)
    {
        LOGE("Failed to mount filesystem: %d", ret);
        return ret;
    }
    LOGI("%s mounted successfully", mp->mnt_point);

}

static int fs_unmount(struct lsfs_mount_t* mp)
{
    int ret;

    ret = lsfs_unmount(mp);
    if (ret != 0)
    {
        LOGE("%s unmount failed!\n", mp->mnt_point);
        return ret;
    }
    LOGI("%s unmount success!\n", mp->mnt_point);
    return 0;
}

extern int test_posix_operations(void);
int main(int argc, char **argv)
{
    LOGI("LVFS sample\n");
    
    /*初始化disk设备*/
    disk_init(NULL);

    /*初始化文件系统 */
    lvfs_init();
    lsfs_init();

    fs_mount(&ram_lsfs_mnt);
    test_posix_operations();
#if CONFIG_LVFS_POSIX_API_ALIAS
    extern int test_posix_alias_operations(void);
    test_posix_alias_operations();
#endif
    fs_unmount(&ram_lsfs_mnt);



    return 0;
}
```

## src/test_posix.c
```c
#include <string.h>
#include <stdio.h>
#include <fcntl.h>
#include <unistd.h>
#include <errno.h>
#include "lsfs.h"
#include "lvfs.h"
#include "disk/disk_access.h"
#include "lisa_log.h"

const char test_str[] = "hello world!";
static int file = -1;

#define RAMDISK_DEVICE      "RAM:"
#define RAMDISK_MOUNT_POINT "/"RAMDISK_DEVICE
#define TEST_FILE RAMDISK_MOUNT_POINT"/testfile.txt"

#define TC_FAIL   (-1)
#define TC_PASS    (0)

static int test_open(void)
{
	int res;

	res = open(TEST_FILE, O_CREAT | O_RDWR, 0660);
	if (res < 0) {
		LOGE("Failed opening file: %d, errno=%d\n", res, errno);
        return TC_FAIL;
	}

	file = res;
    LOGI("[%s] pass", __FUNCTION__);
	return TC_PASS;
}

int test_write(void)
{
	ssize_t brw;
	off_t res;

	res = lseek(file, 0, SEEK_SET);
	if (res != 0) {
		LOGE("lseek failed [%d]\n", (int)res);
		close(file);
		file = -1;
		return TC_FAIL;
	}

	brw = write(file, (char *)test_str, strlen(test_str));
	if (brw < 0) {
		LOGE("Failed writing to file [%d]\n", (int)brw);
		close(file);
		file = -1;
		return TC_FAIL;
	}

	if (brw < strlen(test_str)) {
		LOGE("Unable to complete write. Volume full.\n");
		LOGE("Number of bytes written: [%d]\n", (int)brw);
		close(file);
		file = -1;
		return TC_FAIL;
	}
    LOGI("[%s] pass", __FUNCTION__);
	return res;
}

static int test_read(void)
{
	ssize_t brw;
	off_t res;
	char read_buff[80];
	size_t sz = strlen(test_str);

	res = lseek(file, 0, SEEK_SET);
	if (res != 0) {
		LOGE("lseek failed [%d]\n", (int)res);
		close(file);
		file = -1;
		return TC_FAIL;
	}

	brw = read(file, read_buff, sz);
	if (brw < 0) {
		LOGE("Failed reading file [%d]\n", (int)brw);
		close(file);
		file = -1;
		return TC_FAIL;
	}

	read_buff[brw] = 0;

	if (strcmp(test_str, read_buff)) {
		LOGE("Error - Data read does not match data written\n");
		LOGE("Data read:\"%s\"\n\n", read_buff);
		return TC_FAIL;
	}

	/* Now test after non-zero lseek. */

	res = lseek(file, 2, SEEK_SET);
	if (res != 2) {
		LOGE("lseek failed [%d]\n", (int)res);
		close(file);
		file = -1;
		return TC_FAIL;
	}

	brw = read(file, read_buff, sizeof(read_buff));
	if (brw < 0) {
		LOGE("Failed reading file [%d]\n", (int)brw);
		close(file);
		file = -1;
		return TC_FAIL;
	}

	/* Check for array overrun */
	brw = (brw < 80) ? brw : brw - 1;

	read_buff[brw] = 0;

	if (strcmp(test_str + 2, read_buff)) {
		LOGE("Error - Data read does not match data written\n");
		LOGE("Data read:\"%s\"\n\n", read_buff);
		return TC_FAIL;
	}
    LOGI("[%s] pass", __FUNCTION__);
	return TC_PASS;
}

static int test_close(void)
{
	int res = 0;

	if (file >= 0) {
		res = close(file);
		if (res < 0) {
			LOGE("Failed closing file: %d, errno=%d\n", res, errno);
		}

		file = -1;
	}
    if (res < 0) {
        return TC_FAIL;
    }
    LOGI("[%s] pass", __FUNCTION__);
	return res;
}

static int test_fsync(void)
{
	int res = 0;

	if (file < 0) {
		return res;
	}

	res = fsync(file);
	if (res < 0) {
		LOGE("Failed to sync file: %d, errno = %d\n", res, errno);
		return TC_FAIL;
	}

    LOGI("[%s] pass", __FUNCTION__);
	return res;
}

static int test_truncate(void)
{
	int res = 0;
    ssize_t brw;
    char read_buff[80];
	size_t truncate_size = sizeof(test_str) - 4;

	if (file < 0) {
		return res;
	}

	res = ftruncate(file, truncate_size);
	if (res) {
		LOGE("Error truncating file [%d]\n", res);
		return TC_FAIL;
	}

    res = lseek(file, 0, SEEK_SET);
	if (res != 0) {
		LOGE("lseek failed [%d]\n", (int)res);
		close(file);
		file = -1;
		return TC_FAIL;
	}

	brw = read(file, read_buff, sizeof(read_buff));
	if (brw < 0) {
		LOGE("Failed reading file [%d]\n", (int)brw);
		close(file);
		file = -1;
		return TC_FAIL;
	}

	if ((brw != truncate_size) || (0 != memcmp(test_str, read_buff, brw))) {
		LOGE("Error - Data read does not match data written\n");
		LOGE("Data read:\"%s\"\n\n", read_buff);
		return TC_FAIL;
	}

    LOGI("[%s] pass", __FUNCTION__);
	return res;
}


int test_posix_operations(void){

    test_open();
    test_write();
    test_read();
    test_fsync();
    test_truncate();
    test_close();
    return 0;
}
```

## src/test_posix_alias.c
```c
#include <string.h>
#include <stdio.h>
#include <fcntl.h>
#include <unistd.h>
#include <errno.h>
#include "lsfs.h"
#include "lvfs.h"
#include "disk/disk_access.h"
#include "lisa_log.h"

static const char test_str[] = "hello world!";
static FILE *file = NULL;

#define RAMDISK_DEVICE      "RAM:"
#define RAMDISK_MOUNT_POINT "/"RAMDISK_DEVICE
#define TEST_FILE RAMDISK_MOUNT_POINT"/test_fopen.txt"

#define TC_FAIL   (-1)
#define TC_PASS    (0)

static int test_fopen(void)
{
    file = fopen(TEST_FILE, "w+");
    if (file == NULL) {
        LOGE("Failed opening file: errno=%d\n", errno);
        return TC_FAIL;
    }

    LOGI("[%s] pass", __FUNCTION__);
    return TC_PASS;
}

static int test_fwrite(void)
{
    size_t brw;
    int res;

    res = fseek(file, 0, SEEK_SET);
    if (res != 0) {
        LOGE("fseek failed [%d]\n", res);
        fclose(file);
        file = NULL;
        return TC_FAIL;
    }

    brw = fwrite(test_str, 1, strlen(test_str), file);
    if (brw < strlen(test_str)) {
        LOGE("Failed writing to file or volume full [%d]\n", (int)brw);
        fclose(file);
        file = NULL;
        return TC_FAIL;
    }

    if (fflush(file) != 0) {
        LOGE("Failed to flush file\n");
        fclose(file);
        file = NULL;
        return TC_FAIL;
    }

    LOGI("[%s] pass", __FUNCTION__);
    return TC_PASS;
}

static int test_fread(void)
{
    size_t brw;
    int res;
    char read_buff[80];
    size_t sz = strlen(test_str);

    res = fseek(file, 0, SEEK_SET);
    if (res != 0) {
        LOGE("fseek failed [%d]\n", res);
        fclose(file);
        file = NULL;
        return TC_FAIL;
    }

    brw = fread(read_buff, 1, sz, file);
    if (brw < sz) {
        LOGE("Failed reading file [%d]\n", (int)brw);
        fclose(file);
        file = NULL;
        return TC_FAIL;
    }

    read_buff[brw] = 0;

    if (strcmp(test_str, read_buff)) {
        LOGE("Error - Data read does not match data written\n");
        LOGE("Data read:\"%s\"\n\n", read_buff);
        return TC_FAIL;
    }

    /* Now test after non-zero fseek. */
    res = fseek(file, 2, SEEK_SET);
    if (res != 0) {
        LOGE("fseek failed [%d]\n", res);
        fclose(file);
        file = NULL;
        return TC_FAIL;
    }

    brw = fread(read_buff, 1, sizeof(read_buff) - 1, file);
    if (brw == 0) {
        LOGE("Failed reading file [%d]\n", (int)brw);
        fclose(file);
        file = NULL;
        return TC_FAIL;
    }

    read_buff[brw] = 0;

    if (strcmp(test_str + 2, read_buff)) {
        LOGE("Error - Data read does not match data written\n");
        LOGE("Data read:\"%s\"\n\n", read_buff);
        return TC_FAIL;
    }
    LOGI("[%s] pass", __FUNCTION__);
    return TC_PASS;
}

static int test_fclose(void)
{
    int res = 0;

    if (file != NULL) {
        res = fclose(file);
        if (res != 0) {
            LOGE("Failed closing file: %d, errno=%d\n", res, errno);
        }
        file = NULL;
    }
    if (res != 0) {
        return TC_FAIL;
    }
    LOGI("[%s] pass", __FUNCTION__);
    return TC_PASS;
}

int test_posix_alias_operations(void)
{
    int res;

    LOGI("#### Test stdio operations ####\n");

    res = test_fopen();
    if (res != TC_PASS) {
        return res;
    }

    res = test_fwrite();
    if (res != TC_PASS) {
        return res;
    }

    res = test_fread();
    if (res != TC_PASS) {
        return res;
    }

    res = test_fclose();
    if (res != TC_PASS) {
        return res;
    }

    LOGI("#### Test stdio operations complete ####\n");
    return TC_PASS;
}
```
