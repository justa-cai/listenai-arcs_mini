## CMakeLists.txt
```
cmake_minimum_required(VERSION 3.13)

set(CMAKE_EXPORT_COMPILE_COMMANDS ON)

find_package(listenai-cmake REQUIRED HINTS $ENV{ARCS_BASE})

project(arcs)

listenai_include_directories(
    ./
)

listenai_add_executable(${PROJECT_NAME})

target_sources(${PROJECT_NAME} PRIVATE src/main.c)
if (CONFIG_DISK_DRIVER_SDMMC)
target_sources(${PROJECT_NAME} PRIVATE src/sdmmc_init.c)
endif()

if (CONFIG_DISK_DRIVER_FLASH)
target_compile_options(arcs-hal PRIVATE -DCONFIG_EXT_RAM)
endif()
```

## sample.yaml
```
tests:
  samples.fatfs:
    programmer: arcs
    runner: uart
    log_analyzer:
      type: "regex"
      pattern: "FATFS sample"
```

## prj.conf
```kconfig
# 项目可根据需要在此文件中设置对应的配置
CONFIG_ARCS_HAL_WARNING_DISABLE=y
# CONFIG_ARCS_HAL_DEBUG=y
CONFIG_MODULE_FREERTOS=y
CONFIG_MODULE_HEAP=y
CONFIG_LINK_OPTION_NOSYS_SPECS=y
# CONFIG_SDK_MODULE_EASYLOGGER=n

# 文件系统配置
CONFIG_FILE_SYSTEM=y
CONFIG_FATFS_FILESYSTEM=y

# DISK驱动使能
CONFIG_DISK_DRIVER=y

# DISK FLASH驱动使能及配置
# CONFIG_DISK_DRIVER_FLASH=y
# CONFIG_DISK_FLASH_START_ADDR=0x100000
# CONFIG_DISK_FLASH_MAX_RW_SIZE=4096
# CONFIG_DISK_FLASH_ERASE_ALIGNMENT=4096
# CONFIG_DISK_FLASH_ERASE_BLOCK_SIZE=4096
# CONFIG_DISK_FLASH_SECTOR_SIZE=512
# CONFIG_DISK_FLASH_VOLUME_SIZE=65536

# DISK RAM驱动使能及配置
CONFIG_DISK_DRIVER_RAM=y

# DISK SDMMC驱动使能及配置
CONFIG_DISK_DRIVER_SDMMC=y

CONFIG_HEAP_SIZE=0x20000
```

## src/main.c
```c
#include <string.h>
#include "ff.h"
#include "disk/disk_access.h"
#include "lisa_log.h"

#define RAMDISK_MOUNT_POINT "RAM:"
#define RAMDISK_FILE RAMDISK_MOUNT_POINT "/ram.txt"

#define FLASHDISK_MOUNT_POINT "NAND:"
#define FLASHDISK_FILE FLASHDISK_MOUNT_POINT "/flash.txt"

#define SDMMC_MOUNT_POINT "SD:"
#define SDMMC_FILE SDMMC_MOUNT_POINT "/sdmmc.txt"

static FATFS s_fs;

static int fs_mount(const char *mountpoint)
{

    FRESULT fr;

    // 挂载文件系统
    fr = f_mount(&s_fs, mountpoint, 1);

    if (fr == FR_NO_FILESYSTEM)
    {
        static uint8_t work[FF_MAX_SS];
        MKFS_PARM mkfs_opt = {
            .fmt = FM_ANY | FM_SFD, /* Any suitable FAT */
            .n_fat = 1,             /* One FAT fs table */
            .align = 0,             /* Get sector size via diskio query */
            .n_root = 512,
            .au_size = 0 /* Auto calculate cluster size */
        };

        LOGD("No file system reformatting");
        fr = f_mkfs(mountpoint, &mkfs_opt, work, sizeof(work));
        if (fr == FR_OK)
        {
            LOGD("mkfs success");
            fr = f_mount(&s_fs, mountpoint, 1);
        }
        else
        {
            LOGE("mkfs failed,fr:%d", fr);
        }
    }
    if (fr != FR_OK)
    {
        LOGE("Failed to mount filesystem: %d", fr);
        return fr;
    }

    LOGI("%s mounted successfully", mountpoint);
}

static int fs_unmount(const char *mountpoint)
{
    FRESULT fr;

    fr = f_mount(NULL, mountpoint, 0);
    if (fr != FR_OK)
    {
        LOGE("%s unmount failed!\n", mountpoint);
    }
    LOGI("%s unmount success!\n", mountpoint);
}

static FRESULT list_dir(const char *path)
{
    FRESULT res;
    DIR dir;
    FILINFO fno;
    int nfile, ndir;

    res = f_opendir(&dir, path); /* Open the directory */
    LOGI("%s opendir: %d", path, res);
    if (res == FR_OK)
    {
        nfile = ndir = 0;
        for (;;)
        {
            res = f_readdir(&dir, &fno); /* Read a directory item */
            if (res != FR_OK || fno.fname[0] == 0)
                break; /* Error or end of dir */
            if (fno.fattrib & AM_DIR)
            { /* Directory */
                LOGI("   <DIR>   %s", fno.fname);
                ndir++;
            }
            else
            { /* File */
                LOGI("%10llu %s", fno.fsize, fno.fname);
                nfile++;
            }
        }
        f_closedir(&dir);
        LOGI("%d dirs, %d files.", ndir, nfile);
    }
    else
    {
        LOGE("Failed to open \"%s\". (%u)", path, res);
    }
    return res;
}

int fatfs_write_read(const char *fullpath)
{
    FIL fil;
    FRESULT fr;
    UINT bw;
    UINT br;
    char buffer[64];

    // 创建并打开一个新文件
    fr = f_open(&fil, fullpath, FA_WRITE | FA_CREATE_ALWAYS);
    if (fr != FR_OK)
    {
        LOGE("Failed to open file: %d", fr);
        return fr;
    }

    fr = f_write(&fil, fullpath, strlen(fullpath), &bw);
    if (fr != FR_OK || bw != strlen(fullpath))
    {
        LOGE("Failed to write to file: %d", fr);
        return fr;
    }
    LOGI("Write to file: %s", fullpath);

    // 关闭文件
    f_close(&fil);

    // 读取文件
    fr = f_open(&fil, fullpath, FA_READ);
    if (fr != FR_OK)
    {
        LOGE("Failed to open file for reading: %d", fr);
        return fr;
    }

    fr = f_read(&fil, buffer, sizeof(buffer) - 1, &br);
    if (fr != FR_OK)
    {
        LOGE("Failed to read from file: %d", fr);
        return fr;
    }

    buffer[br] = '\0';
    LOGI("Read from file: %s", buffer);

    f_close(&fil);

    return 0;
}

int main(int argc, char **argv)
{
    LOGI("FATFS sample\n");

 #if (CONFIG_DISK_DRIVER_SDMMC)
    extern int sdmmc_hard_init(void);
    if(0 != sdmmc_hard_init()){
        LOGE("sdmmc hard init failed");
        return -1;
    }
#endif
    disk_init(NULL);

    fs_mount(RAMDISK_MOUNT_POINT);
    fatfs_write_read(RAMDISK_FILE);
    list_dir(RAMDISK_MOUNT_POINT "/");
    fs_unmount(RAMDISK_MOUNT_POINT);

#if (CONFIG_DISK_DRIVER_FLASH)
    fs_mount(FLASHDISK_MOUNT_POINT);
    fatfs_write_read(FLASHDISK_FILE);
    list_dir(FLASHDISK_MOUNT_POINT "/");
    fs_unmount(FLASHDISK_MOUNT_POINT);
#endif

#if (CONFIG_DISK_DRIVER_SDMMC)
    fs_mount(SDMMC_MOUNT_POINT);
    fatfs_write_read(SDMMC_FILE);
    list_dir(SDMMC_MOUNT_POINT "/");
    fs_unmount(SDMMC_MOUNT_POINT);
#endif

    return 0;
}
```

## src/sdmmc_init.c
```c
#include <errno.h>
#include <stdint.h>
#include "lib_sdc.h"
#include "drv_sdc.h"
#include "IOMuxManager.h"
#include "arcs_ap.h"
#include "esp_heap_caps.h"
#include "FreeRTOS.h"

#define SD_PORT SD_0
static SDCardInfo sd_info;
static uint8_t *dma_buf = NULL;

static int sdmmc_setup(void)
{

    IOMuxManager_PinConfigure(CSK_IOMUX_PAD_A, 6, CSK_IOMUX_FUNC_ALTER15); // sd_clk
    IOMuxManager_PinConfigure(CSK_IOMUX_PAD_A, 7, CSK_IOMUX_FUNC_ALTER15); // sd_cmd
    IOMuxManager_PinConfigure(CSK_IOMUX_PAD_A, 5, CSK_IOMUX_FUNC_ALTER15); // sd_dat0
    IOMuxManager_PinConfigure(CSK_IOMUX_PAD_A, 4, CSK_IOMUX_FUNC_ALTER15); // sd_dat1
    IOMuxManager_PinConfigure(CSK_IOMUX_PAD_A, 9, CSK_IOMUX_FUNC_ALTER15); // sd_dat2
    IOMuxManager_PinConfigure(CSK_IOMUX_PAD_A, 8, CSK_IOMUX_FUNC_ALTER15); // sd_dat3

    IP_AP_CFG->REG_CLK_CFG1.bit.ENA_SDIOH_CLK = 1;          // Enable SDIO Host Clock
    IP_SDIOH->REG_VR1.bit.LO_SD_RSTN = 1;                   // SD Output Low-Active Reset Signal to RSTN of eMMC
    IP_SDIOH->REG_CCR_TCR_SRR.bit.UPPER_BIT_SD_CLK_SEL = 0; // SD Clock Frequency Divider[9:8]: DIVx2
    IP_SDIOH->REG_CCR_TCR_SRR.bit.LOW_BIT_SD_CLK_SEL = 0;   // SD Clock Frequency Divider[7:0]: DIVx2
    IP_SDIOH->REG_CCR_TCR_SRR.bit.SD_CLK_EN = 1;            // SD Clock Enable
    IP_SDIOH->REG_HC1_PCR_BGCR.bit.SD_BUS_POW = 1;          // SD Bus Power Enable
    IP_SDIOH->REG_HC1_PCR_BGCR.bit.SD_BUS_VOL = 7;          // SD Bus Voltage Select: 5:1.8V 6:3.0V 7:3.3V
}

static int sdmmc_probe(uint32_t timeout_ms)
{
    u32 ret;

    ret = gm_api_sdc_platform_init(SDC_OPTION_ENABLE | SDC_OPTION_CD_INVERT, 0, NULL, (u32)&sd_info);
    if (ret != ERR_SD_NO_ERROR) {
        CLOGE("gm_api_sdc_platform_init failed:%d", ret);
        goto _ERR1;
    }

    ret = gm_sdc_api_action(SD_PORT, GM_SDC_ACTION_INIT, NULL, NULL);
    if (ret != ERR_SD_NO_ERROR) {
        CLOGE("gm_sdc_api_action GM_SDC_ACTION_INIT failed:%d", ret);
        goto _ERR1;
    }
    dma_buf = heap_caps_aligned_alloc(CACHE_LINE_SIZE(DCACHE), sd_info.FlowSet.sdma_bound_mask + 1,
                                      MALLOC_CAP_DEFAULT | MALLOC_CAP_INTERNAL);
    if (dma_buf == NULL) {
        CLOGE("heap_caps_aligned_alloc failed");
        goto _ERR1;
    }
    CLOGI("##########sd_info.FlowSet.sdma_bound_mask + 1:%d", sd_info.FlowSet.sdma_bound_mask + 1);

    ret = gm_sdc_api_action(SD_PORT, GM_SDC_ACTION_SET_ADMA_BUFER, dma_buf, NULL);
    if (ret != ERR_SD_NO_ERROR) {
        CLOGE("gm_sdc_api_action GM_SDC_ACTION_SET_ADMA_BUFER failed:%d", ret);
        goto _ERR1;
    }

    ret = gm_sdc_api_action(SD_PORT, GM_SDC_ACTION_SOFT_RESET, &(u32){SDHCI_SOFTRST_ALL}, NULL);
    if (ret != ERR_SD_NO_ERROR) {
        CLOGE("gm_sdc_api_action GM_SDC_ACTION_SOFT_RESET failed:%d", ret);
        goto _ERR1;
    }

    for (int i = 0; i < timeout_ms; i += 10) {
        // 0:SDR12/LS 1:SDR25/HS 2:SDR50 3:SDR104 4:DDR50
        ret = gm_sdc_api_action(SD_PORT, GM_SDC_ACTION_CARD_SCAN, &(u32){UHS_SDR25_BUS_SPEED}, NULL);
        if (ERR_SD_NO_ERROR == ret) {
            break;
        }
        if (ERR_SD_CARD_NOT_EXIST != ret) {
            CLOGW("Scan card failed:%d", ret);
        }
        vTaskDelay(pdMS_TO_TICKS(100));
    }

    if (ret != ERR_SD_NO_ERROR) {
        goto _ERR1;
    }

    ret = gm_sdc_api_action(SD_PORT, GM_SDC_ACTION_SET_BUS_WIDTH, &(u32){4}, NULL);
    if (ret != ERR_SD_NO_ERROR) {
        goto _ERR1;
    }
    
    extern u8 SDC_SD_menu(u8 ip_idx);
    SDC_SD_menu(SD_PORT);

    return 0;
_ERR1:
    if (dma_buf != NULL) {
        heap_caps_free(dma_buf);
    }

    return -EIO;
}

int sdmmc_hard_init(void)
{
    sdmmc_setup();
    return sdmmc_probe(3000);
}
```
