## CMakeLists.txt
```
cmake_minimum_required(VERSION 3.13)

set(LISTENAI_MODULES_DIR_LIST
    $ENV{ARCS_BASE}
    $ENV{ARCS_BASE}/../modules/letter-shell
    $ENV{ARCS_BASE}/../modules/easylogger
    $ENV{ARCS_BASE}/../components
    ${CMAKE_CURRENT_SOURCE_DIR}/src
)

set(CMAKE_EXPORT_COMPILE_COMMANDS ON)

find_package(listenai-cmake REQUIRED HINTS $ENV{ARCS_BASE})

project(arcs)

listenai_include_directories(
    ./
)

listenai_add_executable(${PROJECT_NAME})
```

## sample.yaml
```
tests:
  samples.uart_shell:
    programmer: arcs
    runner: uart
    log_analyzer:
      type: "regex"
      pattern: "UART shell sample"
```

## prj.conf
```kconfig
# 项目可根据需要在此文件中设置对应的配置
CONFIG_ARCS_HAL_WARNING_DISABLE=y

CONFIG_SYSLOG_UART_BAUDRATE=921600
CONFIG_LINK_OPTION_NOSYS_SPECS=y
CONFIG_PSRAM_HEAP_SIZE=0x300000
CONFIG_HEAP_SIZE=0x10000
CONFIG_DCACHE_ENABLE=y

CONFIG_SDK_MODULE_LETTER_SHELL=y
CONFIG_SDK_MODULE_LETTER_SHELL_CONFIG_FILE="shell_cfg_user.h"

CONFIG_BACK_TRACE=y
CONFIG_EASYLOGGER_ASYNC_BUF_SIZE=102400
```

## src/main.c
```c
#include "stdio.h"
#include "stdlib.h"
#include "stddef.h"
#include "string.h"
#include "lisa_log.h"
#include "shell.h"
#include "app_shell.h"

struct listen_cmd_t {
    char *name;
    int (*exec)(int argc, char **argv);
    char *help;
};

static int shell_hello_world(int argc, char **argv)
{
    printf("Hello World\n");
    return 0;
}

static int shell_echo(int argc, char **argv)
{
    if (argc < 1) {
        printf("Usage: echo <message>\n");
        return -1;
    }

    for (int i = 0; i < argc; i++) {
        printf("%s ", argv[i]);
    }
    printf("\n");

    return 0;
}

static const struct listen_cmd_t g_shell_cmds[] = {
    {"helloworld", shell_hello_world, "Print Hello World"},
    {"echo", shell_echo, "Echo command"},
};

static int shell_test_cmd_help(int argc, char **argv)
{
    int cmd_len = sizeof(g_shell_cmds) / sizeof(g_shell_cmds[0]);
    for (int i = 0; i < cmd_len; i++) {
        if (g_shell_cmds[i].help != NULL) {
            printf("%-17s\t:\t%s\n", g_shell_cmds[i].name, g_shell_cmds[i].help);
        }
    }

    return 0;
}

static int shell_test_cmd_handler(int argc, char **argv)
{
    if (argc == 1) {
        shell_test_cmd_help(argc, argv);
        return 0;
    }

    int i;

    for (i = 0; i < sizeof(g_shell_cmds) / sizeof(g_shell_cmds[0]); i++) {
        if (strcmp(g_shell_cmds[i].name, argv[1]) == 0) {
            return g_shell_cmds[i].exec(argc - 2, argv + 2);
        }
    }

    shell_test_cmd_help(argc, argv);

    return 0;
}

static void log_shell_backend_output(const uint8_t *log, uint32_t len, void *data)
{
    lisa_shell_output_raw((const char *)log, len);
}

int main(int argc, char **argv)
{
    LOGI("UART shell sample\n");

    lisa_shell_init();

    /* shell的串口和系统默认的日志输出串口是同一个, 这里暂停系统默认的日志输出 */
    lisa_log_backend_pause("sys.log");
    lisa_log_backend_add("user.shell", log_shell_backend_output, NULL);

    while (1) {
        LOGI("shell test is running\n");
        vTaskDelay(1000);
    }

    return 0;
}

SHELL_EXPORT_CMD(SHELL_CMD_PERMISSION(0) | SHELL_CMD_TYPE(SHELL_TYPE_CMD_MAIN) | SHELL_CMD_DISABLE_RETURN, shell_test,
                 shell_test_cmd_handler, shell test cmd group);
```

## src/app_shell.c
```c
#include "chip.h"
#include "Driver_UART.h"
#include "IOMuxManager.h"
#include "ClockManager.h"

#include "shell.h"

#include "FreeRTOS.h"
#include "task.h"
#include "semphr.h"

#include "string.h"

#define UART0_IO_TX_PAD (CSK_IOMUX_PAD_A)
#define UART0_IO_TX_PIN 3
#define UART0_IO_TX_SEL (CSK_IOMUX_FUNC_ALTER2)

#define UART0_IO_RX_PAD (CSK_IOMUX_PAD_A)
#define UART0_IO_RX_PIN 2
#define UART0_IO_RX_SEL (CSK_IOMUX_FUNC_ALTER2)

#define UART1_IO_TX_PAD (CSK_IOMUX_PAD_A)
#define UART1_IO_TX_PIN (21)
#define UART1_IO_TX_SEL (CSK_IOMUX_FUNC_ALTER3)

#define UART1_IO_RX_PAD (CSK_IOMUX_PAD_A)
#define UART1_IO_RX_PIN (20)
#define UART1_IO_RX_SEL (CSK_IOMUX_FUNC_ALTER3)

#define SHELL_UART_TX_PIN UART0_IO_TX_PIN
#define SHELL_UART_TX_PAD UART0_IO_TX_PAD
#define SHELL_UART_TX_SEL UART0_IO_TX_SEL

#define SHELL_UART_RX_PIN UART0_IO_RX_PIN
#define SHELL_UART_RX_PAD UART0_IO_RX_PAD
#define SHELL_UART_RX_SEL UART0_IO_RX_SEL

#define SHELL_UART_BAUDRATE (921600)
#define UART_PORT()         UART0()
#define SHELL_CLK_INIT()    HAL_CRM_SetUart0ClkDiv(1, 1)

static Shell *g_shell;
static SemaphoreHandle_t uart_rx_sem = NULL;

static void uart_event_callback(uint32_t event, void *workspace)
{
    if ((event & CSK_UART_EVENT_RX_TIMEOUT) || (event & CSK_UART_EVENT_RECEIVE_COMPLETE)) {
        BaseType_t xHigherPriorityTaskWoken = pdFALSE;
        xSemaphoreGiveFromISR(uart_rx_sem, &xHigherPriorityTaskWoken);
        portYIELD_FROM_ISR(xHigherPriorityTaskWoken);
    }
}

static int shell_uart_init(void *port, int32_t baudrate)
{
    UART_Initialize(port, uart_event_callback, NULL);
    UART_PowerControl(port, CSK_POWER_FULL);

    UART_Control(port,
                 CSK_UART_MODE_ASYNCHRONOUS_TIMEOUT | CSK_UART_DATA_BITS_8 | CSK_UART_PARITY_NONE |
                     CSK_UART_STOP_BITS_1 | CSK_UART_FLOW_CONTROL_NONE | CSK_UART_Function_CONTROL_Int |
                     CSK_UART_GPIO_CONTROL_DEFAULT,
                 baudrate);

    UART_Control(port, CSK_UART_CONTROL_TX, 1);
    UART_Control(port, CSK_UART_CONTROL_RX, 1);
    UART_Control(port, CSK_UART_DISABLE_TX_INT, 1);

    return 0;
}

static int lisa_shell_low_init(void)
{
    IOMuxManager_PinConfigure(SHELL_UART_TX_PAD, SHELL_UART_TX_PIN, SHELL_UART_TX_SEL);
    IOMuxManager_PinConfigure(SHELL_UART_RX_PAD, SHELL_UART_RX_PIN, SHELL_UART_RX_SEL);

    SHELL_CLK_INIT();

    return shell_uart_init(UART_PORT(), SHELL_UART_BAUDRATE);
}

static signed short shell_write(char *data, unsigned short size)
{
    UART_Send(UART_PORT(), data, size);

    return size;
}

static signed short shell_read(char *data, unsigned short size)
{
    UART_Receive(UART_PORT(), data, size);

    xSemaphoreTake(uart_rx_sem, portMAX_DELAY);

    return size;
}

static void shell_task(void *p)
{
    int r;
    Shell *sh = (Shell *)p;

    assert(sh);

    while (1) {
        uint8_t ch;
        if (sh->read && sh->read(&ch, 1) == 1) {
            shellHandler(sh, ch);
        }
    }
}

int lisa_shell_init(void)
{
    int r;

    uart_rx_sem = xSemaphoreCreateBinary();
    assert(uart_rx_sem);

    r = lisa_shell_low_init();
    assert(r == 0);

    Shell *sh = malloc(sizeof(Shell));
    assert(sh);
    memset(sh, 0, sizeof(Shell));
    uint8_t *shell_buf = malloc(512);
    assert(shell_buf);
    sh->write = shell_write;
    sh->read = shell_read;

    g_shell = sh;
    shellInit(sh, shell_buf, 512);

    xTaskCreate(shell_task, "shell", 1024, sh, configMAX_PRIORITIES - 1, NULL);
}

void lisa_shell_output_raw(const char *data, int len)
{
    if (g_shell) {
        shellWriteEndLine(g_shell, (uint8_t *)data, len);
    }
}
```

## src/app_shell.h
```c
#ifndef __APP_SHELL_H__
#define __APP_SHELL_H__

int lisa_shell_init(void);
void lisa_shell_output_raw(const char *data, int len);

#endif
```

## src/shell_cfg_user.h
```c
/**
 * @file shell_cfg_user.h
 * @author Letter (nevermindzzt@gmail.com)
 * @brief shell config
 * @version 3.0.0
 * @date 2019-12-31
 * 
 * @copyright (c) 2019 Letter
 * 
 */

#ifndef __SHELL_CFG_USER_H__
#define __SHELL_CFG_USER_H__

#include <stdint.h>
#include <stddef.h>
#include <stdlib.h>
#include "FreeRTOS.h"
#include "task.h"

#define     SHELL_SHOW_INFO             1

#define     SHELL_TASK_WHILE            1

/**
 * @brief 是否使用shell伴生对象
 *        一些扩展的组件(文件系统支持，日志工具等)需要使用伴生对象
 */
#define     SHELL_USING_COMPANION       0


/**
 * @brief 支持shell尾行模式
 */
#define     SHELL_SUPPORT_END_LINE      1


/**
 * @brief 使用LF作为命令行回车触发
 *        可以和SHELL_ENTER_CR同时开启
 */
#define     SHELL_ENTER_LF              1

/**
 * @brief 使用CR作为命令行回车触发
 *        可以和SHELL_ENTER_LF同时开启
 */
#define     SHELL_ENTER_CR              1

/**
 * @brief 使用CRLF作为命令行回车触发
 *        不可以和SHELL_ENTER_LF或SHELL_ENTER_CR同时开启
 */
#define     SHELL_ENTER_CRLF            0

/**
 * @brief shell格式化输入的缓冲大小
 *        为0时不使用shell格式化输入
 * @note shell格式化输入会阻塞shellTask, 仅适用于在有操作系统的情况下使用
 */
#define     SHELL_SCAN_BUFFER          128

/**
 * @brief 获取系统时间(ms)
 *        定义此宏为获取系统Tick，如`HAL_GetTick()`
 * @note 此宏不定义时无法使用双击tab补全命令help，无法使用shell超时锁定
 */
#define     SHELL_GET_TICK()            xTaskGetTickCount()

/**
 * @brief 使用锁
 * @note 使用shell锁时，需要对加锁和解锁进行实现
 */
#define     SHELL_USING_LOCK            0

/**
 * @brief shell内存分配
 *        shell本身不需要此接口，若使用shell伴生对象，需要进行定义
 */
#define     SHELL_MALLOC(size)         0

/**
 * @brief shell内存释放
 *        shell本身不需要此接口，若使用shell伴生对象，需要进行定义
 */
#define     SHELL_FREE(obj)             0

#endif
```
