## CMakeLists.txt
```
cmake_minimum_required(VERSION 3.19)

set(CMAKE_EXPORT_COMPILE_COMMANDS ON)

find_package(listenai-cmake REQUIRED HINTS $ENV{ARCS_BASE})

project(arcs)

listenai_add_executable(${PROJECT_NAME})

target_sources(${PROJECT_NAME} PRIVATE 
    src/main.cpp
    src/class_examples.cpp
    src/vector_examples.cpp
)

listenai_include_directories(src)
```

## prj.conf
```kconfig
# 项目可根据需要在此文件中设置对应的配置
CONFIG_MEM_CONFIG=y
CONFIG_LINK_OPTION_NONE_SPECS=y
```

## src/main.cpp
```c
#include <stdio.h>    // C 标准库
#include <functional> // C++11 功能库
#include <iostream> // 简化版iostream实现
#include "class_examples.h"
#include "vector_examples.h"

// 使用 C++11 特性的类
class HelloWorld {
public:
    void sayHello() const {
        printf("printf: Hello C++11 World!\n");
        std::cout << "cout: Hello World\r\n" << std::endl;
    }
    
    static constexpr int VALUE = 42;
};


int main(int argc, char **argv)
{
    HelloWorld hello;
    hello.sayHello();

    demonstrateNewFeatures();
    
    runAllVectorExamples();
    
    printf("Simple Use Completed\r\n");
    return 0;
}
```

## src/class_examples.h
```c
#ifndef NEW_FEATURES_DEMO_H
#define NEW_FEATURES_DEMO_H
#pragma once

void demonstrateNewFeatures();


#endif // NEW_FEATURES_DEMO_H
```

## src/uchardet_test.cpp
```c
#include <cstring>
#include <iostream>
#include "uchardet.h"
#include "uchardet_test.h"

static const char *uchar_str[] = {
    "简体中文简体中文简体中文简体中文简体中文简体中文简体中文简体中文简体中文简体中文简体中文", //gb18030
    "姹夊瓧婕㈠瓧绲变竴绶ㄧ⒓钀湅纰�", //zh_utf8
};

void uchardet_test(void){

    for(int i=0;i<sizeof(uchar_str)/sizeof(uchar_str[0]);i++){
        uchardet_t  handle = uchardet_new();
        uchardet_handle_data(handle, uchar_str[i], strlen(uchar_str[i]));
        uchardet_data_end(handle);
        std::cout << "Detected encoding: " << uchardet_get_charset(handle) << std::endl;
        uchardet_delete(handle);
    }
    return;
}
```

## src/uchardet_test.h
```c
#ifndef UCHARDET_TEST_H
#define UCHARDET_TEST_H


void uchardet_test(void);
#endif
```

## src/vector_examples.cpp
```c
#include "vector_examples.h"
#include <vector>     // C++11 容器
#include <algorithm>  // For vector algorithms
#include <stdio.h>    // C 标准库

// 演示向量的基本用法
void demonstrateVectorBasic() {
    printf("\n=== Vector Basic Tests ===\n");
    std::vector<int> numbers = {1, 2, 3};
    for (const auto& num : numbers) {
        printf("  Number: %d\n", num);
    }
}

// 演示向量的各种初始化方法
void demonstrateVectorInitialization() {
    printf("\n=== Vector Initialization Tests ===\n");
    // 使用列表初始化
    std::vector<int> vec1 = {10, 20, 30, 40, 50};
    printf("vector with list initialization: size=%zu\n", vec1.size());
    
    // 使用填充构造函数
    std::vector<int> vec2(5, 100);  // 5个元素，每个值为100
    printf("vector with fill constructor: size=%zu, first value=%d\n", 
           vec2.size(), vec2.front());
    
    // 使用范围构造函数
    std::vector<int> vec3(vec1.begin(), vec1.begin() + 3);
    printf("vector with range constructor: size=%zu\n", vec3.size());
}

// 演示向量的修改操作（添加、插入、删除元素）
void demonstrateVectorModification() {
    printf("\n=== Vector Modification Tests ===\n");
    std::vector<int> vec4;
    
    // 添加元素
    printf("Adding elements to vector...\n");
    vec4.push_back(1);
    vec4.push_back(2);
    vec4.push_back(3);
    printf("  After adding 3 elements: size=%zu\n", vec4.size());
    
    // 插入元素
    vec4.insert(vec4.begin() + 1, 99);
    printf("  After inserting at position 1: ");
    for (const auto& n : vec4) {
        printf("%d ", n);
    }
    printf("\n");
    
    // 删除元素
    vec4.pop_back();
    printf("  After removing last element: size=%zu\n", vec4.size());
}

// 演示向量的容量和大小相关操作
void demonstrateVectorCapacity() {
    printf("\n=== Vector Capacity Tests ===\n");
    std::vector<int> vec5;
    printf("Empty vector: size=%zu, capacity=%zu\n", vec5.size(), vec5.capacity());
    
    // 预分配内存
    vec5.reserve(10);
    printf("After reserve(10): size=%zu, capacity=%zu\n", vec5.size(), vec5.capacity());
    
    // 调整大小
    vec5.resize(5, 7);
    printf("After resize(5, 7): size=%zu, capacity=%zu\n", vec5.size(), vec5.capacity());
}

// 演示向量的算法操作（排序、查找、计数）
void demonstrateVectorAlgorithms() {
    printf("\n=== Vector Algorithm Tests ===\n");
    std::vector<int> vec6 = {3, 1, 4, 1, 5, 9, 2, 6};
    
    // 排序
    std::sort(vec6.begin(), vec6.end());
    printf("Sorted vector: ");
    for (const auto& n : vec6) {
        printf("%d ", n);
    }
    printf("\n");
    
    // 查找
    auto it = std::find(vec6.begin(), vec6.end(), 5);
    if (it != vec6.end()) {
        printf("Found element 5 at position: %ld\n", it - vec6.begin());
    } else {
        printf("Element 5 not found\n");
    }
    
    // 计算元素数量
    int count = std::count(vec6.begin(), vec6.end(), 1);
    printf("Count of element 1: %d\n", count);
}

// 运行所有向量示例
void runAllVectorExamples() {
    demonstrateVectorBasic();
    demonstrateVectorInitialization();
    demonstrateVectorModification();
    demonstrateVectorCapacity();
    demonstrateVectorAlgorithms();
}
```
