## CMakeLists.txt
```
cmake_minimum_required(VERSION 3.19)

set(CMAKE_EXPORT_COMPILE_COMMANDS ON)

find_package(listenai-cmake REQUIRED HINTS $ENV{ARCS_BASE})

project(app)

listenai_include_directories(
    ./
)

listenai_add_executable(${PROJECT_NAME})
listenai_link_libraries(m)

target_sources(${PROJECT_NAME} PRIVATE src/main.c)
```

## prj.conf
```kconfig
# 项目可根据需要在此文件中设置对应的配置
CONFIG_SDK_MODULE_FLEXLAYOUT=y
```

## src/main.c
```c
#include "FlexLayout.h"
#include "stdio.h"

int main(int argc, char const *argv[])
{
    printf("Start flexlayout sample\r\n");

    FlexNodeRef root = Flex_newNode();

    FlexNodeRef child1 = Flex_newNode();
    Flex_setWidth(child1, 50);
    Flex_setHeight(child1, 50);
    Flex_addChild(root, child1);

    FlexNodeRef child2 = Flex_newNode();
    Flex_setWidth(child2, 50);
    Flex_setHeight(child2, 50);
    Flex_addChild(root, child2);

    Flex_layout(root, FlexUndefined, FlexUndefined, 1);
    Flex_print(root, FlexPrintDefault);

    Flex_freeNodeRecursive(root);

    return 0;
}
```
