## CMakeLists.txt
```
cmake_minimum_required(VERSION 3.19)
set(CMAKE_EXPORT_COMPILE_COMMANDS ON)

find_package(listenai-cmake REQUIRED HINTS $ENV{ARCS_BASE})
project(rust_async_tasks)

set(LISTENAI_RUST_APP ${CMAKE_CURRENT_SOURCE_DIR})

listenai_add_executable(${PROJECT_NAME})
include($ENV{ARCS_BASE}/modules/rust/rust_sample.cmake)
listenai_maybe_enable_rust_target(${PROJECT_NAME})

# The arcs-embassy crate needs a small FreeRTOS C shim; compile it as part of
# the app so it sees the full SDK / FreeRTOS include path.
target_sources(${PROJECT_NAME} PRIVATE
    src/main.c
    $ENV{ARCS_BASE}/modules/rust/arcs-embassy/glue/arcs_embassy_glue.c)
target_include_directories(${PROJECT_NAME} PRIVATE
    $ENV{ARCS_BASE}/modules/rust/arcs-embassy/glue)
```

## sample.yaml
```
tests:
  samples.libraries.rust.async_tasks:
    programmer: arcs
    runner: uart
    platform_allow:
      - arcs_evb
    log_analyzer:
      type: "regex"
      pattern: "async_tasks:ok"
```

## prj.conf
```kconfig
CONFIG_LOG_FRONTEND_EASYLOGGER=y
```

## src/main.c
```c
/*
 * Copyright (c) 2026, LISTENAI
 * SPDX-License-Identifier: Apache-2.0
 */
#define LOG_TAG "rust_async_tasks"
#include <lisa_log.h>

extern int rust_main(void);

/*
 * Thin shim into the Rust entry point. rust_main() brings up the embassy
 * executor on this (the main) FreeRTOS task and never returns.
 */
int main(int argc, char **argv)
{
    (void)argc;
    (void)argv;
    LOGI("=== Rust async/embassy demo ===");
    int ret = rust_main();
    if (ret != 0) {
        LOGE("rust_main returned %d", ret);
    }
    return 0;
}
```
