## CMakeLists.txt
```
cmake_minimum_required(VERSION 3.19)
set(CMAKE_EXPORT_COMPILE_COMMANDS ON)

find_package(listenai-cmake REQUIRED HINTS $ENV{ARCS_BASE})
project(rust_fpu_hardfloat)

set(LISTENAI_RUST_APP ${CMAKE_CURRENT_SOURCE_DIR})

listenai_add_executable(${PROJECT_NAME})
include($ENV{ARCS_BASE}/modules/rust/rust_sample.cmake)
listenai_maybe_enable_rust_target(${PROJECT_NAME})
target_sources(${PROJECT_NAME} PRIVATE src/main.c)
```

## sample.yaml
```
tests:
  samples.libraries.rust.fpu_hardfloat:
    # 暂时跳过此 sample，因为切换 nightly 工具链有概率会引起其它 sample 选错工具链
    skip: true
    programmer: arcs
    runner: uart
    platform_allow:
      - arcs_evb
    log_analyzer:
      type: "regex"
      pattern: "fpu_hardfloat:done"
```

## prj.conf
```kconfig
CONFIG_LOG_FRONTEND_EASYLOGGER=y

# Run on the AP core (hartid 0): it owns the hardware FPU (misa.F=1); the
# default CP core (hartid 1) has none. ARCS_AP_CORE auto-sets CONFIG_HARTID=0.
CONFIG_ARCS_AP_CORE=y

# Embed the bootloader and call the app directly on the AP core (single
# self-contained image at 0x0; not auto-on for AP, default routing jumps to CP).
CONFIG_BOOT=y
CONFIG_BOOT_APP_CORE_AP=y

# Full hard-float: build the whole image rv32imafc / ilp32f (ARCS_AP_CORE
# already `imply FPU`; set it explicitly for clarity). CONFIG_RISCV_FPU makes
# the FreeRTOS port save/restore the F registers per task, so C and Rust can
# both use FP safely. Rust must match the ilp32f ABI — the sample's
# .cargo/config.toml targets riscv32imafc + build-std (nightly).
CONFIG_FPU=y
CONFIG_RISCV_FPU=y
```

## src/main.c
```c
/*
 * Copyright (c) 2026, LISTENAI
 * SPDX-License-Identifier: Apache-2.0
 */
#define LOG_TAG "rust_fpu_hardfloat"
#include <lisa_log.h>

extern int rust_main(void);

int main(int argc, char **argv)
{
    (void)argc;
    (void)argv;
    LOGI("=== Rust FPU demo: full hard-float ABI (rv32imafc / ilp32f) ===");
    int ret = rust_main();
    if (ret != 0) {
        LOGE("rust_main returned %d", ret);
    }
    return 0;
}
```
