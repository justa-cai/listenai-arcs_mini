## CMakeLists.txt
```
cmake_minimum_required(VERSION 3.19)
set(CMAKE_EXPORT_COMPILE_COMMANDS ON)

find_package(listenai-cmake REQUIRED HINTS $ENV{ARCS_BASE})
project(rust_audio_play)

set(LISTENAI_RUST_APP ${CMAKE_CURRENT_SOURCE_DIR})

listenai_add_executable(${PROJECT_NAME})
include($ENV{ARCS_BASE}/modules/rust/rust_sample.cmake)
listenai_maybe_enable_rust_target(${PROJECT_NAME})
target_sources(${PROJECT_NAME} PRIVATE src/main.c)
```

## sample.yaml
```
tests:
  samples.libraries.rust.audio_play:
    programmer: arcs
    runner: uart
    platform_allow:
      - arcs_evb
    log_analyzer:
      type: "regex"
      pattern: "audio_play:done"
```

## prj.conf
```kconfig
CONFIG_LOG_FRONTEND_EASYLOGGER=y

# Single-core memory layout: grow SRAM, drop IPC / LUNA shared regions
# (matches the C/Zig audio playback samples).
CONFIG_MEM_SRAM_SIZE=0x00038000
CONFIG_MEM_IPC_ISOLATED=n
CONFIG_MEM_LUNA_SHARED_SIZE=0x0

# LISA device framework + audio (DAC) driver -> registers "audio0".
CONFIG_LISA_DEVICE=y
CONFIG_LISA_AUDIO_DEVICE=y

# The driver allocates its DMA buffer pool from the PSRAM heap, and the Rust
# sample puts its PCM working buffer there too (arcs::Zone::Psram, R5).
CONFIG_HEAP_SIZE=0x20000
CONFIG_PSRAM_HEAP_SIZE=0x80000

# To drive the on-board speaker amplifier instead of line-out, enable the PA:
#   CONFIG_LISA_AUDIO_PLAY_PA_ENABLE=y
#   CONFIG_LISA_AUDIO_PLAY_PA_PIN=27
```

## src/main.c
```c
/*
 * Copyright (c) 2026, LISTENAI
 * SPDX-License-Identifier: Apache-2.0
 */
#define LOG_TAG "rust_audio_play"
#include <lisa_log.h>

extern int rust_main(void);

/*
 * Plays two short tones (1 kHz then 500 Hz) on the "audio0" DAC. No pinmux is
 * needed here: the audio driver claims its pads from Kconfig, so this is a
 * thin shim into the Rust entry point.
 */
int main(int argc, char **argv)
{
    (void)argc;
    (void)argv;
    LOGI("=== Rust audio playback demo ===");
    int ret = rust_main();
    if (ret != 0) {
        LOGE("rust_main returned %d", ret);
    }
    return 0;
}
```
