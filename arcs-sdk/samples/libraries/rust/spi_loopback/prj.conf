## CMakeLists.txt
```
cmake_minimum_required(VERSION 3.19)
set(CMAKE_EXPORT_COMPILE_COMMANDS ON)

find_package(listenai-cmake REQUIRED HINTS $ENV{ARCS_BASE})
project(rust_spi_loopback)

set(LISTENAI_RUST_APP ${CMAKE_CURRENT_SOURCE_DIR})

listenai_add_executable(${PROJECT_NAME})
include($ENV{ARCS_BASE}/modules/rust/rust_sample.cmake)
listenai_maybe_enable_rust_target(${PROJECT_NAME})
target_sources(${PROJECT_NAME} PRIVATE src/main.c)
```

## sample.yaml
```
tests:
  samples.libraries.rust.spi_loopback:
    programmer: arcs
    runner: uart
    platform_allow:
      - arcs_evb
    log_analyzer:
      type: "regex"
      pattern: "spi_loopback:done"
```

## prj.conf
```kconfig
CONFIG_LOG_FRONTEND_EASYLOGGER=y
CONFIG_LISA_SPI_DEVICE=y
CONFIG_LISA_SPI0=y
```

## src/main.c
```c
/*
 * Copyright (c) 2026, LISTENAI
 * SPDX-License-Identifier: Apache-2.0
 */
#define LOG_TAG "rust_spi_loopback"
#include <lisa_log.h>
#include "IOMuxManager.h"

extern int rust_main(void);

/*
 * The board's weak lisa_spi0_pinmux() (boards/arcs_evb/pinmux.c) is empty, so
 * route SPI0 to physical pads here: CLK=PA15, MOSI=PA14, MISO=PA13, CS=PA12
 * (ALTER5). Mirrors samples/drivers/devices/lisa_spi/master. Jumper PA14<->PA13
 * to exercise the MOSI->MISO loopback path; otherwise the demo still runs to
 * completion and reports "no loopback".
 */
#ifdef CONFIG_BOARD_ARCS_EVB
void lisa_spi0_pinmux(void)
{
    IOMuxManager_PinConfigure(CSK_IOMUX_PAD_A, 15, CSK_IOMUX_FUNC_ALTER5);
    IOMuxManager_PinConfigure(CSK_IOMUX_PAD_A, 14, CSK_IOMUX_FUNC_ALTER5);
    IOMuxManager_PinConfigure(CSK_IOMUX_PAD_A, 13, CSK_IOMUX_FUNC_ALTER5);
    IOMuxManager_PinConfigure(CSK_IOMUX_PAD_A, 12, CSK_IOMUX_FUNC_ALTER5);
}
#endif

int main(int argc, char **argv)
{
    (void)argc;
    (void)argv;
    LOGI("=== Rust SPI loopback demo ===");
    int ret = rust_main();
    if (ret != 0) {
        LOGE("rust_main returned %d", ret);
    }
    return 0;
}
```
