## CMakeLists.txt
```
cmake_minimum_required(VERSION 3.19)
set(CMAKE_EXPORT_COMPILE_COMMANDS ON)

find_package(listenai-cmake REQUIRED HINTS $ENV{ARCS_BASE})
project(rust_helloworld)

set(LISTENAI_RUST_APP ${CMAKE_CURRENT_SOURCE_DIR})

listenai_add_executable(${PROJECT_NAME})
include($ENV{ARCS_BASE}/modules/rust/rust_sample.cmake)
listenai_maybe_enable_rust_target(${PROJECT_NAME})
target_sources(${PROJECT_NAME} PRIVATE src/main.c)
```

## sample.yaml
```
tests:
  samples.libraries.rust.helloworld:
    programmer: arcs
    runner: uart
    platform_allow:
      - arcs_evb
    log_analyzer:
      type: "regex"
      pattern: "=== Rust Test PASSED ==="
```

## prj.conf
```kconfig
# Minimal config — enable easylogger frontend for Rust log output to be visible.
CONFIG_LOG_FRONTEND_EASYLOGGER=y
```

## src/main.c
```c
/*
 * Copyright (c) 2026, LISTENAI
 * SPDX-License-Identifier: Apache-2.0
 *
 * Rust Hello-World on ARCS SDK.
 *
 * C is the real entry; it delegates the demo body to a Rust extern "C"
 * function defined in src/lib.rs via the arcs::entry! macro.
 */
#define LOG_TAG "rust_test"
#include <lisa_log.h>

extern int rust_hello_main(void);

int main(int argc, char **argv)
{
    (void)argc; (void)argv;

    LOGI("=== Rust Language Support Test ===");
    int ret = rust_hello_main();
    if (ret == 0) {
        LOGI("=== Rust Test PASSED ===");
    } else {
        LOGE("=== Rust Test FAILED (ret=%d) ===", ret);
    }
    return 0;
}
```
