## CMakeLists.txt
```
cmake_minimum_required(VERSION 3.19)
set(CMAKE_EXPORT_COMPILE_COMMANDS ON)

find_package(listenai-cmake REQUIRED HINTS $ENV{ARCS_BASE})
project(rust_display_gfx)

set(LISTENAI_RUST_APP ${CMAKE_CURRENT_SOURCE_DIR})

listenai_add_executable(${PROJECT_NAME})
include($ENV{ARCS_BASE}/modules/rust/rust_sample.cmake)
listenai_maybe_enable_rust_target(${PROJECT_NAME})
target_sources(${PROJECT_NAME} PRIVATE src/main.c)
```

## sample.yaml
```
tests:
  samples.libraries.rust.display_gfx:
    programmer: arcs
    runner: uart
    platform_allow:
      - arcs_evb
    log_analyzer:
      type: "regex"
      pattern: "display_gfx:done"
```

## prj.conf
```kconfig
CONFIG_LOG_FRONTEND_EASYLOGGER=y

# Display bring-up on arcs_evb (ST7789P3 over SPI1 4-wire, PWM0 backlight).
CONFIG_LISA_DEVICE=y
CONFIG_LISA_GPIO_DEVICE=y
CONFIG_LISA_GPIOA=y
CONFIG_LISA_GPIOB=y
CONFIG_LISA_PWM=y
CONFIG_LISA_SPI1=y
CONFIG_LISA_DISPLAY_DEVICE=y
CONFIG_LISA_DISPLAY_PANEL_ST7789P3=y
CONFIG_PANEL_ST7789P3_WIDTH=240
CONFIG_PANEL_ST7789P3_HEIGHT=320
CONFIG_PANEL_ST7789P3_X_OFFSET=0
CONFIG_LISA_DISPLAY_BUS_SPI_4WIRE=y

# Framebuffer (240x320x2 ~ 150 KiB) is allocated in PSRAM via arcs::Zone::Psram,
# so the PSRAM heap must be large enough (default 0x20000 is too small).
CONFIG_PSRAM_HEAP_SIZE=0x3b0000
```

## src/main.c
```c
/*
 * Copyright (c) 2026, LISTENAI
 * SPDX-License-Identifier: Apache-2.0
 */
#include <lisa_device.h>
#include <lisa_display.h>
#include "lisa_gpio.h"
#include "IOMuxManager.h"
#include "board.h"

#define LOG_TAG "rust_display_gfx"
#include <lisa_log.h>

extern int rust_main(void);

/*
 * arcs_evb LCD wiring (ST7789P3 over SPI1 4-wire). Pinmux + bus/panel attach are
 * board-specific C; Rust (rust_main) opens the ready "display" device and draws.
 * Mirrors samples/drivers/devices/lisa_display/display_flush.
 */
#ifdef CONFIG_BOARD_ARCS_EVB
#define LCD_CS_PIN 5
#define LCD_SPI_CLK_PIN 3
#define LCD_SPI_DATA_PIN 1

void lisa_gpioa_pinmux(void)
{
    IOMuxManager_PinConfigure(CSK_IOMUX_PAD_A, LCD_RST_PIN, CSK_IOMUX_FUNC_ALTER1);
}

void lisa_gpiob_pinmux(void)
{
    IOMuxManager_PinConfigure(CSK_IOMUX_PAD_B, LCD_TE_PIN, CSK_IOMUX_FUNC_DEFAULT);
    IOMuxManager_PinConfigure(CSK_IOMUX_PAD_B, LCD_CD_PIN, CSK_IOMUX_FUNC_DEFAULT);
    IOMuxManager_PinConfigure(CSK_IOMUX_PAD_B, LCD_CS_PIN, CSK_IOMUX_FUNC_DEFAULT);
}

void lisa_spi1_pinmux(void)
{
    IOMuxManager_PinConfigure(CSK_IOMUX_PAD_B, LCD_SPI_CLK_PIN, CSK_IOMUX_FUNC_ALTER6);
    IOMuxManager_PinConfigure(CSK_IOMUX_PAD_B, LCD_SPI_DATA_PIN, CSK_IOMUX_FUNC_ALTER6);
}
#endif

int main(int argc, char **argv)
{
    (void)argc;
    (void)argv;
    LOGI("=== Rust display (embedded-graphics) demo ===");

    lisa_device_t *gpioa_dev = lisa_device_get("gpioa");
    lisa_device_t *gpiob_dev = lisa_device_get("gpiob");

    lisa_display_config_t display_config = {
        .bus_type = LISA_DISPLAY_BUS_SPI_4WIRE,
        .panel_name = "st7789p3",
        .bus_config = {.spi_4wire = {
                           .spi_dev = lisa_device_get("spi1"),
                           .cs_gpio = gpiob_dev,
                           .cs_pin = LCD_CS_PIN,
                           .dc_gpio = gpiob_dev,
                           .dc_pin = LCD_CD_PIN,
                           .spi_freq = 50 * 1000 * 1000,
                       }},
        .backlight = {.type = LISA_DISPLAY_BACKLIGHT_TYPE_PWM,
                      .blacklight_polarity = LISA_DISPLAY_BLACKLIGHT_POLARITY_LOW,
                      .config.pwm = {.channel = 0, .dev = lisa_device_get("pwm0"), .freq = 2000}},
        .rst_gpio = gpioa_dev,
        .rst_pin = LCD_RST_PIN,
    };

    lisa_device_t *display_device = lisa_device_get("display");
    if (!display_device) {
        LOGE("Failed to get display device");
        return -1;
    }
    int ret = lisa_display_attach_bus(display_device, &display_config);
    if (ret != 0) {
        LOGE("attach_bus failed: %d", ret);
        return -1;
    }

    ret = rust_main();
    if (ret != 0) {
        LOGE("rust_main returned %d", ret);
    }
    return 0;
}
```
