## CMakeLists.txt
```
cmake_minimum_required(VERSION 3.19)
set(CMAKE_EXPORT_COMPILE_COMMANDS ON)

find_package(listenai-cmake REQUIRED HINTS $ENV{ARCS_BASE})
project(rust_blinky)

set(LISTENAI_RUST_APP ${CMAKE_CURRENT_SOURCE_DIR})

listenai_add_executable(${PROJECT_NAME})
include($ENV{ARCS_BASE}/modules/rust/rust_sample.cmake)
listenai_maybe_enable_rust_target(${PROJECT_NAME})
target_sources(${PROJECT_NAME} PRIVATE src/main.c)
```

## sample.yaml
```
tests:
  samples.libraries.rust.blinky:
    programmer: arcs
    runner: uart
    platform_allow:
      - arcs_evb
    log_analyzer:
      type: "regex"
      pattern: "blinky:tick:"
```

## prj.conf
```kconfig
# Minimal config — enable easylogger frontend for Rust log output to be visible.
CONFIG_LOG_FRONTEND_EASYLOGGER=y

# GPIO controller used by the blinky sample (LED on PAD_B[9]).
CONFIG_LISA_GPIO_DEVICE=y
CONFIG_LISA_GPIOB=y
```

## src/main.c
```c
/*
 * Copyright (c) 2026, LISTENAI
 * SPDX-License-Identifier: Apache-2.0
 *
 * Rust Blinky on ARCS SDK.
 *
 * C is the real entry; it delegates the demo body to a Rust extern "C"
 * function defined in src/lib.rs via the arcs::entry! macro.
 */
#define LOG_TAG "rust_blinky"
#include <lisa_log.h>

extern int rust_blinky_main(void);

int main(int argc, char **argv)
{
    (void)argc; (void)argv;

    LOGI("=== Rust Blinky Starting ===");
    int ret = rust_blinky_main();
    if (ret != 0) {
        LOGE("rust_blinky_main returned %d", ret);
    }
    return 0;
}
```
