## CMakeLists.txt
```
cmake_minimum_required(VERSION 3.19)
set(CMAKE_EXPORT_COMPILE_COMMANDS ON)

find_package(listenai-cmake REQUIRED HINTS $ENV{ARCS_BASE})
project(rust_rtt_log)

set(LISTENAI_RUST_APP ${CMAKE_CURRENT_SOURCE_DIR})

listenai_add_executable(${PROJECT_NAME})
include($ENV{ARCS_BASE}/modules/rust/rust_sample.cmake)
listenai_maybe_enable_rust_target(${PROJECT_NAME})
target_sources(${PROJECT_NAME} PRIVATE src/main.c)
```

## sample.yaml
```
tests:
  samples.libraries.rust.rtt_log:
    programmer: arcs
    runner: uart
    platform_allow:
      - arcs_evb
    log_analyzer:
      type: "regex"
      pattern: "rtt_log: tick"
```

## prj.conf
```kconfig
# Easylogger frontend → dispatches to all registered backends.
CONFIG_LOG_FRONTEND_EASYLOGGER=y
# Additive SEGGER RTT backend: Rust `log` (via elog_output) is also written to
# the RTT control block, readable over J-Link (JLinkRTTLogger/JLinkRTTClient).
CONFIG_LOG_BACKEND_SEGGER_RTT=y
```

## src/main.c
```c
/*
 * Copyright (c) 2026, LISTENAI
 * SPDX-License-Identifier: Apache-2.0
 */
#define LOG_TAG "rust_rtt_log"
#include <lisa_log.h>

extern int rust_main(void);

int main(int argc, char **argv)
{
    (void)argc;
    (void)argv;
    LOGI("=== Rust RTT log demo ===");
    int ret = rust_main();
    if (ret != 0) {
        LOGE("rust_main returned %d", ret);
    }
    return 0;
}
```
