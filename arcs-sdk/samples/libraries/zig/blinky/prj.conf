## CMakeLists.txt
```
cmake_minimum_required(VERSION 3.19)

set(CMAKE_EXPORT_COMPILE_COMMANDS ON)

find_package(listenai-cmake REQUIRED HINTS $ENV{ARCS_BASE})

project(zig_blinky)

set(LISTENAI_ZIG_APP ${CMAKE_CURRENT_SOURCE_DIR}/src/zig_app.zig)

listenai_add_executable(${PROJECT_NAME})
listenai_maybe_enable_zig_target(${PROJECT_NAME})

target_sources(${PROJECT_NAME} PRIVATE src/main.c)
```

## sample.yaml
```
tests:
  samples.libraries.zig.blinky:
    programmer: arcs
    runner: uart
    platform_allow:
      - arcs_evb
    log_analyzer:
      type: "regex"
      pattern: "Blinky done"
```

## prj.conf
```kconfig
CONFIG_LOG=y
CONFIG_PRINTF_LOG_REDIRECT=y
CONFIG_LISA_DEVICE=y
CONFIG_LISA_GPIO_DEVICE=y
CONFIG_LISA_GPIOB=y
```

## src/main.c
```c
/* Zig on ARCS SDK - Blinky Demo
 *
 * 验证 Zig 代码可以通过设备框架操控 GPIO 硬件。
 * C 端作为入口, 调用 Zig 导出的 blinky 函数。
 */

#define LOG_TAG "zig_blinky"

#include <lisa_log.h>

/* Zig 导出的函数 */
extern int zig_blinky_main(void);

int main(int argc, char **argv)
{
    LOGI("=== Zig Blinky Demo ===");
    LOGI("Calling zig_blinky_main()...");

    int ret = zig_blinky_main();

    if (ret == 0) {
        LOGI("Zig blinky returned successfully (ret=%d)", ret);
        LOGI("=== Zig Blinky PASSED ===");
    } else {
        LOGE("Zig blinky failed (ret=%d)", ret);
        LOGE("=== Zig Blinky FAILED ===");
    }

    return 0;
}
```
