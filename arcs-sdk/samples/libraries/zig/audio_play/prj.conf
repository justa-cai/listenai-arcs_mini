## CMakeLists.txt
```
cmake_minimum_required(VERSION 3.19)

set(CMAKE_EXPORT_COMPILE_COMMANDS ON)

find_package(listenai-cmake REQUIRED HINTS $ENV{ARCS_BASE})

project(zig_audio_play)

set(LISTENAI_ZIG_APP ${CMAKE_CURRENT_SOURCE_DIR}/src/zig_app.zig)

listenai_add_executable(${PROJECT_NAME})
listenai_maybe_enable_zig_target(${PROJECT_NAME})

target_sources(${PROJECT_NAME} PRIVATE src/main.c)
```

## sample.yaml
```
tests:
  samples.libraries.zig.audio_play:
    build_only: true
```

## prj.conf
```kconfig
# 单核内存配置
CONFIG_MEM_SRAM_SIZE=0x00038000
CONFIG_MEM_IPC_ISOLATED=n
CONFIG_MEM_LUNA_SHARED_SIZE=0x0

# LISA Device Framework
CONFIG_LISA_DEVICE=y

# LISA Audio Driver
CONFIG_LISA_AUDIO_DEVICE=y

# 减少 heap 以释放 SRAM
CONFIG_HEAP_SIZE=0x20000
CONFIG_PSRAM_HEAP_SIZE=0x80000

# 日志
CONFIG_LOG=y
CONFIG_PRINTF_LOG_REDIRECT=y

# 调试
CONFIG_BACK_TRACE=y
```

## src/main.c
```c
/* Zig on ARCS SDK - Audio Play Demo
 *
 * 验证 Zig 代码可以通过音频设备框架播放 PCM 音频。
 * Zig 端在编译时生成正弦波 PCM 数据，运行时通过 Audio HAL 播放。
 *
 * 播放内容:
 *   - 0.8s 1kHz 正弦波 (高音嘟)
 *   - 0.2s 静音
 *   - 0.8s 500Hz 正弦波 (低音嘟)
 *   - 0.2s 静音
 */

#define LOG_TAG "zig_audio"

#include <lisa_log.h>

/* Zig 导出的函数 */
extern int zig_audio_play_main(void);

int main(int argc, char **argv)
{
    LOGI("=== Zig Audio Play Demo ===");
    LOGI("Calling zig_audio_play_main()...");

    int ret = zig_audio_play_main();

    if (ret == 0) {
        LOGI("Zig audio play returned successfully (ret=%d)", ret);
        LOGI("=== Zig Audio Play PASSED ===");
    } else {
        LOGE("Zig audio play failed (ret=%d)", ret);
        LOGE("=== Zig Audio Play FAILED ===");
    }

    return 0;
}
```
