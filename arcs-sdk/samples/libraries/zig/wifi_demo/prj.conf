## CMakeLists.txt
```
cmake_minimum_required(VERSION 3.19)

set(CMAKE_EXPORT_COMPILE_COMMANDS ON)

find_package(listenai-cmake REQUIRED HINTS $ENV{ARCS_BASE})

project(zig_wifi_demo)

set(LISTENAI_ZIG_APP ${CMAKE_CURRENT_SOURCE_DIR}/src/zig_app.zig)

listenai_add_executable(${PROJECT_NAME})
listenai_maybe_enable_zig_target(${PROJECT_NAME})

target_sources(${PROJECT_NAME} PRIVATE src/main.c)
```

## sample.yaml
```
tests:
  samples.libraries.zig.wifi_demo:
    build_only: true
```

## prj.conf
```kconfig
CONFIG_HEAP_SIZE=0xC000
CONFIG_PSRAM_HEAP_SIZE=0x200000

CONFIG_LOG=y
CONFIG_PRINTF_LOG_REDIRECT=y

# WiFi (底层, 无 WiFi Manager)
CONFIG_LISA_WIFI=y
CONFIG_WIFI_LWIP_SAME_CORE=y

# MAC Manager
CONFIG_MAC_MANAGER=y
CONFIG_MAC_MANAGER_MAC_BY_CHIP_ID=y

# Platform
CONFIG_LISA_PORTING=y
CONFIG_LISA_OS=y
CONFIG_LISA_DEVICE=y
```

## src/main.c
```c
#define LOG_TAG "zig_wifi"

#include <lisa_log.h>
#include "FreeRTOS.h"
#include "task.h"

extern int zig_wifi_demo_main(void);
extern int zig_wifi_scan_task(void);

int main(int argc, char **argv)
{
    LOGI("=== Zig WiFi Scan Demo ===");

    int ret = zig_wifi_demo_main();
    if (ret != 0) {
        LOGE("WiFi init failed (ret=%d)", ret);
        return ret;
    }

    ret = zig_wifi_scan_task();
    if (ret == 0) {
        LOGI("=== WiFi Scan PASSED ===");
    } else {
        LOGE("WiFi scan failed (ret=%d)", ret);
    }

    while (1) {
        vTaskDelay(pdMS_TO_TICKS(10000));
    }

    return 0;
}
```
