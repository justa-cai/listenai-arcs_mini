## CMakeLists.txt
```
cmake_minimum_required(VERSION 3.19)

set(CMAKE_EXPORT_COMPILE_COMMANDS ON)

find_package(listenai-cmake REQUIRED HINTS $ENV{ARCS_BASE})

project(app)

if(DEFINED ENV{RLOTTIE_ROOT})
    set(RLOTTIE_ROOT_DEFAULT "$ENV{RLOTTIE_ROOT}")
else()
    set(RLOTTIE_ROOT_DEFAULT "${CMAKE_CURRENT_LIST_DIR}/rlottie-riscv")
endif()

set(RLOTTIE_ROOT "${RLOTTIE_ROOT_DEFAULT}" CACHE PATH "Path to prebuilt Samsung rlottie install")


find_path(RLOTTIE_INCLUDE_DIR
    NAMES rlottie_capi.h
    HINTS "${RLOTTIE_ROOT}/include"
    NO_DEFAULT_PATH
)

find_library(RLOTTIE_LIBRARY
    NAMES rlottie librlottie.a
    HINTS "${RLOTTIE_ROOT}/lib"
    NO_DEFAULT_PATH
)

if(NOT RLOTTIE_INCLUDE_DIR OR NOT RLOTTIE_LIBRARY)
    message(FATAL_ERROR
        "未在 RLOTTIE_ROOT='${RLOTTIE_ROOT}' 下找到可用的 Samsung rlottie 预编译产物。\n"
        "期望存在:\n"
        "  ${RLOTTIE_ROOT}/include/rlottie_capi.h\n"
        "  ${RLOTTIE_ROOT}/lib/librlottie.a")
endif()

listenai_add_executable(${PROJECT_NAME})

target_sources(${PROJECT_NAME} PRIVATE
    src/main.c
)

# modules_lvgl8 会无条件编译 lv_port_indev.c；即便 sample 不启用触摸，
# 也需要让其在编译期能找到 lisa_touch.h。
get_filename_component(ARCS_SDK_ROOT "${CMAKE_CURRENT_LIST_DIR}/../../../../../" ABSOLUTE)
listenai_include_directories("${ARCS_SDK_ROOT}/drivers/lisa_touch")

# 使 modules_lvgl8 编译 lv_rlottie.c 时能够找到 Samsung rlottie 的 C API 头文件。
listenai_include_directories(${RLOTTIE_INCLUDE_DIR})

# 把 rlottie 放进 ListenAI 统一链接组，避免静态库顺序导致符号解析失败。
listenai_link_libraries("${RLOTTIE_LIBRARY}" m)

# rlottie 为 C++ 静态库，这里强制使用 C++ 链接器。
set_property(TARGET ${PROJECT_NAME} PROPERTY LINKER_LANGUAGE CXX)
```

## sample.yaml
```
tests:
  samples.lvgl8.rlottie:
    programmer: arcs
    runner: uart
    log_analyzer:
      type: "regex"
      pattern: "LVGL8 rlottie start"
```

## prj.conf
```kconfig
# 项目可根据需要在此文件中设置对应的配置

# LISA 设备配置
CONFIG_LISA_DEVICE=y
CONFIG_LISA_GPIO_DEVICE=y
CONFIG_LISA_GPIOA=y
CONFIG_LISA_GPIOB=y
CONFIG_LISA_PWM=y
CONFIG_LISA_SPI0=y
CONFIG_LISA_SPI1=y

# 显示设备配置
CONFIG_LISA_DISPLAY_DEVICE=y
CONFIG_LISA_DISPLAY_PANEL_ST7789P3=y
CONFIG_LISA_DISPLAY_CPDMA_ROTATE=n
CONFIG_LISA_DISPLAY_BUS_SPI_4WIRE=y
CONFIG_PANEL_ST7789P3_WIDTH=240
CONFIG_PANEL_ST7789P3_HEIGHT=240
CONFIG_PANEL_ST7789P3_X_OFFSET=0
CONFIG_LISA_DISPLAY_COLOR_INVERT=y

# 触摸设备配置
CONFIG_LISA_TOUCH_DEVICE=n
CONFIG_LISA_I2C=n
CONFIG_LISA_I2C0=n
CONFIG_LISA_TOUCH_ARCS_CST328=n

# LVGL8 配置
CONFIG_SDK_MODULE_LVGL8=y
CONFIG_LV_DEMO_SYS_HEAP=y
CONFIG_LV_DRIVER_PIXEL_ALIGN_SIZE=16
CONFIG_LV_BUILD_EXAMPLES=y
CONFIG_LV_USE_RLOTTIE=y
CONFIG_LV_USE_GPU_CSK_DMA2D=y
CONFIG_LV_DOUBLE_VDB=y
CONFIG_LV_USE_PERF_MONITOR=y
CONFIG_LV_DRIVER_FULL_REFRESH=y
CONFIG_LV_CUSTOM_MONITOR=n
CONFIG_LV_REFR_UNCONDITIONAL_AREA_JOIN=y
CONFIG_LV_DRIVER_ROTATE_90=y
CONFIG_LV_ATTRIBUTE_FAST_MEM_USE_IRAM=y

# 内存配置
CONFIG_PSRAM_HEAP_SIZE=614400
```

## src/main.c
```c
/*
 * Copyright (c) 2025, LISTENAI
 *
 * SPDX-License-Identifier: Apache-2.0
 */

#include "FreeRTOS.h"
#include "FreeRTOSConfig.h"
#include "IOMuxManager.h"
#include "board.h"
#include "lisa_device.h"
#include "lisa_display.h"
#include "lv_port_disp.h"
#include "lvgl.h"

#define LOG_TAG "lvgl8_sample_rlottie"
#include <lisa_log.h>

#define RLOTTIE_MARGIN      16
#define MIN_RLOTTIE_SIZE    96
#define UI_TASK_STACK_DEPTH (8 * 1024)

/*
    为满足不同板型示例场景，重定向设备的 pinmux 配置
*/
#ifdef CONFIG_BOARD_ARCS_EVB

/* arcs_evb: LCD 与 arcs_mini 引脚不同，需要重定义并覆盖 weak pinmux 函数 */
#define LCD_CS_PIN       5
#define LCD_SPI_CLK_PIN  3
#define LCD_SPI_DATA_PIN 1

void lisa_gpioa_pinmux()
{
    IOMuxManager_PinConfigure(CSK_IOMUX_PAD_A, LCD_RST_PIN, CSK_IOMUX_FUNC_ALTER1);
}

void lisa_gpiob_pinmux()
{
    IOMuxManager_PinConfigure(CSK_IOMUX_PAD_B, LCD_TE_PIN, CSK_IOMUX_FUNC_DEFAULT);
    IOMuxManager_PinConfigure(CSK_IOMUX_PAD_B, LCD_CD_PIN, CSK_IOMUX_FUNC_DEFAULT);
    IOMuxManager_PinConfigure(CSK_IOMUX_PAD_B, LCD_CS_PIN, CSK_IOMUX_FUNC_DEFAULT);
}

void lisa_spi1_pinmux()
{
    IOMuxManager_PinConfigure(CSK_IOMUX_PAD_B, LCD_SPI_CLK_PIN, CSK_IOMUX_FUNC_ALTER6);
    IOMuxManager_PinConfigure(CSK_IOMUX_PAD_B, LCD_SPI_DATA_PIN, CSK_IOMUX_FUNC_ALTER6);
}

void lisa_pwm_pinmux()
{
    IOMuxManager_PinConfigure(CSK_IOMUX_PAD_A, LCD_PWM_PIN, CSK_IOMUX_FUNC_ALTER12);
}

#else /* arcs_mini 及其他板型 */

/*
 * arcs_mini: LCD_CS/CD/SPI/RST/PWM 引脚已由 boards/arcs_mini/pinmux.h 定义，
 * pinmux.c 提供 weak 实现，无需在此覆盖。
 */

#endif

extern const uint8_t lv_example_rlottie_approve[];

static lisa_device_t *display_device;

static lv_coord_t get_lottie_size(void)
{
    lv_coord_t min_res = LV_MIN(lv_disp_get_hor_res(NULL), lv_disp_get_ver_res(NULL));
    lv_coord_t max_size = min_res - RLOTTIE_MARGIN;

    if (max_size < MIN_RLOTTIE_SIZE) {
        return MIN_RLOTTIE_SIZE;
    }

    return max_size;
}

static void create_rlottie_demo_ui(void)
{
    lv_coord_t lottie_size = get_lottie_size();
    lv_obj_t *screen = lv_scr_act();
    lv_obj_t *lottie;

    lv_obj_set_style_bg_color(screen, lv_color_hex(0x0f172a), 0);
    lv_obj_set_style_bg_opa(screen, LV_OPA_COVER, 0);

    lottie = lv_rlottie_create_from_raw(screen,
                                        lottie_size,
                                        lottie_size,
                                        (const char *)lv_example_rlottie_approve);
    lv_obj_center(lottie);
}

static void task_ui(void *pvParameters)
{
    LV_UNUSED(pvParameters);

    create_rlottie_demo_ui();

    LISA_LOGI(LOG_TAG, "LVGL8 rlottie start");

    lv_task_handler();
    lisa_display_blanking_off(display_device);
    lisa_display_set_brightness(display_device, 100);

    while (1) {
        uint32_t wait_time = lv_task_handler();
        vTaskDelay(pdMS_TO_TICKS(wait_time));
    }
}

int main(int argc, char **argv)
{
    lisa_device_t *gpioa_dev;
    lisa_device_t *gpiob_dev;
    lisa_display_config_t display_config;
    int ret;

    LV_UNUSED(argc);
    LV_UNUSED(argv);

    lv_init();

    gpioa_dev = lisa_device_get("gpioa");
    gpiob_dev = lisa_device_get("gpiob");

#ifdef CONFIG_BOARD_ARCS_EVB
    display_config = (lisa_display_config_t){
        .bus_type = LISA_DISPLAY_BUS_SPI_4WIRE,
        .bus_config = {.spi_4wire =
                           {
                               .spi_dev = lisa_device_get("spi1"),
                               .cs_gpio = gpiob_dev,
                               .cs_pin = LCD_CS_PIN,
                               .dc_gpio = gpiob_dev,
                               .dc_pin = LCD_CD_PIN,
                               .spi_freq = 50 * 1000 * 1000,
                           }},
        .backlight = {.type = LISA_DISPLAY_BACKLIGHT_TYPE_PWM,
                      .blacklight_polarity = LISA_DISPLAY_BLACKLIGHT_POLARITY_LOW,
                      .config.pwm = {.channel = 0, .dev = lisa_device_get("pwm0"), .freq = 2000}},
        .rst_gpio = gpioa_dev,
        .rst_pin = LCD_RST_PIN,
    };
#else
    display_config = (lisa_display_config_t){
        .bus_type = LISA_DISPLAY_BUS_SPI_4WIRE,
        .bus_config = {.spi_4wire =
                           {
                               .spi_dev = lisa_device_get("spi0"),
                               .cs_gpio = gpioa_dev,
                               .cs_pin = LCD_CS_PIN,
                               .dc_gpio = gpioa_dev,
                               .dc_pin = LCD_CD_PIN,
                               .spi_freq = 50 * 1000 * 1000,
                           }},
        .backlight = {.type = LISA_DISPLAY_BACKLIGHT_TYPE_PWM,
                      .blacklight_polarity = LISA_DISPLAY_BLACKLIGHT_POLARITY_LOW,
                      .config.pwm = {.channel = 1, .dev = lisa_device_get("pwm0"), .freq = 2000}},
        .rst_gpio = gpiob_dev,
        .rst_pin = LCD_RST_PIN,
    };
#endif

    display_device = lisa_device_get("display");
    if (display_device == NULL) {
        LISA_LOGE(LOG_TAG, "Failed to get display device");
        return -1;
    }

    ret = lisa_display_attach_bus(display_device, &display_config);
    if (ret != 0) {
        LISA_LOGE(LOG_TAG, "Display bus attach failed: %d", ret);
        return ret;
    }

    lv_port_disp_init(display_device);

    /* arcs_mini 无触摸屏，此 sample 仅初始化显示，不初始化 indev。 */

    xTaskCreate(task_ui, "task_ui", UI_TASK_STACK_DEPTH, NULL, configMAX_PRIORITIES - 2, NULL);

    return 0;
}
```
