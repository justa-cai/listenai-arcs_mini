## arcs-sdk/samples/media/app_player/stream_playback/sample.yaml
```yaml
tests:
  samples.app_player.stream_playback:
    programmer: arcs
    runner: uart
    build_only: true
    log_analyzer:
      type: "regex"
      pattern: "Stream playback completed"
```

## arcs-sdk/samples/media/giflib/sample.yaml
```yaml
tests:
  samples.giflib:
    programmer: arcs
    runner: uart
    log_analyzer:
      type: "regex"
      pattern: "GifLib sample completed successfully"
```

## arcs-sdk/samples/media/png/sample.yaml
```yaml
tests:
  samples.png:
    programmer: arcs
    runner: uart
    log_analyzer:
      type: "regex"
      pattern: "Conversion completed successfully"
```

## arcs-sdk/samples/modules/cjson/sample.yaml
```yaml
tests:
  samples.cjson:
    programmer: arcs
    runner: uart
    log_analyzer:
      type: "regex"
      pattern: "Zip Code: 12345"
```

## arcs-sdk/samples/modules/collections-c/sample.yaml
```yaml
tests:
  samples.helloworld:
    programmer: arcs
    runner: uart
    log_analyzer:
      type: "regex"
      pattern: "collections-c sample done"
```

## arcs-sdk/samples/modules/flexlayout/sample.yaml
```yaml
tests:
  samples.flexlayout:
    programmer: arcs
    runner: uart
    log_analyzer:
      type: "regex"
      pattern: "Start flexlayout sample"
```

## arcs-sdk/samples/modules/jpeg_turbo/jpeg_turbo_show/sample.yaml
```yaml
tests:
  samples.jpeg_turbo.jpeg_turbo_show:
    programmer: arcs
    runner: uart
    log_analyzer:
      type: "regex"
      pattern: "Demo completed"
```

## arcs-sdk/samples/modules/lisa_shell/sample.yaml
```yaml
tests:
  samples.lisa_shell:
    programmer: arcs
    runner: uart
    log_analyzer:
      type: "regex"
      pattern: "Type 'help' in shell to see all commands"
```

## arcs-sdk/samples/modules/mbedtls/ecdsa/sample.yaml
```yaml
tests:
  samples.ecdsa:
    programmer: arcs
    runner: uart
    log_analyzer:
      type: "regex"
      pattern: "mbedtls ecdsa test begin"
```

## arcs-sdk/samples/modules/quirc/sample.yaml
```yaml
tests:
  samples.modules.quirc:
    programmer: arcs
    runner: uart
    log_analyzer:
      type: "regex"
      pattern: "quirc Sample Application"
```

## arcs-sdk/samples/modules/usb/device/uvc/Kconfig
```kconfig
osource "$ARCS_BASE/Kconfig"

config IMAGE_WIDTH
    int "iamge width"
    default 640

config IMAGE_HEIGHT
    int "image height"
    default 480

config IMAGE_FPS
    int "image fps"
    default 15
```

## arcs-sdk/samples/network/wifi_dual_core/cp/src/low_port/Kconfig
```kconfig
menu "low port configuration"

    config LOW_PORT
        bool "low port support"
        default n

endmenu
```

## arcs-sdk/samples/security/mbedtls/ecdh/sample.yaml
```yaml
tests:
  samples.ecdh:
    programmer: arcs
    runner: uart
    log_analyzer:
      type: "regex"
      pattern: "mbedtls ecdh test end"
```

## arcs-sdk/samples/security/mbedtls/rsa/sample.yaml
```yaml
tests:
  samples.rsa:
    programmer: arcs
    runner: uart
    log_analyzer:
      type: "regex"
      pattern: "PKCS#1 sig. verify: all passed"
```

## arcs-sdk/samples/security/mbedtls/self_check/sample.yaml
```yaml
tests:
  samples.self_check:
    programmer: arcs
    runner: uart
    log_analyzer:
      type: "regex"
      pattern: "[ All tests PASS ]"
```

## arcs-sdk/samples/subsys/linker_script/app_registry/sample.yaml
```yaml
tests:
  samples.linker_script.app_registry:
    programmer: arcs
    runner: uart
    log_analyzer:
      type: "regex"
      pattern: "All 2 modules initialized"
```

## arcs-sdk/samples/subsys/linker_script/code_relocate/sample.yaml
```yaml
tests:
  samples.linker_script.code_relocate:
    programmer: arcs
    runner: uart
    log_analyzer:
      type: "regex"
      pattern: "IRQ handler executed successfully from SRAM"
```

## arcs-sdk/samples/subsys/linker_script/custom_section/sample.yaml
```yaml
tests:
  samples.linker_script.custom_section:
    programmer: arcs
    runner: uart
    log_analyzer:
      type: "regex"
      pattern: "Total config entries: 3"
```

## arcs-sdk/samples/subsys/uboot/recovery_basic/Kconfig
```kconfig
#
# SPDX-License-Identifier: Apache-2.0
#

osource "$ARCS_BASE/system/uboot/Kconfig"
```

## arcs-sdk/samples/subsys/uboot/recovery_basic/sample.yaml
```yaml
tests:
  samples.subsys.uboot.recovery_basic.cherryusb:
    build_only: true

  samples.subsys.uboot.recovery_basic.tinyusb:
    build_only: true
    build_extra_args: "-c prj_tinyusb.conf"
```

## arcs-sdk/samples/subsys/usb/device/msc/sample.yaml
```yaml
tests:
  samples.usb.device.msc:
    build_only: true
    log_analyzer:
      type: "regex"
      pattern: "Device mounted"
```
