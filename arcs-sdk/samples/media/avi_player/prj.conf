## CMakeLists.txt
```
cmake_minimum_required(VERSION 3.20)

set(CMAKE_EXPORT_COMPILE_COMMANDS ON)

find_package(listenai-cmake REQUIRED HINTS $ENV{ARCS_BASE})

project(arcs)

add_subdirectory(src)

listenai_add_executable(${PROJECT_NAME})
```

## Kconfig
```
# Copyright (c) 2025, LISTENAI
# SPDX-License-Identifier: Apache-2.0

osource "$ARCS_BASE/Kconfig"

# All playback knobs are now under:
#   component -> lisa_media_player

config AVI_PLAYER_LVGL_RENDER
	bool "Enable LVGL video renderer for avi_player"
	default y
	help
	  When enabled, avi_player registers a custom av_render video renderer that
	  updates frames through LVGL image widgets.
```

## sample.yaml
```
tests:
  samples.media.avi_player:
    programmer: arcs
    runner: uart
    log_analyzer:
      type: "regex"
      pattern: "UI task started"
```

## prj.conf
```kconfig
# 系统配置
CONFIG_BACK_TRACE=y

# 内存配置
CONFIG_MODULE_HEAP=y
# arcs_evb 的 SRAM 仅 146KB，原 0x20000(128KB) 会导致 .noinit 溢出。
# 绝大多数分配走 PSRAM heap，这里只留小块用于快速路径。
CONFIG_HEAP_SIZE=0x4000
CONFIG_PSRAM_HEAP_SIZE=0x5b0000

# 日志和调试
CONFIG_LOG=y
# CONFIG_SYSLOG_PRINTK_REDIRECT=y
# CONFIG_ARCS_HAL_DEBUG=y
CONFIG_LOG_LEVEL_DEBUG=y
CONFIG_ARCS_HAL_LOG_LEVEL_INFO=y

# 项目可根据需要在此文件中设置对应的配置
# LISA Device Framework
CONFIG_LISA_DEVICE=y
CONFIG_LISA_GPIO_DEVICE=y
CONFIG_LISA_GPIOA=y
CONFIG_LISA_GPIOB=y
CONFIG_LISA_PWM=y
CONFIG_LISA_SPI1=y

# lisa 显示屏配置（arcs_evb 默认：ST7789P3 240x320，4-wire SPI）
CONFIG_LISA_DISPLAY_DEVICE=y
CONFIG_LISA_DISPLAY_BUS_SPI_4WIRE=y
CONFIG_LISA_DISPLAY_PANEL_ST7789P3=y
CONFIG_PANEL_ST7789P3_WIDTH=240
CONFIG_PANEL_ST7789P3_HEIGHT=320
CONFIG_PANEL_ST7789P3_X_OFFSET=0
CONFIG_LISA_DISPLAY_COLOR_INVERT=y

# 触摸设备配置（arcs_evb 默认：CST328 on I2C0）
CONFIG_LISA_TOUCH_DEVICE=y
CONFIG_LISA_I2C=y
CONFIG_LISA_I2C0=y
CONFIG_LISA_TOUCH_ARCS_CST328=y
# 把 CST328 读取任务的优先级提到 decoder (priority 3) 之上，
# 否则视频播放时 MJPEG/MP3 解码线程会把 touch 任务饿死，
# 导致屏幕点击事件（例如播放界面的 Stop 按钮）没有响应。
CONFIG_LISA_TOUCH_ARCS_CST328_READ_TASK_PRIORITY=5

# LVGL8 配置
CONFIG_SDK_MODULE_LVGL8=y
CONFIG_LV_DEMO_SYS_HEAP=y
CONFIG_LV_DRIVER_PIXEL_ALIGN_SIZE=16
CONFIG_LV_USE_DEMO_WIDGETS=y
CONFIG_LV_USE_GPU_CSK_DMA2D=y
CONFIG_LV_DOUBLE_VDB=y
CONFIG_LV_USE_PERF_MONITOR=y
CONFIG_LV_DRIVER_FULL_REFRESH=y
CONFIG_LV_CUSTOM_MONITOR=n
CONFIG_LV_REFR_UNCONDITIONAL_AREA_JOIN=y
CONFIG_LV_DRIVER_ROTATE_270=y
# CONFIG_LV_ATTRIBUTE_FAST_MEM_USE_IRAM=y  # disabled: ILM too small with wifi+media components

# LVGL fonts
CONFIG_LV_FONT_MONTSERRAT_16=y
CONFIG_LV_FONT_MONTSERRAT_12=y
CONFIG_LV_USE_DEMO_WIDGETS=y

# lisa SDMMC 配置
CONFIG_LISA_SDMMC_DEVICE=y
CONFIG_LISA_SDMMC_CARD_TYPE_AUTO=y

# 文件系统配置
CONFIG_FILE_SYSTEM=y
CONFIG_FATFS_FILESYSTEM=y

# DISK配置
CONFIG_DISK_DRIVER=y
CONFIG_DISK_DRIVER_SDMMC=y

# 抽象文件系统
CONFIG_LSFS=y
CONFIG_LSFS_FAT=y
CONFIG_LSFS_REGISTER_VFS=y

# 虚拟文件系统
CONFIG_LVFS=y
CONFIG_LVFS_POSIX_API=y
CONFIG_LVFS_POSIX_API_ALIAS=y

# LISA Audio Driver
CONFIG_LISA_AUDIO_DEVICE=y

# Play (DAC) - enable external PA control (some boards need this for audible output)
# CONFIG_LISA_AUDIO_PLAY_PA_ENABLE=y

# FreeRTOS 配置
CONFIG_FREERTOS_STATIC_ALLOCATION_ENABLE=y

#using mbedtls for hardware decoding(IF CONFIG_WX_SQLITE3_HARD_CODEC)
CONFIG_SDK_MODULE_MBEDTLS=y
CONFIG_CUSTOM_MBEDTLS_CFG_FILE=y
CONFIG_MBEDTLS_CFG_FILE="config-tls-generic.h"
CONFIG_MBEDTLS_HARDWARE_ENTROPY=y
# CONFIG_MBEDTLS_HARDWARE_AES=y
# CONFIG_MBEDTLS_HARDWARE_SHA1=y
# CONFIG_MBEDTLS_HARDWARE_SHA256=y
# CONFIG_MBEDTLS_HARDWARE_SHA512=y
# CONFIG_MBEDTLS_HARDWARE_AES_CCM=y
# CONFIG_MBEDTLS_HARDWARE_AES_GCM=y
# CONFIG_MBEDTLS_HARDWARE_ECC=y

# System support
CONFIG_MBEDTLS_HAVE_ASM=y
CONFIG_MBEDTLS_HAVE_TIME_DATE=y
CONFIG_MBEDTLS_SSL_ALPN=y

# Save RAM at the expense of ROM
CONFIG_MBEDTLS_AES_ROM_TABLES=y
# mbed TLS feature support
CONFIG_MBEDTLS_CIPHER_MODE_CBC_ENABLED=y
CONFIG_MBEDTLS_KEY_EXCHANGE_RSA_ENABLED=y
CONFIG_MBEDTLS_KEY_EXCHANGE_ECDHE_RSA_ENABLED=y
# Supported TLS versions
CONFIG_MBEDTLS_TLS_VERSION_1_0=y
CONFIG_MBEDTLS_TLS_VERSION_1_1=y
CONFIG_MBEDTLS_TLS_VERSION_1_2=y
# mbed TLS modules
CONFIG_MBEDTLS_CIPHER_AES_ENABLED=y
CONFIG_MBEDTLS_CIPHER=y
CONFIG_MBEDTLS_CTR_DRBG_ENABLED=y
CONFIG_MBEDTLS_ENTROPY_ENABLED=y
CONFIG_MBEDTLS_MD=y
CONFIG_MBEDTLS_MAC_MD5_ENABLED=y
CONFIG_MBEDTLS_HASH_MD5_ENABLED=y
CONFIG_MBEDTLS_MAC_SHA1_ENABLED=y
CONFIG_MBEDTLS_HASH_SHA1_ENABLED=y
CONFIG_MBEDTLS_MAC_SHA256_ENABLED=y
CONFIG_MBEDTLS_SHA256_SMALLER=y
CONFIG_MBEDTLS_HASH_SHA256_ENABLED=y
CONFIG_MBEDTLS_DTLS=y
CONFIG_MBEDTLS_SERVER_NAME_INDICATION=y
CONFIG_MBEDTLS_ECDH_C=y
CONFIG_MBEDTLS_ECP_C=y
CONFIG_MBEDTLS_CIPHER_GCM_ENABLED=y
CONFIG_MBEDTLS_ECP_DP_SECP256R1_ENABLED=y
CONFIG_MBEDTLS_MAC_SHA512_ENABLED=y
CONFIG_MBEDTLS_HASH_SHA512_ENABLED=y
CONFIG_MBEDTLS_PEM_CERTIFICATE_FORMAT=y
CONFIG_MBEDTLS_SSL_MAX_CONTENT_LEN=16384
CONFIG_MBEDTLS_CTR_DRBG_ENABLED=y

# CONFIG_MBEDTLS_DEBUG=y

CONFIG_MBEDTLS_INTERNAL_MEM_ALLOC=n
CONFIG_MBEDTLS_EXTERNAL_MEM_ALLOC=y

# LISA WIFI
#
# 注：前期调查一度怀疑 arcs_evb 板 wifi 在启动早期挂死（0 字节串口、
# 连 SDK banner 都没出），后来定位到是 cskburn 用了错的 reset 策略
# （需要 `--reset-strategy cross-coupled` 对应 Q1/Q2 交叉耦合复位电路）。
# 用对 reset 策略后，wifi 栈在 arcs_evb 上完全正常（扫描到 AP、shell
# 正常）。完整分析见 branch fix/macos-build-link-slow 的调试记录。
CONFIG_LISA_WIFI=y
CONFIG_MAC_MANAGER=y
CONFIG_MAC_MANAGER_MAC_BY_CHIP_ID=y
CONFIG_WIFI_MANAGER=y
CONFIG_LWIP=y
CONFIG_WIFI=y
CONFIG_WIFI_TX_BUF_COPY=y
CONFIG_WIFI_LWIP_SAME_CORE=y
CONFIG_LWIP_TX_BUF_COPY=y
CONFIG_LWIP_OPTION_LWIP_DNS=y
CONFIG_LWIP_OPTION_SO_REUSE=y
CONFIG_MODULE_ZE_TLS=y
CONFIG_MODULE_HTTPCLIENT=y
CONFIG_MODULE_NOPOLL=y
CONFIG_MODULE_CORESNTP=y

# 使能 libjpeg-turbo
CONFIG_SDK_MODULE_LIBJPEG_TURBO=y
CONFIG_LISA_JPEG=y

# Use global component instead of sample-local sources
CONFIG_LISA_MEDIA_PLAYER=y
CONFIG_SDK_MODULE_LVGL8=y
CONFIG_AVI_PLAYER_LVGL_RENDER=y


# Enable MP3 audio in AVI (WAVE_FORMAT_MPEGLAYER3=0x0055)
CONFIG_AVI_PLAYER_AUDIO_MP3=y

# MP3 decode resources (tune if needed)
CONFIG_AVI_PLAYER_MP3_DECODE_QUEUE_DEPTH=8
CONFIG_AVI_PLAYER_MP3_DECODE_THREAD_STACK_SIZE=12288
CONFIG_AVI_PLAYER_MP3_DECODE_THREAD_PRIORITY=3

# HTTP Range streaming (needed for online playback)
CONFIG_AVI_PLAYER_HTTP_RANGE=y
CONFIG_AVI_PLAYER_WIFI_CONNECT_TIMEOUT_S=30

CONFIG_AVI_PLAYER_PROFILE_LOG=y
CONFIG_AVI_PLAYER_MAX_VIDEO_AHEAD_MS=500
CONFIG_AVI_PLAYER_MJPEG_DECODE_THREAD_PRIORITY=3

# lisa_jpeg hw decoder tuning for av_render (reduce timeout-retry jitter)
CONFIG_LISA_JPEG_DECODER_RGB565_ONLY=y
CONFIG_LISA_JPEG_DECODER_WAIT_TIMEOUT_US=45000
CONFIG_LISA_JPEG_DECODE_GPDMA_IN_CH=5
CONFIG_LISA_JPEG_DECODE_GPDMA_OUT_CH=4
CONFIG_AVI_PLAYER_LISA_JPEG_SOFT_FALLBACK=y

# TinyUSB 配置
CONFIG_TINY_USB=y
CONFIG_TINY_USB_USE_CUSTOM_CONFIG_FILE=y
CONFIG_TINY_USB_CONFIG_FILE="tusb_config.h"

# 系统配置
CONFIG_LINK_OPTION_NOSYS_SPECS=y

CONFIG_LISA_QSPILCD_GPDMA_CH=1

CONFIG_LISA_AUDIO_RECORD_MIC0_ENABLE=n
CONFIG_LISA_AUDIO_RECORD_MIC1_ENABLE=n
CONFIG_AVI_PLAYER_STATS_LOG=y

CONFIG_AVI_PLAYER_FIXED_FPS=y
CONFIG_AVI_PLAYER_FIXED_FPS_VALUE=20

# Adaptive FPS: reduce video pressure when decode/push cost remains high
CONFIG_AVI_PLAYER_ADAPTIVE_DECODE_SLOW_FPS=y
CONFIG_AVI_PLAYER_ADAPTIVE_DECODE_SLOW_FPS_MIN=12
CONFIG_AVI_PLAYER_ADAPTIVE_DECODE_SLOW_FPS_STEP=2
CONFIG_AVI_PLAYER_ADAPTIVE_DECODE_SLOW_WINDOW_FRAMES=16
CONFIG_AVI_PLAYER_ADAPTIVE_DECODE_SLOW_DOWN_MS=45
CONFIG_AVI_PLAYER_ADAPTIVE_DECODE_SLOW_UP_MS=32

CONFIG_AVI_PLAYER_VIDEO_DECODER_MJPEG=y
```

## src/main.c
```c
/*
 * Copyright (c) 2025, LISTENAI
 *
 * SPDX-License-Identifier: Apache-2.0
 *
 * Sample-local pinmux / display / touch 初始化。
 * 参考 samples/media/lvgl/lvgl8/widgets/src/main.c 的模式：
 *   - 应用层覆写 arcs_evb 默认 pinmux (spi1 / gpioa / gpiob / i2c0 / pwm)，
 *     以便 LCD_CS(PB5) 作为 GPIO 由应用驱动，而不是 SPI 硬件 CS；
 *   - 不经过 board_* 默认配置接口，直接构造 lisa_display_config_t /
 *     lisa_touch_bus_config_t。
 */

#include <stdint.h>
#include <stdbool.h>
#include <stddef.h>
#include <stdio.h>
#include <string.h>
#include <stdlib.h>

#include "lisa_device.h"
#include "lisa_display.h"
#include "lisa_touch.h"
#include "lisa_thread.h"
#include "lisa_mem.h"
#include "lisa_gpio.h"
#include "lisa_sdmmc.h"

#include "lv_port_indev.h"
#include "lv_port_disp.h"
#include "lvgl.h"

#include "FreeRTOSConfig.h"
#include "FreeRTOS.h"
#include "task.h"
#include "semphr.h"

#include "IOMuxManager.h"
#include "ClockManager.h"
#include "board.h"
#include "log_print.h"
#include "tusb.h"
#include "arcs_ap.h"
#include "disk/disk_access.h"
#include <disk/disk.h>

#include "lsfs.h"
#include "lvfs.h"

#include "app_context.h"
#include "ui_main_menu.h"
#include "ui_playback.h"
#include "wifi_utils.h"

#ifdef LOG_TAG
#undef LOG_TAG
#endif
#define LOG_TAG "avi_player"
#include <lisa_log.h>

#define TOUCH_DEVICE        "touch_cst328"
#define I2C_DEVICE          "i2c0"
/* SDMMC_MOUNT_POINT 与 AUDIO_DEVICE_NAME 由 app_context.h 定义 */

#define USBD_STACK_SIZE (3 * configMINIMAL_STACK_SIZE)
#define DISK_BLOCK_SIZE 512

/* ================================================================
 * Board Pin Mux override (SPI LCD + CST328 touch on arcs_evb)
 * 与 samples/media/lvgl/lvgl8/widgets 的覆写保持一致，差异点：
 *   - 同样是 SPI1 4-wire + PB5 软 CS + PA0 PWM 背光；
 *   - avi_player 不改 SDIO / UART / audio，这些沿用 board 默认 pinmux。
 * ================================================================ */
#ifdef CONFIG_BOARD_ARCS_EVB

#define LCD_CS_PIN          5
#define LCD_SPI_CLK_PIN     3
#define LCD_SPI_DATA_PIN    1

/* Touch I2C 引脚定义 */
#define LISA_TOUCH_I2C_SDA_PORT  CSK_IOMUX_PAD_A
#define LISA_TOUCH_I2C_SDA_PIN   22
#define LISA_TOUCH_I2C_SDA_FUNC  8

#define LISA_TOUCH_I2C_SCL_PORT  CSK_IOMUX_PAD_A
#define LISA_TOUCH_I2C_SCL_PIN   23
#define LISA_TOUCH_I2C_SCL_FUNC  8

/* Touch GPIO 引脚定义 */
#define LISA_TOUCH_I2C_RST_PORT  CSK_IOMUX_PAD_A
#define LISA_TOUCH_I2C_RST_PIN   25
#define LISA_TOUCH_I2C_RST_FUNC  0

#define LISA_TOUCH_I2C_INT_PORT  CSK_IOMUX_PAD_A
#define LISA_TOUCH_I2C_INT_PIN   24
#define LISA_TOUCH_I2C_INT_FUNC  0

void lisa_gpioa_pinmux()
{
    IOMuxManager_PinConfigure(CSK_IOMUX_PAD_A, LCD_RST_PIN, CSK_IOMUX_FUNC_ALTER1);
    IOMuxManager_PinConfigure(LISA_TOUCH_I2C_RST_PORT, LISA_TOUCH_I2C_RST_PIN, LISA_TOUCH_I2C_RST_FUNC);
    IOMuxManager_PinConfigure(LISA_TOUCH_I2C_INT_PORT, LISA_TOUCH_I2C_INT_PIN, LISA_TOUCH_I2C_INT_FUNC);
    IOMuxManager_PinConfigure(CSK_IOMUX_PAD_A, PA_EN_PIN, CSK_IOMUX_FUNC_DEFAULT);
}

void lisa_gpiob_pinmux()
{
    IOMuxManager_PinConfigure(CSK_IOMUX_PAD_B, LCD_TE_PIN, CSK_IOMUX_FUNC_DEFAULT);
    IOMuxManager_PinConfigure(CSK_IOMUX_PAD_B, LCD_CD_PIN, CSK_IOMUX_FUNC_DEFAULT);
    IOMuxManager_PinConfigure(CSK_IOMUX_PAD_B, LCD_CS_PIN, CSK_IOMUX_FUNC_DEFAULT);
}

void lisa_i2c0_pinmux()
{
    IOMuxManager_PinConfigure(LISA_TOUCH_I2C_SDA_PORT, LISA_TOUCH_I2C_SDA_PIN, LISA_TOUCH_I2C_SDA_FUNC);
    IOMuxManager_PinConfigure(LISA_TOUCH_I2C_SCL_PORT, LISA_TOUCH_I2C_SCL_PIN, LISA_TOUCH_I2C_SCL_FUNC);
}

void lisa_spi1_pinmux()
{
    IOMuxManager_PinConfigure(CSK_IOMUX_PAD_B, LCD_SPI_CLK_PIN, CSK_IOMUX_FUNC_ALTER6);
    IOMuxManager_PinConfigure(CSK_IOMUX_PAD_B, LCD_SPI_DATA_PIN, CSK_IOMUX_FUNC_ALTER6);
}

void lisa_pwm_pinmux()
{
    IOMuxManager_PinConfigure(CSK_IOMUX_PAD_A, LCD_PWM_PIN, CSK_IOMUX_FUNC_ALTER12);
}
#endif /* CONFIG_BOARD_ARCS_EVB */

lisa_device_t *display_device = NULL;

/* ================================================================
 * USB MSC Callbacks (required by TinyUSB linker)
 * ================================================================ */

static bool ejected = false;

void tud_mount_cb(void)         { ejected = false; }
void tud_umount_cb(void)        { }
void tud_suspend_cb(bool rw)    { (void)rw; }
void tud_resume_cb(void)        { }

void tud_msc_inquiry_cb(uint8_t lun, uint8_t vendor_id[8], uint8_t product_id[16], uint8_t product_rev[4])
{
    (void)lun;
    memcpy(vendor_id, "TinyUSB", 7);
    memcpy(product_id, "Mass Storage", 12);
    memcpy(product_rev, "1.0", 3);
}

bool tud_msc_test_unit_ready_cb(uint8_t lun)
{
    (void)lun;
    if (ejected) { tud_msc_set_sense(lun, SCSI_SENSE_NOT_READY, 0x3a, 0x00); return false; }
    return true;
}

void tud_msc_capacity_cb(uint8_t lun, uint32_t *block_count, uint16_t *block_size)
{
    (void)lun;
    const char *pdrv = CONFIG_DISK_SDMMC_VOLUME_NAME;
    uint32_t sc = 0, ss = 0;
    if (disk_access_ioctl(pdrv, DISK_IOCTL_GET_SECTOR_COUNT, &sc) != 0 ||
        disk_access_ioctl(pdrv, DISK_IOCTL_GET_SECTOR_SIZE, &ss) != 0) {
        sc = 0x1000; ss = DISK_BLOCK_SIZE;
    }
    *block_count = sc; *block_size = ss;
}

bool tud_msc_start_stop_cb(uint8_t lun, uint8_t pc, bool start, bool load_eject)
{
    (void)lun; (void)pc;
    if (load_eject) {
        if (!start) {
            if (disk_access_status(CONFIG_DISK_SDMMC_VOLUME_NAME) == DISK_STATUS_OK) ejected = true;
            else return false;
        } else { ejected = false; }
    }
    return true;
}

int32_t tud_msc_read10_cb(uint8_t lun, uint32_t lba, uint32_t offset, void *buffer, uint32_t bufsize)
{
    (void)lun;
    const char *pdrv = CONFIG_DISK_SDMMC_VOLUME_NAME;
    if (disk_access_status(pdrv) != DISK_STATUS_OK) { tud_msc_set_sense(lun, SCSI_SENSE_NOT_READY, 0x3A, 0x00); return -1; }
    if (disk_access_read(pdrv, buffer, lba, bufsize / DISK_BLOCK_SIZE) != 0) { tud_msc_set_sense(lun, SCSI_SENSE_MEDIUM_ERROR, 0x03, 0x00); return -1; }
    return bufsize;
}

int32_t tud_msc_write10_cb(uint8_t lun, uint32_t lba, uint32_t offset, uint8_t *buffer, uint32_t bufsize)
{
    (void)lun;
    const char *pdrv = CONFIG_DISK_SDMMC_VOLUME_NAME;
    if (disk_access_status(pdrv) != DISK_STATUS_OK) { tud_msc_set_sense(lun, SCSI_SENSE_NOT_READY, 0x3A, 0x00); return -1; }
    if (disk_access_write(pdrv, buffer, lba, bufsize / DISK_BLOCK_SIZE) != 0) { tud_msc_set_sense(lun, SCSI_SENSE_MEDIUM_ERROR, 0x03, 0x00); return -1; }
    return bufsize;
}

bool tud_msc_is_writable_cb(uint8_t lun) { (void)lun; return disk_access_status(CONFIG_DISK_SDMMC_VOLUME_NAME) == DISK_STATUS_OK; }

int32_t tud_msc_scsi_cb(uint8_t lun, uint8_t const scsi_cmd[16], void *buffer, uint16_t bufsize)
{
    (void)buffer; (void)bufsize;
    tud_msc_set_sense(lun, SCSI_SENSE_ILLEGAL_REQUEST, 0x20, 0x00);
    return -1;
}

void usb_device_task(void *param)
{
    (void)param;
    tud_init(BOARD_TUD_RHPORT);
    while (1) { tud_task(); }
}

void user_usbd_msc_init(void)
{
    __HAL_CRM_USB_CLK_ENABLE();
    IP_CMN_SYS->REG_USB_CTRL1.bit.USBC_CFG_IDDIG = 0x1;
    IP_CMN_SYS->REG_USB_CTRL1.bit.UTMI_DATABUS16_8 = 0x1;
    tud_disconnect();
    tusb_init();
    tud_connect();
}

/* ================================================================
 * SDMMC / Filesystem / Speaker PA
 * ================================================================ */

struct lsfs_mount_t sdmmc_mnt = {
    .type = LSFS_FATFS,
    .mnt_point = SDMMC_MOUNT_POINT,
    .fs_data = NULL,
};

static int board_storage_init(void)
{
    lisa_device_t *sdmmc = lisa_device_get("sdmmc0");
    if (!sdmmc) { LISA_LOGE(LOG_TAG, "No sdmmc device"); return -1; }
    if (lisa_sdmmc_probe(sdmmc) != LISA_DEVICE_OK) { LISA_LOGE(LOG_TAG, "Disk probe fail"); return -1; }
    if (lisa_sdmmc_status(sdmmc) != LISA_SDMMC_STATUS_OK) { LISA_LOGE(LOG_TAG, "Disk not ready"); return -1; }

    uint32_t sc, ss;
    lisa_sdmmc_get_sector_count(sdmmc, &sc);
    lisa_sdmmc_get_sector_size(sdmmc, &ss);
    LISA_LOGI(LOG_TAG, "SD: %u sectors, %llu MB", sc, (uint64_t)sc * ss / (1024*1024));

    disk_init(NULL);
    lvfs_init();
    lsfs_init();

    int ret = lsfs_mount(&sdmmc_mnt);
    if (ret != 0) {
        LISA_LOGW(LOG_TAG, "Mount failed, formatting...");
        lsfs_mkfs(LSFS_FATFS, "SD:", NULL, 0);
        ret = lsfs_mount(&sdmmc_mnt);
    }
    if (ret != 0) { LISA_LOGE(LOG_TAG, "FS mount failed: %d", ret); return ret; }
    LISA_LOGI(LOG_TAG, "FS mounted");

    /* 确保 README 约定的目录结构存在：Video/、URL/、WiFi/
     * 首次上电或格式化后用户不用再手动建目录，直接丢 avi / ini 即可。
     */
    static const char * const required_dirs[] = {
        SDMMC_MOUNT_POINT "/Video",
        SDMMC_MOUNT_POINT "/URL",
        SDMMC_MOUNT_POINT "/WiFi",
    };
    for (size_t i = 0; i < sizeof(required_dirs) / sizeof(required_dirs[0]); ++i) {
        struct lsfs_dirent ent;
        if (lsfs_stat(required_dirs[i], &ent) == 0) {
            continue;   /* 已存在，跳过 */
        }
        int mret = lsfs_mkdir(required_dirs[i]);
        if (mret == 0) {
            LISA_LOGI(LOG_TAG, "Created %s", required_dirs[i]);
        } else {
            LISA_LOGW(LOG_TAG, "mkdir %s failed: %d", required_dirs[i], mret);
        }
    }

    /* Speaker PA enable (PA_EN_PIN on gpioa) */
    lisa_device_t *gpio_dev = lisa_device_get("gpioa");
    if (gpio_dev && lisa_device_ready(gpio_dev)) {
        lisa_gpio_configure(gpio_dev, PA_EN_PIN, LISA_GPIO_OUTPUT | LISA_GPIO_OUTPUT_INIT_LOW);
        lisa_gpio_write_pin(gpio_dev, PA_EN_PIN, LISA_GPIO_HIGH);
    }

    return 0;
}

/* ================================================================
 * UI Task - same structure as lvgl8_widgets task_ui
 * ================================================================ */

static void task_ui(void *pvParameters)
{
    (void)pvParameters;

    /* Build our main menu (replaces lv_demo_widgets) */
    ui_main_menu_create();

    LISA_LOGI(LOG_TAG, "UI ready");

    // 避免开机花屏
    lv_task_handler();

    while (1) {
        /* During playback, refresh video frame from render context */
        app_context_t *ctx = app_ctx_get();
        if (ctx->current_screen == SCREEN_PLAYBACK) {
            avi_lvgl_render_ctx_t *rctx = &ctx->render_ctx;
            if (rctx->lock && xSemaphoreTake(rctx->lock, pdMS_TO_TICKS(5)) == pdTRUE) {
                if (rctx->frame_dirty) {
                    ui_playback_refresh_frame();
                    rctx->frame_dirty = false;
                }
                xSemaphoreGive(rctx->lock);
            }
        }

        uint32_t wait_time = lv_task_handler();
        if (wait_time == 0 || wait_time > 20) {
            wait_time = 20;
        }
        lisa_thread_mdelay(wait_time);
    }
}

/* ================================================================
 * main() - Display/Touch init 与 lvgl8_widgets sample 对齐，
 *          外加 storage / wifi / audio 初始化。
 * ================================================================ */

int main(int argc, char **argv)
{
    (void)argc; (void)argv;

    LISA_LOGI(LOG_TAG, "Lisa Media Player starting");

    /* --- 1. Storage init (before display, non-display stuff) --- */
    board_storage_init();

    /* --- 2. Display + Touch --- */
    lv_init();

    lisa_device_t *gpioa_dev = lisa_device_get("gpioa");
    lisa_device_t *gpiob_dev = lisa_device_get("gpiob");

    lisa_display_config_t display_config = {
        .bus_type = LISA_DISPLAY_BUS_SPI_4WIRE,
        .bus_config = {.spi_4wire =
                           {
                               .spi_dev = lisa_device_get("spi1"),
                               .cs_gpio = gpiob_dev,
                               .cs_pin = LCD_CS_PIN,
                               .dc_gpio = gpiob_dev,
                               .dc_pin = LCD_CD_PIN,
                               .spi_freq = 50 * 1000 * 1000,
                           }},
        .backlight = {.type = LISA_DISPLAY_BACKLIGHT_TYPE_PWM,
                      .blacklight_polarity = LISA_DISPLAY_BLACKLIGHT_POLARITY_LOW,
                      .config.pwm = {.channel = 0, .dev = lisa_device_get("pwm0"), .freq = 2000}},
        .rst_gpio = gpioa_dev,
        .rst_pin = LCD_RST_PIN,
    };

    display_device = lisa_device_get("display");
    if (!display_device) {
        LISA_LOGE(LOG_TAG, "Failed to get display device");
        return -1;
    }

    if (lisa_display_attach_bus(display_device, &display_config) != 0) {
        LISA_LOGE(LOG_TAG, "lisa_display_attach_bus failed");
        return -1;
    }
    lv_port_disp_init(display_device);

    /* --- Touch --- */
    lisa_device_t *touch_dev = lisa_device_get(TOUCH_DEVICE);
    if (!lisa_device_ready(touch_dev)) {
        LISA_LOGE(LOG_TAG, "Error: %s device not ready", TOUCH_DEVICE);
        return -1;
    }

    lisa_device_t *i2c_dev = lisa_device_get(I2C_DEVICE);
    if (!lisa_device_ready(i2c_dev)) {
        LISA_LOGE(LOG_TAG, "Error: %s device not ready", I2C_DEVICE);
        return -1;
    }

    lisa_display_blanking_off(display_device);

    lisa_touch_bus_config_t bus_config = {
        .bus_type = LISA_TOUCH_BUS_I2C,
        .config = {
            .i2c = {
                .i2c_dev = i2c_dev,
                .int_gpio = gpioa_dev,
                .int_pin = LISA_TOUCH_I2C_INT_PIN,
                .rst_gpio = gpioa_dev,
                .rst_pin = LISA_TOUCH_I2C_RST_PIN,
            }
        }
    };
    int ret = lisa_touch_attach_bus(touch_dev, &bus_config);
    if (ret != 0) {
        LISA_LOGE(LOG_TAG, "Error: Touch bus attach failed (code: %d)", ret);
        return -1;
    }
    lv_port_indev_init(touch_dev);

    lisa_display_set_brightness(display_device, 90);

    /* --- 3. App context + WiFi --- */
    app_ctx_init(display_device, lisa_device_get(AUDIO_DEVICE_NAME));
    wifi_utils_init();

    /* --- 4. Start UI task (same pattern as lvgl8_widgets) --- */
    xTaskCreate(task_ui, "task_ui", 4 * 1024, NULL, configMAX_PRIORITIES - 2, NULL);

    LISA_LOGI(LOG_TAG, "UI task started");
    return 0;
}
```

## src/app_context.c
```c
/*
 * Copyright (c) 2025, LISTENAI
 *
 * SPDX-License-Identifier: Apache-2.0
 */
#include "app_context.h"
#include <string.h>
#include "ui_main_menu.h"
#include "ui_usb_msc.h"
#include "ui_local_list.h"
#include "ui_online_list.h"
#include "ui_playback.h"
#include "lisa_thread.h"

#ifdef LOG_TAG
#undef LOG_TAG
#endif
#define LOG_TAG "app_context"
#include <lisa_log.h>

static app_context_t s_app_ctx;

app_context_t *app_ctx_get(void)
{
    return &s_app_ctx;
}

void app_ctx_init(lisa_device_t *display_dev, lisa_device_t *audio_dev)
{
    memset(&s_app_ctx, 0, sizeof(s_app_ctx));
    s_app_ctx.display_dev = display_dev;
    s_app_ctx.audio_dev = audio_dev;
    s_app_ctx.lv_mutex = xSemaphoreCreateMutex();
    s_app_ctx.current_screen = SCREEN_MAIN_MENU;
    s_app_ctx.previous_screen = SCREEN_MAIN_MENU;
}

static void destroy_current_screen(void)
{
    switch (s_app_ctx.current_screen) {
    case SCREEN_MAIN_MENU:
        ui_main_menu_destroy();
        break;
    case SCREEN_USB_MSC:
        ui_usb_msc_destroy();
        break;
    case SCREEN_LOCAL_LIST:
        ui_local_list_destroy();
        break;
    case SCREEN_ONLINE_LIST:
        ui_online_list_destroy();
        break;
    case SCREEN_PLAYBACK:
        ui_playback_destroy();
        break;
    }
}

static void create_screen(screen_id_t id)
{
    switch (id) {
    case SCREEN_MAIN_MENU:
        ui_main_menu_create();
        break;
    case SCREEN_USB_MSC:
        ui_usb_msc_create();
        break;
    case SCREEN_LOCAL_LIST:
        ui_local_list_create();
        break;
    case SCREEN_ONLINE_LIST:
        ui_online_list_create();
        break;
    case SCREEN_PLAYBACK:
        /* Playback screen is created via ui_playback_create(path, is_url) directly */
        break;
    }
}

void app_switch_screen(screen_id_t id)
{
    LISA_LOGI(LOG_TAG, "Switching screen: %d -> %d", s_app_ctx.current_screen, id);

    if (id != SCREEN_PLAYBACK) {
        s_app_ctx.previous_screen = s_app_ctx.current_screen;
    }

    /*
     * IMPORTANT: create the new screen FIRST (which calls lv_scr_load),
     * then destroy the old screen. This avoids deleting the screen
     * that the current button event callback is running on.
     */
    screen_id_t old_screen = s_app_ctx.current_screen;
    s_app_ctx.current_screen = id;
    create_screen(id);

    /* Now safe to destroy old screen (it's no longer the active screen) */
    switch (old_screen) {
    case SCREEN_MAIN_MENU:   ui_main_menu_destroy(); break;
    case SCREEN_USB_MSC:     ui_usb_msc_destroy(); break;
    case SCREEN_LOCAL_LIST:  ui_local_list_destroy(); break;
    case SCREEN_ONLINE_LIST: ui_online_list_destroy(); break;
    case SCREEN_PLAYBACK:    ui_playback_destroy(); break;
    }
}

/* Note: app_ui_task is no longer used.
 * The UI task (task_ui) is defined in main.c following the lvgl8_widgets sample pattern:
 * - All LVGL init happens in main()
 * - task_ui just builds UI and runs lv_task_handler() loop
 */
```

## src/app_context.h
```c
/*
 * Copyright (c) 2025, LISTENAI
 *
 * SPDX-License-Identifier: Apache-2.0
 */
#ifndef APP_CONTEXT_H
#define APP_CONTEXT_H

#include <stdint.h>
#include <stdbool.h>
#include "lisa_device.h"
#include "FreeRTOS.h"
#include "semphr.h"
#include "lvgl.h"

#define SDMMC_DEVICE_NAME   "sdmmc0"
#define SDMMC_DEVICE        "SD:"
#define SDMMC_MOUNT_POINT   "/" SDMMC_DEVICE
#define AUDIO_DEVICE_NAME   "audio0"

#define VIDEO_DIR           SDMMC_MOUNT_POINT "/Video"
#define URL_DIR             SDMMC_MOUNT_POINT "/URL"
#define WIFI_CONFIG_PATH    SDMMC_MOUNT_POINT "/WiFi/wifi.ini"

typedef enum {
    SCREEN_MAIN_MENU,
    SCREEN_USB_MSC,
    SCREEN_LOCAL_LIST,
    SCREEN_ONLINE_LIST,
    SCREEN_PLAYBACK,
} screen_id_t;

/* LVGL video render context for AVI playback */
typedef struct {
    SemaphoreHandle_t lock;
    lv_obj_t *screen;
    lv_obj_t *img;
    lv_img_dsc_t img_dsc;
    uint8_t *frame_buf;
    size_t frame_buf_size;
    uint16_t frame_w;
    uint16_t frame_h;
    bool frame_dirty;
    bool first_frame_arrived;
} avi_lvgl_render_ctx_t;

typedef struct {
    lisa_device_t *display_dev;
    lisa_device_t *audio_dev;
    lisa_device_t *touch_dev;
    SemaphoreHandle_t lv_mutex;
    screen_id_t current_screen;
    screen_id_t previous_screen;
    bool ui_ready;
    /* Video render context shared with playback */
    avi_lvgl_render_ctx_t render_ctx;
} app_context_t;

/* Global app context */
app_context_t *app_ctx_get(void);
void app_ctx_init(lisa_device_t *display_dev, lisa_device_t *audio_dev);

/* Screen navigation */
void app_switch_screen(screen_id_t id);

/* LVGL UI task entry (run as FreeRTOS task) */
void app_ui_task(void *param);

/* Screen create/destroy (implemented by each ui_*.c) */
void ui_main_menu_create(void);
void ui_main_menu_destroy(void);
void ui_usb_msc_create(void);
void ui_usb_msc_destroy(void);
void ui_local_list_create(void);
void ui_local_list_destroy(void);
void ui_online_list_create(void);
void ui_online_list_destroy(void);
void ui_playback_create(const char *path_or_url, bool is_url);
void ui_playback_destroy(void);

/* USB MSC functions (defined in main.c, called from ui_usb_msc.c) */
void user_usbd_msc_init(void);
void usb_device_task(void *param);

#endif /* APP_CONTEXT_H */
```

## src/fs_utils.c
```c
/*
 * Copyright (c) 2025, LISTENAI
 *
 * SPDX-License-Identifier: Apache-2.0
 */
#include "fs_utils.h"
#include "lsfs.h"
#include <stdio.h>
#include <string.h>
#include <ctype.h>

#ifdef LOG_TAG
#undef LOG_TAG
#endif
#define LOG_TAG "fs_utils"
#include <lisa_log.h>

static bool str_ends_with_ci(const char *str, const char *suffix)
{
    size_t str_len = strlen(str);
    size_t suf_len = strlen(suffix);
    if (str_len < suf_len) {
        return false;
    }
    const char *end = str + str_len - suf_len;
    for (size_t i = 0; i < suf_len; i++) {
        if (tolower((unsigned char)end[i]) != tolower((unsigned char)suffix[i])) {
            return false;
        }
    }
    return true;
}

static void trim_trailing(char *s)
{
    size_t len = strlen(s);
    while (len > 0 && (s[len - 1] == '\n' || s[len - 1] == '\r' || s[len - 1] == ' ')) {
        s[--len] = '\0';
    }
}

int fs_list_avi_files(const char *dir_path, fs_file_list_t *out)
{
    if (!dir_path || !out) {
        return -1;
    }

    memset(out, 0, sizeof(*out));

    struct lsfs_dir_t dir;
    lsfs_dir_t_init(&dir);

    int ret = lsfs_opendir(&dir, dir_path);
    if (ret != 0) {
        LISA_LOGW(LOG_TAG, "Cannot open dir: %s (ret=%d)", dir_path, ret);
        return -1;
    }

    struct lsfs_dirent entry;
    while (out->count < FS_MAX_ENTRIES) {
        ret = lsfs_readdir(&dir, &entry);
        if (ret != 0) {
            break;
        }
        if (entry.name[0] == '\0') {
            break;
        }
        if (entry.type != LSFS_DIR_ENTRY_FILE) {
            continue;
        }
        if (!str_ends_with_ci(entry.name, ".avi")) {
            continue;
        }

        strncpy(out->entries[out->count].name, entry.name, FS_MAX_FILENAME_LEN - 1);
        out->entries[out->count].name[FS_MAX_FILENAME_LEN - 1] = '\0';
        out->entries[out->count].size = (uint32_t)entry.size;
        out->count++;
    }

    lsfs_closedir(&dir);
    LISA_LOGI(LOG_TAG, "Found %d AVI files in %s", out->count, dir_path);
    return 0;
}

int fs_list_urls(const char *dir_path, fs_url_list_t *out)
{
    if (!dir_path || !out) {
        return -1;
    }

    memset(out, 0, sizeof(*out));

    struct lsfs_dir_t dir;
    lsfs_dir_t_init(&dir);

    int ret = lsfs_opendir(&dir, dir_path);
    if (ret != 0) {
        LISA_LOGW(LOG_TAG, "Cannot open dir: %s (ret=%d)", dir_path, ret);
        return -1;
    }

    struct lsfs_dirent entry;
    while (1) {
        ret = lsfs_readdir(&dir, &entry);
        if (ret != 0 || entry.name[0] == '\0') {
            break;
        }
        if (entry.type != LSFS_DIR_ENTRY_FILE) {
            continue;
        }
        if (!str_ends_with_ci(entry.name, ".ini")) {
            continue;
        }

        /* Read URLs from this INI file */
        char filepath[128];
        snprintf(filepath, sizeof(filepath), "%s/%s", dir_path, entry.name);

        FILE *fp = fopen(filepath, "r");
        if (!fp) {
            LISA_LOGW(LOG_TAG, "Cannot open: %s", filepath);
            continue;
        }

        char line[FS_MAX_URL_LEN];
        while (out->count < FS_MAX_ENTRIES && fgets(line, sizeof(line), fp)) {
            trim_trailing(line);
            /* Skip empty lines and comments */
            if (line[0] == '\0' || line[0] == '#' || line[0] == ';') {
                continue;
            }
            /* Must look like a URL */
            if (strncmp(line, "http://", 7) != 0 && strncmp(line, "https://", 8) != 0) {
                continue;
            }

            strncpy(out->entries[out->count].url, line, FS_MAX_URL_LEN - 1);
            out->entries[out->count].url[FS_MAX_URL_LEN - 1] = '\0';

            /* Label: truncate URL for display */
            const char *path_start = strstr(line + 8, "/");
            if (path_start) {
                const char *name = strrchr(path_start, '/');
                if (name && name[1] != '\0') {
                    strncpy(out->entries[out->count].label, name + 1, FS_MAX_FILENAME_LEN - 1);
                } else {
                    strncpy(out->entries[out->count].label, line, FS_MAX_FILENAME_LEN - 1);
                }
            } else {
                strncpy(out->entries[out->count].label, line, FS_MAX_FILENAME_LEN - 1);
            }
            out->entries[out->count].label[FS_MAX_FILENAME_LEN - 1] = '\0';

            out->count++;
        }

        fclose(fp);
    }

    lsfs_closedir(&dir);
    LISA_LOGI(LOG_TAG, "Found %d URLs in %s", out->count, dir_path);
    return 0;
}

int fs_read_wifi_config(const char *file_path, fs_wifi_config_t *out)
{
    if (!file_path || !out) {
        return -1;
    }

    memset(out, 0, sizeof(*out));

    FILE *fp = fopen(file_path, "r");
    if (!fp) {
        LISA_LOGW(LOG_TAG, "Cannot open WiFi config: %s", file_path);
        return -1;
    }

    char line[128];
    while (fgets(line, sizeof(line), fp)) {
        trim_trailing(line);

        if (strncmp(line, "WIFI_SSID=", 10) == 0) {
            strncpy(out->ssid, line + 10, sizeof(out->ssid) - 1);
        } else if (strncmp(line, "WIFI_PWD=", 9) == 0) {
            strncpy(out->pwd, line + 9, sizeof(out->pwd) - 1);
        }
    }

    fclose(fp);

    out->valid = (out->ssid[0] != '\0');
    if (out->valid) {
        LISA_LOGI(LOG_TAG, "WiFi config: SSID=%s", out->ssid);
    } else {
        LISA_LOGW(LOG_TAG, "WiFi config invalid (no SSID)");
    }

    return out->valid ? 0 : -1;
}
```

## src/fs_utils.h
```c
/*
 * Copyright (c) 2025, LISTENAI
 *
 * SPDX-License-Identifier: Apache-2.0
 */
#ifndef FS_UTILS_H
#define FS_UTILS_H

#include <stdint.h>
#include <stdbool.h>

#define FS_MAX_FILENAME_LEN  64
#define FS_MAX_ENTRIES       32
#define FS_MAX_URL_LEN       256

typedef struct {
    char name[FS_MAX_FILENAME_LEN];
    uint32_t size;
} fs_file_entry_t;

typedef struct {
    fs_file_entry_t entries[FS_MAX_ENTRIES];
    int count;
} fs_file_list_t;

typedef struct {
    char url[FS_MAX_URL_LEN];
    char label[FS_MAX_FILENAME_LEN]; /* display name */
} fs_url_entry_t;

typedef struct {
    fs_url_entry_t entries[FS_MAX_ENTRIES];
    int count;
} fs_url_list_t;

typedef struct {
    char ssid[64];
    char pwd[64];
    bool valid;
} fs_wifi_config_t;

/**
 * List .avi files in a directory.
 * @param dir_path  e.g. "/SD:/Video"
 * @param out       populated file list
 * @return 0 on success, -1 on error
 */
int fs_list_avi_files(const char *dir_path, fs_file_list_t *out);

/**
 * List URLs from .ini files in a directory.
 * Each .ini file contains one URL per line.
 * @param dir_path  e.g. "/SD:/URL"
 * @param out       populated URL list
 * @return 0 on success, -1 on error
 */
int fs_list_urls(const char *dir_path, fs_url_list_t *out);

/**
 * Read WiFi config from an INI file.
 * Expected format: WIFI_SSID=xxx and WIFI_PWD=xxx on separate lines.
 * @param file_path  e.g. "/SD:/WiFi/wifi.ini"
 * @param out        populated config
 * @return 0 on success, -1 on error
 */
int fs_read_wifi_config(const char *file_path, fs_wifi_config_t *out);

#endif /* FS_UTILS_H */
```

## src/playback_mgr.c
```c
/*
 * Copyright (c) 2025, LISTENAI
 *
 * SPDX-License-Identifier: Apache-2.0
 */
#include "playback_mgr.h"
#include "avi_player.h"
#include "av_render.h"
#include "lisa_thread.h"
#include "lisa_mem.h"
#include "FreeRTOS.h"
#include "task.h"

#include <string.h>

#ifdef LOG_TAG
#undef LOG_TAG
#endif
#define LOG_TAG "playback_mgr"
#include <lisa_log.h>

#define PLAYBACK_TASK_STACK_SIZE  (8 * 1024)
#define PLAYBACK_TASK_PRIORITY    (configMAX_PRIORITIES - 3)

typedef struct {
    playback_type_t type;
    char path_or_url[256];
    lisa_device_t *display_dev;
    lisa_device_t *audio_dev;
    const av_render_video_renderer_ops_t *video_ops;
    void *video_user;
} playback_params_t;

static volatile bool s_active;
static avi_player_ctrl_t *s_ctrl;
static TaskHandle_t s_task_handle;
static playback_done_cb_t s_done_cb;
static void *s_done_user;
static playback_params_t s_params;

static void playback_task(void *param)
{
    playback_params_t *p = (playback_params_t *)param;

    av_render_cfg_t cfg = {
        .display_dev = (void *)p->display_dev,
        .audio_dev = (void *)p->audio_dev,
        .sync_mode = AV_RENDER_SYNC_AUDIO,
        .rotate_mode = AV_RENDER_ROTATE_NONE, /* LVGL handles rotation */
        .video_fps_limit =
#if defined(CONFIG_AVI_PLAYER_FIXED_FPS)
            (uint16_t)CONFIG_AVI_PLAYER_FIXED_FPS_VALUE,
#else
            0,
#endif
        .max_video_ahead_ms = (uint32_t)CONFIG_AVI_PLAYER_MAX_VIDEO_AHEAD_MS,
        .video_queue_depth = 6,
        .audio_queue_depth = 24,
    };

    av_render_t *render = NULL;
    if (av_render_open(&cfg, &render) != 0 || !render) {
        LISA_LOGE(LOG_TAG, "av_render_open failed");
        goto done;
    }

    if (p->video_ops) {
        av_render_register_video_renderer(render, p->video_ops, p->video_user);
    }

    s_ctrl = avi_player_ctrl_create();
    if (!s_ctrl) {
        LISA_LOGE(LOG_TAG, "avi_player_ctrl_create failed");
        av_render_close(render);
        goto done;
    }

    int ret = 0;
    if (p->type == PLAYBACK_TYPE_LOCAL_FILE) {
        LISA_LOGI(LOG_TAG, "Playing file: %s", p->path_or_url);
        ret = avi_player_play_file_ex(p->path_or_url, render, 0, s_ctrl);
    }
#if defined(CONFIG_AVI_PLAYER_HTTP_RANGE)
    else if (p->type == PLAYBACK_TYPE_HTTP_URL) {
        LISA_LOGI(LOG_TAG, "Playing URL: %s", p->path_or_url);
        ret = avi_player_play_url_ex(p->path_or_url, render, 0, s_ctrl);
    }
#endif

    LISA_LOGI(LOG_TAG, "Playback finished: ret=%d", ret);

    av_render_close(render);
    avi_player_ctrl_destroy(s_ctrl);
    s_ctrl = NULL;

done:
    s_active = false;
    s_task_handle = NULL;

    /* Notify done (only if not stopped externally) */
    if (s_done_cb) {
        s_done_cb(s_done_user);
    }

    vTaskDelete(NULL);
}

int playback_start(playback_type_t type,
                   const char *path_or_url,
                   lisa_device_t *display_dev,
                   lisa_device_t *audio_dev,
                   const av_render_video_renderer_ops_t *video_ops,
                   void *video_user)
{
    if (s_active) {
        LISA_LOGW(LOG_TAG, "Already playing");
        return -1;
    }

    memset(&s_params, 0, sizeof(s_params));
    s_params.type = type;
    strncpy(s_params.path_or_url, path_or_url, sizeof(s_params.path_or_url) - 1);
    s_params.display_dev = display_dev;
    s_params.audio_dev = audio_dev;
    s_params.video_ops = video_ops;
    s_params.video_user = video_user;

    s_active = true;

    if (xTaskCreate(playback_task, "playback",
                    PLAYBACK_TASK_STACK_SIZE, &s_params,
                    PLAYBACK_TASK_PRIORITY, &s_task_handle) != pdPASS) {
        LISA_LOGE(LOG_TAG, "Failed to create playback task");
        s_active = false;
        return -1;
    }

    return 0;
}

void playback_stop(void)
{
    if (!s_active) {
        return;
    }

    if (s_ctrl) {
        LISA_LOGI(LOG_TAG, "Requesting playback stop...");
        avi_player_stop(s_ctrl);
    }

    /* Wait for task to finish */
    int timeout_ms = 5000;
    while (s_active && timeout_ms > 0) {
        lisa_thread_mdelay(50);
        timeout_ms -= 50;
    }

    if (s_active) {
        LISA_LOGW(LOG_TAG, "Playback task did not exit in time");
    }
}

bool playback_is_active(void)
{
    return s_active;
}

void playback_set_done_callback(playback_done_cb_t cb, void *user)
{
    s_done_cb = cb;
    s_done_user = user;
}

int playback_get_progress(uint32_t *position_ms, uint32_t *duration_ms)
{
    if (!s_active || !s_ctrl) {
        return -1;
    }
    return avi_player_get_progress(s_ctrl, position_ms, duration_ms);
}
```

## src/playback_mgr.h
```c
/*
 * Copyright (c) 2025, LISTENAI
 *
 * SPDX-License-Identifier: Apache-2.0
 */
#ifndef PLAYBACK_MGR_H
#define PLAYBACK_MGR_H

#include <stdbool.h>
#include "lisa_device.h"
#include "av_render.h"

typedef enum {
    PLAYBACK_TYPE_LOCAL_FILE,
    PLAYBACK_TYPE_HTTP_URL,
} playback_type_t;

typedef void (*playback_done_cb_t)(void *user);

/**
 * Start playback in a background FreeRTOS task.
 * @param type         local file or HTTP URL
 * @param path_or_url  file path or URL string
 * @param display_dev  display device
 * @param audio_dev    audio device (can be NULL)
 * @param video_ops    LVGL video renderer ops (can be NULL for default)
 * @param video_user   user data for video_ops
 * @return 0 on success, -1 if already playing or error
 */
int playback_start(playback_type_t type,
                   const char *path_or_url,
                   lisa_device_t *display_dev,
                   lisa_device_t *audio_dev,
                   const av_render_video_renderer_ops_t *video_ops,
                   void *video_user);

/**
 * Stop current playback and wait for task to exit.
 */
void playback_stop(void);

/**
 * @return true if playback task is running
 */
bool playback_is_active(void);

/**
 * Set callback invoked when playback finishes naturally (not via stop).
 * Called from the playback task context.
 */
void playback_set_done_callback(playback_done_cb_t cb, void *user);

/**
 * Get current playback progress.
 * @param position_ms  [out] current position in ms (can be NULL)
 * @param duration_ms  [out] total duration in ms (can be NULL)
 * @return 0 on success, -1 if not playing
 */
int playback_get_progress(uint32_t *position_ms, uint32_t *duration_ms);

#endif /* PLAYBACK_MGR_H */
```

## src/ui_local_list.c
```c
/*
 * Copyright (c) 2025, LISTENAI
 *
 * SPDX-License-Identifier: Apache-2.0
 */
#include "ui_local_list.h"
#include "app_context.h"
#include "ui_playback.h"
#include "fs_utils.h"
#include "lvgl.h"

#include <stdio.h>
#include <string.h>

#ifdef LOG_TAG
#undef LOG_TAG
#endif
#define LOG_TAG "ui_local_list"
#include <lisa_log.h>

static lv_obj_t *s_screen;
static fs_file_list_t s_file_list;

static void btn_back_cb(lv_event_t *e)
{
    (void)e;
    app_switch_screen(SCREEN_MAIN_MENU);
}

static void file_item_cb(lv_event_t *e)
{
    int idx = (int)(intptr_t)lv_event_get_user_data(e);
    if (idx < 0 || idx >= s_file_list.count) {
        return;
    }

    char path[128];
    snprintf(path, sizeof(path), "%s/%s", VIDEO_DIR, s_file_list.entries[idx].name);
    LISA_LOGI(LOG_TAG, "Selected: %s", path);

    app_ctx_get()->previous_screen = SCREEN_LOCAL_LIST;
    app_ctx_get()->current_screen = SCREEN_PLAYBACK;

    /* Create playback screen (it calls lv_scr_load internally) */
    ui_playback_create(path, false);
}

void ui_local_list_create(void)
{
    s_screen = lv_obj_create(NULL);
    lv_obj_clear_flag(s_screen, LV_OBJ_FLAG_SCROLLABLE);
    lv_obj_set_style_bg_color(s_screen, lv_color_make(0x1a, 0x1a, 0x2e), LV_PART_MAIN);
    lv_obj_set_style_bg_opa(s_screen, LV_OPA_COVER, LV_PART_MAIN);

    /* Top bar (height 32) */
    lv_obj_t *top_bar = lv_obj_create(s_screen);
    lv_obj_remove_style_all(top_bar);
    lv_obj_set_size(top_bar, LV_PCT(100), 32);
    lv_obj_align(top_bar, LV_ALIGN_TOP_LEFT, 0, 0);
    lv_obj_clear_flag(top_bar, LV_OBJ_FLAG_SCROLLABLE);

    /* Back button */
    lv_obj_t *btn_back = lv_btn_create(top_bar);
    lv_obj_set_size(btn_back, 64, 26);
    lv_obj_align(btn_back, LV_ALIGN_LEFT_MID, 4, 0);
    lv_obj_set_style_bg_color(btn_back, lv_color_make(0x80, 0x30, 0x30), 0);
    lv_obj_t *back_lbl = lv_label_create(btn_back);
    lv_label_set_text(back_lbl, LV_SYMBOL_LEFT " Back");
    lv_obj_center(back_lbl);
    lv_obj_add_event_cb(btn_back, btn_back_cb, LV_EVENT_CLICKED, NULL);

    /* Title */
    lv_obj_t *title = lv_label_create(top_bar);
    lv_label_set_text(title, LV_SYMBOL_VIDEO " Local Videos");
    lv_obj_set_style_text_color(title, lv_color_white(), LV_PART_MAIN);
    lv_obj_align(title, LV_ALIGN_CENTER, 0, 0);

    /* Scan files */
    int ret = fs_list_avi_files(VIDEO_DIR, &s_file_list);

    /* File list —— 占满 top_bar 下方所有空间 */
    lv_obj_t *list = lv_list_create(s_screen);
    lv_obj_set_size(list, LV_PCT(100), LV_VER_RES - 32);
    lv_obj_align(list, LV_ALIGN_BOTTOM_MID, 0, 0);
    lv_obj_set_style_bg_color(list, lv_color_make(0x22, 0x22, 0x3a), LV_PART_MAIN);
    lv_obj_set_style_border_width(list, 0, LV_PART_MAIN);

    if (ret != 0 || s_file_list.count == 0) {
        lv_obj_t *empty = lv_label_create(list);
        lv_label_set_text(empty, "No AVI files in /Video/");
        lv_obj_set_style_text_color(empty, lv_color_make(0x88, 0x88, 0x88), LV_PART_MAIN);
    } else {
        for (int i = 0; i < s_file_list.count; i++) {
            char item_text[80];
            uint32_t size_kb = s_file_list.entries[i].size / 1024;
            snprintf(item_text, sizeof(item_text), "%s  (%u KB)",
                     s_file_list.entries[i].name, size_kb);

            lv_obj_t *btn = lv_list_add_btn(list, LV_SYMBOL_VIDEO, item_text);
            lv_obj_add_event_cb(btn, file_item_cb, LV_EVENT_CLICKED, (void *)(intptr_t)i);
        }
    }

    lv_scr_load(s_screen);
    LISA_LOGI(LOG_TAG, "Local list: %d files", s_file_list.count);
}

void ui_local_list_destroy(void)
{
    if (s_screen) {
        lv_obj_del(s_screen);
        s_screen = NULL;
    }
}
```

## src/ui_local_list.h
```c
/*
 * Copyright (c) 2025, LISTENAI
 *
 * SPDX-License-Identifier: Apache-2.0
 */
#ifndef UI_LOCAL_LIST_H
#define UI_LOCAL_LIST_H

void ui_local_list_create(void);
void ui_local_list_destroy(void);

#endif /* UI_LOCAL_LIST_H */
```

## src/ui_main_menu.c
```c
/*
 * Copyright (c) 2025, LISTENAI
 *
 * SPDX-License-Identifier: Apache-2.0
 */
#include "ui_main_menu.h"
#include "app_context.h"
#include "lvgl.h"

static lv_obj_t *s_screen;

static void btn_usb_msc_cb(lv_event_t *e)
{
    (void)e;
    app_switch_screen(SCREEN_USB_MSC);
}

static void btn_online_cb(lv_event_t *e)
{
    (void)e;
    app_switch_screen(SCREEN_ONLINE_LIST);
}

static void btn_local_cb(lv_event_t *e)
{
    (void)e;
    app_switch_screen(SCREEN_LOCAL_LIST);
}

void ui_main_menu_create(void)
{
    s_screen = lv_obj_create(NULL);
    lv_obj_clear_flag(s_screen, LV_OBJ_FLAG_SCROLLABLE);
    lv_obj_set_style_bg_color(s_screen, lv_color_make(0x1a, 0x1a, 0x2e), LV_PART_MAIN);
    lv_obj_set_style_bg_opa(s_screen, LV_OPA_COVER, LV_PART_MAIN);

    /* 320x240 layout: 上方单行标题，下方 3 个按钮竖排，整体居中
     *   - 标题区 ~36px 高
     *   - 按钮区 ~200px 高，每个按钮 ~56px 高（含间距），宽 78% 屏宽 */

    /* Title (top) */
    lv_obj_t *title = lv_label_create(s_screen);
    lv_label_set_text(title, "Lisa Media Player");
    lv_obj_set_style_text_color(title, lv_color_white(), LV_PART_MAIN);
    lv_obj_set_style_text_font(title, &lv_font_montserrat_16, LV_PART_MAIN);
    lv_obj_set_style_text_align(title, LV_TEXT_ALIGN_CENTER, LV_PART_MAIN);
    lv_obj_align(title, LV_ALIGN_TOP_MID, 0, 8);

    /* Button container (below title) */
    lv_obj_t *cont = lv_obj_create(s_screen);
    lv_obj_remove_style_all(cont);
    lv_obj_set_size(cont, LV_PCT(100), LV_PCT(82));
    lv_obj_align(cont, LV_ALIGN_BOTTOM_MID, 0, 0);
    lv_obj_set_flex_flow(cont, LV_FLEX_FLOW_COLUMN);
    lv_obj_set_flex_align(cont, LV_FLEX_ALIGN_SPACE_EVENLY, LV_FLEX_ALIGN_CENTER, LV_FLEX_ALIGN_CENTER);
    lv_obj_clear_flag(cont, LV_OBJ_FLAG_SCROLLABLE);

    /* Button style */
    static lv_style_t btn_style;
    lv_style_init(&btn_style);
    lv_style_set_radius(&btn_style, 8);
    lv_style_set_bg_color(&btn_style, lv_color_make(0x3a, 0x7b, 0xd5));
    lv_style_set_bg_opa(&btn_style, LV_OPA_COVER);
    lv_style_set_text_color(&btn_style, lv_color_white());
    lv_style_set_pad_hor(&btn_style, 20);
    lv_style_set_pad_ver(&btn_style, 8);

    /* USB MSC button */
    lv_obj_t *btn1 = lv_btn_create(cont);
    lv_obj_add_style(btn1, &btn_style, 0);
    lv_obj_set_width(btn1, LV_PCT(78));
    lv_obj_t *lbl1 = lv_label_create(btn1);
    lv_label_set_text(lbl1, LV_SYMBOL_USB "  USB MSC");
    lv_obj_center(lbl1);
    lv_obj_add_event_cb(btn1, btn_usb_msc_cb, LV_EVENT_CLICKED, NULL);

    /* Online Play button */
    lv_obj_t *btn2 = lv_btn_create(cont);
    lv_obj_add_style(btn2, &btn_style, 0);
    lv_obj_set_width(btn2, LV_PCT(78));
    lv_obj_t *lbl2 = lv_label_create(btn2);
    lv_label_set_text(lbl2, LV_SYMBOL_WIFI "  Online Play");
    lv_obj_center(lbl2);
    lv_obj_add_event_cb(btn2, btn_online_cb, LV_EVENT_CLICKED, NULL);

    /* Local Play button */
    lv_obj_t *btn3 = lv_btn_create(cont);
    lv_obj_add_style(btn3, &btn_style, 0);
    lv_obj_set_width(btn3, LV_PCT(78));
    lv_obj_t *lbl3 = lv_label_create(btn3);
    lv_label_set_text(lbl3, LV_SYMBOL_VIDEO "  Local Play");
    lv_obj_center(lbl3);
    lv_obj_add_event_cb(btn3, btn_local_cb, LV_EVENT_CLICKED, NULL);

    lv_scr_load(s_screen);
}

void ui_main_menu_destroy(void)
{
    if (s_screen) {
        lv_obj_del(s_screen);
        s_screen = NULL;
    }
}
```

## src/ui_main_menu.h
```c
/*
 * Copyright (c) 2025, LISTENAI
 *
 * SPDX-License-Identifier: Apache-2.0
 */
#ifndef UI_MAIN_MENU_H
#define UI_MAIN_MENU_H

void ui_main_menu_create(void);
void ui_main_menu_destroy(void);

#endif /* UI_MAIN_MENU_H */
```

## src/ui_online_list.h
```c
/*
 * Copyright (c) 2025, LISTENAI
 *
 * SPDX-License-Identifier: Apache-2.0
 */
#ifndef UI_ONLINE_LIST_H
#define UI_ONLINE_LIST_H

void ui_online_list_create(void);
void ui_online_list_destroy(void);

#endif /* UI_ONLINE_LIST_H */
```
