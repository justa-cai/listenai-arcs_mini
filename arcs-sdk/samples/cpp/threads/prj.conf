## CMakeLists.txt
```
cmake_minimum_required(VERSION 3.13)

set(CMAKE_EXPORT_COMPILE_COMMANDS ON)

find_package(listenai-cmake REQUIRED HINTS $ENV{ARCS_BASE})

project(arcs)

listenai_add_executable(${PROJECT_NAME})

target_sources(${PROJECT_NAME} PRIVATE 
    src/main.cpp
    src/future_promise_test.cpp
    src/mutex_condvar_test.cpp
)

listenai_include_directories(src)
```

## sample.yaml
```
tests:
  samples.cpp.threads:
    programmer: arcs
    runner: uart
    log_analyzer:
      type: "regex"
      pattern: "Variable Tests Completed"
```

## prj.conf
```kconfig
# 项目可根据需要在此文件中设置对应的配置
CONFIG_MEM_CONFIG=y
CONFIG_FREERTOS_STATIC_ALLOCATION_ENABLE=1
CONFIG_FREERTOS_CPP11=y
```

## src/future_promise_test.cpp
```c
#include "future_promise_test.h"
#include <future>

// 使用promise设置值，future获取值的示例
void promiseFunction(std::promise<int> intPromise) {
    std::cout << "Promise thread: calculating value..." << std::endl;
    // 模拟一些计算工作
    std::this_thread::sleep_for(std::chrono::seconds(2));
    // 设置promise的值
    intPromise.set_value(42);
    std::cout << "Promise thread: value set" << std::endl;
}

// 另一个简单的promise示例函数
void anotherPromiseFunction(std::promise<int> intPromise) {
    std::cout << "Another promise thread: calculating value..." << std::endl;
    // 模拟一些计算工作
    std::this_thread::sleep_for(std::chrono::seconds(1));
    // 设置promise的值
    intPromise.set_value(100);
    std::cout << "Another promise thread: value set" << std::endl;
}

// 使用packaged_task封装函数
int calculateValue(int x) {
    std::cout << "Packaged task: calculating result for " << x << "..." << std::endl;
    std::this_thread::sleep_for(std::chrono::seconds(1));
    return x * x;
}

// 展示std::async的使用
void asyncExample() {
    std::cout << "\n=== Async Example ===" << std::endl;
    
    // 使用std::async启动异步任务
    std::cout << "Starting async task with launch::async..." << std::endl;
    std::future<int> asyncResult = std::async(std::launch::async, []{
        std::cout << "Async task: working in separate thread..." << std::endl;
        std::this_thread::sleep_for(std::chrono::seconds(2));
        return 100;
    });
    
    // 可以在此处执行其他工作
    std::cout << "Main thread: doing other work while waiting..." << std::endl;
    std::this_thread::sleep_for(std::chrono::milliseconds(500));
    
    // 获取结果
    std::cout << "Main thread: getting async result..." << std::endl;
    int result = asyncResult.get();
    std::cout << "Main thread: async result is " << result << std::endl;
    
    // 延迟任务示例
    std::cout << "\nStarting async task with launch::deferred..." << std::endl;
    std::future<int> deferredResult = std::async(std::launch::deferred, []{
        std::cout << "Deferred task: executing in caller's thread when get() is called..." << std::endl;
        return 200;
    });
    
    // 调用get()才会执行延迟任务
    std::cout << "Main thread: calling get() on deferred task..." << std::endl;
    result = deferredResult.get();
    std::cout << "Main thread: deferred result is " << result << std::endl;
}

void runFuturePromiseTests() {
    // 基本的Future/Promise 示例
    std::cout << "=== Basic Future/Promise Example ===" << std::endl;
    
    // 创建promise和对应的future
    std::promise<int> intPromise;
    std::future<int> intFuture = intPromise.get_future();
    
    // 启动线程，并传递promise
    std::thread promiseThread(promiseFunction, std::move(intPromise));
    
    // 主线程等待future的值
    std::cout << "Main thread: waiting for value..." << std::endl;
    int value = intFuture.get(); // 阻塞直到promise设置值
    std::cout << "Main thread: received value " << value << std::endl;
    
    promiseThread.join();
    
    // 另一个Future/Promise 示例
    std::cout << "\n=== Another Future/Promise Example ===" << std::endl;
    
    std::promise<int> anotherPromise;
    std::future<int> anotherFuture = anotherPromise.get_future();
    
    std::thread anotherThread(anotherPromiseFunction, std::move(anotherPromise));
    
    std::cout << "Main thread: waiting for another value..." << std::endl;
    int anotherValue = anotherFuture.get();
    std::cout << "Main thread: received another value " << anotherValue << std::endl;
    
    anotherThread.join();
    
    // Packaged Task示例
    std::cout << "\n=== Packaged Task Example ===" << std::endl;
    
    // 创建一个packaged_task，封装calculateValue函数
    std::packaged_task<int(int)> task(calculateValue);
    
    // 获取future
    std::future<int> taskFuture = task.get_future();
    
    // 在另一个线程中执行task
    std::thread taskThread(std::move(task), 5);
    
    // 等待结果
    std::cout << "Main thread: waiting for packaged task result..." << std::endl;
    int taskResult = taskFuture.get();
    std::cout << "Main thread: packaged task result is " << taskResult << std::endl;
    
    taskThread.join();
    
    // 异步任务示例
    asyncExample();
}
```

## src/future_promise_test.h
```c
#ifndef FUTURE_PROMISE_TEST_H
#define FUTURE_PROMISE_TEST_H

#include <iostream>
#include <thread>
#include <future>
#include <chrono>

// 使用promise设置值，future获取值的示例
void promiseFunction(std::promise<int> intPromise);

// 带有异常处理的promise示例
void promiseFunctionWithException(std::promise<int> intPromise);

// 使用packaged_task封装函数
int calculateValue(int x);

// 展示std::async的使用
void asyncExample();

// 运行所有future和promise测试
void runFuturePromiseTests();

#endif // FUTURE_PROMISE_TEST_H
```

## src/mutex_condvar_test.cpp
```c
#include "mutex_condvar_test.h"

// 基本互斥锁使用示例
void basicMutexExample() {
    std::cout << "\n=== Basic Mutex Example ===" << std::endl;
    
    std::mutex mtx;
    int counter = 0;
    
    std::cout << "Starting two threads that increment a counter with mutex protection..." << std::endl;
    
    // 创建两个线程，都会增加计数器
    std::thread t1(mutexProtectedCounter, std::ref(mtx), std::ref(counter), 10000);
    std::thread t2(mutexProtectedCounter, std::ref(mtx), std::ref(counter), 10000);
    
    t1.join();
    t2.join();
    
    std::cout << "Final counter value: " << counter << std::endl;
    std::cout << "Expected value: 20000" << std::endl;
}

// 使用互斥锁保护共享数据的函数
void mutexProtectedCounter(std::mutex& mtx, int& counter, int iterations) {
    for (int i = 0; i < iterations; i++) {
        // 锁定互斥锁，确保只有一个线程可以访问计数器
        std::lock_guard<std::mutex> lock(mtx);
        counter++; // 临界区：安全地修改共享变量
    }
}

// 使用条件变量的生产者函数
void producer(std::mutex& mtx, std::condition_variable& cv, std::queue<int>& queue, int items) {
    for (int i = 1; i <= items; i++) {
        {
            std::lock_guard<std::mutex> lock(mtx);
            queue.push(i);
            std::cout << "Produced: " << i << std::endl;
        }
        // 通知等待的消费者
        cv.notify_one();
        // 生产速度稍慢于消费
        std::this_thread::sleep_for(std::chrono::milliseconds(100));
    }
}

// 使用条件变量的消费者函数
void consumer(std::mutex& mtx, std::condition_variable& cv, std::queue<int>& queue, bool& done) {
    while (!done) {
        std::unique_lock<std::mutex> lock(mtx);
        
        // 等待队列非空或完成标志
        cv.wait(lock, [&queue, &done]() { 
            return !queue.empty() || done; 
        });
        
        // 检查是否只是因为done标志而被唤醒
        if (queue.empty() && done) {
            break;
        }
        
        // 处理队列中的元素
        int value = queue.front();
        queue.pop();
        
        std::cout << "Consumed: " << value << std::endl;
        
        // 解锁互斥锁，以便生产者可以继续
        lock.unlock();
        
        // 模拟处理数据的时间
        std::this_thread::sleep_for(std::chrono::milliseconds(50));
    }
}

// 展示多个线程的条件变量使用
void multipleConsumersExample() {
    std::cout << "\n=== Multiple Consumers Example ===" << std::endl;
    
    std::mutex mtx;
    std::condition_variable cv;
    std::queue<int> queue;
    std::vector<std::thread> consumers;
    bool done = false;
    
    // 创建多个消费者线程
    std::cout << "Starting 3 consumer threads..." << std::endl;
    for (int i = 0; i < 3; i++) {
        consumers.emplace_back(consumer, std::ref(mtx), std::ref(cv), std::ref(queue), std::ref(done));
    }
    
    // 创建生产者线程
    std::cout << "Starting producer thread..." << std::endl;
    std::thread producerThread(producer, std::ref(mtx), std::ref(cv), std::ref(queue), 15);
    
    // 等待生产者完成
    producerThread.join();
    
    // 通知所有消费者已经没有更多数据了
    {
        std::lock_guard<std::mutex> lock(mtx);
        done = true;
    }
    cv.notify_all();
    
    // 等待所有消费者完成
    for (auto& t : consumers) {
        t.join();
    }
    
    std::cout << "All threads completed successfully" << std::endl;
}

void runMutexCondVarTests() {
    std::cout << "=== Mutex and Condition Variable Tests ===" << std::endl;
    
    // 运行基本互斥锁示例
    basicMutexExample();
    
    // 简单的条件变量示例
    std::cout << "\n=== Basic Condition Variable Example ===" << std::endl;
    
    std::mutex mtx;
    std::condition_variable cv;
    std::queue<int> queue;
    bool done = false;
    
    // 创建消费者线程
    std::cout << "Starting consumer thread..." << std::endl;
    std::thread consumerThread(consumer, std::ref(mtx), std::ref(cv), std::ref(queue), std::ref(done));
    
    // 创建生产者线程
    std::cout << "Starting producer thread..." << std::endl;
    std::thread producerThread(producer, std::ref(mtx), std::ref(cv), std::ref(queue), 5);
    
    // 等待生产者完成
    producerThread.join();
    
    // 通知消费者已经没有更多数据了
    {
        std::lock_guard<std::mutex> lock(mtx);
        done = true;
    }
    cv.notify_one();
    
    // 等待消费者完成
    consumerThread.join();
    
    // 运行多消费者示例
    multipleConsumersExample();
}
```

## src/mutex_condvar_test.h
```c
#ifndef MUTEX_CONDVAR_TEST_H
#define MUTEX_CONDVAR_TEST_H

#include <iostream>
#include <thread>
#include <mutex>
#include <condition_variable>
#include <chrono>
#include <queue>
#include <vector>

// 基本互斥锁使用示例函数
void basicMutexExample();

// 使用互斥锁保护共享数据的函数
void mutexProtectedCounter(std::mutex& mtx, int& counter, int iterations);

// 使用条件变量的生产者函数
void producer(std::mutex& mtx, std::condition_variable& cv, std::queue<int>& queue, int items);

// 使用条件变量的消费者函数
void consumer(std::mutex& mtx, std::condition_variable& cv, std::queue<int>& queue, bool& done);

// 展示多个线程的条件变量使用
void multipleConsumersExample();

// 运行所有mutex和condition_variable测试
void runMutexCondVarTests();

#endif // MUTEX_CONDVAR_TEST_H
```
