## arcs-sdk/soc/arcs/hal/modules/profiles/Kconfig
```kconfig
# BLE Profiles Kconfig aggregator

menu "BLE Profiles"
    depends on BLE || BT || BLUETOOTH

rsource "hogp/Kconfig"
rsource "bas/Kconfig"
rsource "dis/Kconfig"
rsource "netcfg_ble/netcfg_bles/Kconfig"

endmenu
```

## arcs-sdk/soc/arcs/hal/modules/profiles/hogp/Kconfig
```kconfig
config BLE_PROFILE_HOGPBH
    bool "Enable BLE Profile HOGP Boot Host"
    default n
    help
        Enable BLE HID over GATT Profile Boot Host support

config BLE_PROFILE_HOGPD
    bool "Enable BLE Profile HOGP Device"
    default n
    help
        Enable BLE HID over GATT Profile Device support

config BLE_PROFILE_HOGPRH
    bool "Enable BLE Profile HOGP Report Host"
    default n
    help
        Enable BLE HID over GATT Profile Report Host support
```

## arcs-sdk/soc/arcs/hal/modules/profiles/netcfg_ble/netcfg_bles/Kconfig
```kconfig
config BLE_PROFILE_NETCFG_BLES
    bool "Enable BLE Profile NETCFG over BLE Server"
    default n
    help
        Enable BLE-based Network Configuration Server support
```

## arcs-sdk/soc/arcs/hal/modules/segger_rtt/Kconfig
```kconfig
menu "SEGGER RTT Support"

config SUPPORT_SEGGER_RTT
    bool "Enable SEGGER RTT support"
    default n
    help
        Enable SEGGER RTT support

if SUPPORT_SEGGER_RTT

config SEGGER_RTT_MODE_DEFAULT
    int "SEGGER RTT Default Mode"
    default 2
    help
        Default mode for SEGGER RTT buffer 0.
        0: SEGGER_RTT_MODE_NO_BLOCK_SKIP - Skip all data if buffer full
        1: SEGGER_RTT_MODE_NO_BLOCK_TRIM - Trim data to fit buffer
        2: SEGGER_RTT_MODE_BLOCK_IF_FIFO_FULL - Block until buffer has space (Recommended)

config SEGGER_RTT_BUFFER_SIZE_UP
    int "SEGGER RTT Up Buffer Size"
    default 1024
    help
        Size of the SEGGER RTT Up buffer (target to host).

config SEGGER_RTT_BUFFER_SIZE_DOWN
    int "SEGGER RTT Down Buffer Size"
    default 16
    help
        Size of the SEGGER RTT Down buffer (host to target).

endif
endmenu
```

## arcs-sdk/soc/arcs/hal/modules/shell/Kconfig
```kconfig
config ARCS_HAL_MODULE_SHELL
    bool "Enable ARCS HAL MODULE SHELL"
    default n
    help
        Enable Shell module support for command line interface

if ARCS_HAL_MODULE_SHELL
    config ARCS_HAL_MODULE_SHELL_TASK_STACK_SIZE
        int "ARCS HAL MODULE SHELL TASK STACK SIZE"
        default 1024
        help
            Set the stack size of the shell task

    config ARCS_HAL_MODULE_SHELL_TASK_PRIORITY
        int "ARCS HAL MODULE SHELL TASK PRIORITY"
        default 9
        help
            Set the priority of the shell task
    config SHELL_UART
        int "ARCS HAL SHELL UART PORT"
        default 0
    
    config SHELL_UART_BAUDRATE
        int "ARCS HAL SHELL UART BAUDRATE"
        default 921600
    
endif
```

## arcs-sdk/soc/arcs/hal/test/test_ls_utils_weak_with_override/testcase.yaml
```yaml
tests:
  test.ls_utils_weak_with_override:
    runner: linux
    builder: cmake
    log_analyzer: "unity"
```

## arcs-sdk/soc/arcs/hal/test/test_ls_utils_weak_without_override/testcase.yaml
```yaml
tests:
  test.ls_utils_weak_without_override:
    runner: linux
    builder: cmake
    log_analyzer: "unity"
```

## arcs-sdk/soc/arcs/hal/test/test_net_al_lwip_api/testcase.yaml
```yaml
tests:
  test.net_al_lwip_api:
    runner: linux
    builder: cmake
    log_analyzer: "unity"
```

## arcs-sdk/soc/arcs/ls26xx/Kconfig
```kconfig
# Copyright (c) 2025, LISTENAI
# SPDX-License-Identifier: Apache-2.0

config SOC_SERIES_LS26XX
	bool
	select SOC_ARCS

config SOC_LS2662
	bool "LS2662L0U"
	select SOC_SERIES_LS26XX
	help
		Dual Core RISC-V 300MHz, 4M PSRAM, no NPU

config SOC_LS2663
	bool "LS2663L0U"
	select SOC_SERIES_LS26XX
	help
		Dual Core RISC-V 300MHz, 8M PSRAM, no NPU

config SOC_LS2664
	bool "LS2664L0U"
	select SOC_SERIES_LS26XX
	help
		Dual Core RISC-V 300MHz, 16M PSRAM, no NPU

config SOC_LS2682
	bool "LS2682L0U"
	select SOC_SERIES_LS26XX
	help
		Dual Core RISC-V 300MHz, 4M PSRAM, NPU 64G ops

config SOC_LS2683
	bool "LS2683L0U"
	select SOC_SERIES_LS26XX
	help
		Dual Core RISC-V 300MHz, 8M PSRAM, NPU 64G ops

config SOC_LS2684
	bool "LS2684L0U"
	select SOC_SERIES_LS26XX
	help
		Dual Core RISC-V 300MHz, 16M PSRAM, NPU 64G ops

if SOC_SERIES_LS26XX

rsource "ls2662/Kconfig.defconfig"
rsource "ls2663/Kconfig.defconfig"
rsource "ls2664/Kconfig.defconfig"
rsource "ls2682/Kconfig.defconfig"
rsource "ls2683/Kconfig.defconfig"
rsource "ls2684/Kconfig.defconfig"

endif # SOC_SERIES_LS26XX
```

## arcs-sdk/soc/arcs/ls26xx/ls2662/Kconfig.defconfig
```kconfig
# Copyright (c) 2025, LISTENAI
# SPDX-License-Identifier: Apache-2.0

if SOC_LS2662

config MEM_PSRAM_SIZE
	default 0x00400000    # 4MB

endif # SOC_LS2662
```

## arcs-sdk/soc/arcs/ls26xx/ls2663/Kconfig.defconfig
```kconfig
# Copyright (c) 2025, LISTENAI
# SPDX-License-Identifier: Apache-2.0

if SOC_LS2663

config MEM_PSRAM_SIZE
	default 0x00800000    # 8MB

endif # SOC_LS2663
```

## arcs-sdk/soc/arcs/ls26xx/ls2664/Kconfig.defconfig
```kconfig
# Copyright (c) 2025, LISTENAI
# SPDX-License-Identifier: Apache-2.0

if SOC_LS2664

config MEM_PSRAM_SIZE
	default 0x01000000    # 16MB

endif # SOC_LS2664
```

## arcs-sdk/soc/arcs/ls26xx/ls2683/Kconfig.defconfig
```kconfig
# Copyright (c) 2025, LISTENAI
# SPDX-License-Identifier: Apache-2.0

if SOC_LS2683

config MEM_PSRAM_SIZE
	default 0x00800000    # 8MB

config SOC_HAS_NPU
	default y

endif # SOC_LS2683
```

## arcs-sdk/soc/arcs/ls26xx/ls2684/Kconfig.defconfig
```kconfig
# Copyright (c) 2025, LISTENAI
# SPDX-License-Identifier: Apache-2.0

if SOC_LS2684

config MEM_PSRAM_SIZE
	default 0x01000000    # 16MB

config SOC_HAS_NPU
	default y

endif # SOC_LS2684
```

## arcs-sdk/soc/common/Kconfig.mem.venusa
```kconfig
# Copyright (c) 2025, LISTENAI
# SPDX-License-Identifier: Apache-2.0

config MEM_CONFIG
	bool
	default y

# VenusA 默认 SRAM 布局（半开区间：[start, end)）
#
# 低 128KB CPU SRAM：
#   0x20000000  +----------+  CIDU IPC 共享邮箱       4KB   [0x20000000, 0x20001000)
#               |   IPC    |
#   0x20001000  +----------+  LUNA shared/.sharedmem  32KB  [0x20001000, 0x20009000)
#               |   LUNA   |
#               |  shared  |
#   0x20009000  +----------+  AP SRAM                 52KB  [0x20009000, 0x20016000)
#               | AP SRAM  |
#   0x20016000  +----------+  CP SRAM                 40KB  [0x20016000, 0x20020000)
#               | CP SRAM  |
#   0x20020000  +----------+
#
# 算法 SRAM 与 LUNA 专属 SRAM：
#   0x20020000  +----------+  APRAM/算法 SRAM        384KB  [0x20020000, 0x20080000)
#               |  APRAM   |
#   0x20080000  +----------+  LUNA private            24KB  [0x20080000, *)
#               | LUNA 私有|
#   *  			+----------+
#
# 说明：
#   - MEM_SRAM_BASE/SIZE 只描述当前镜像的普通 SRAM。
#   - AP/CP 镜像独立链接，链接脚本不检查 AP SRAM 与 CP SRAM 是否互踩。
#	- 不建议修改 IPC 分区。
#   - prj.conf 可调整各分区大小/位置；链接脚本会检查当前镜像 SRAM、IPC、
#     LUNA shared、APRAM、LUNA private 之间是否重叠。

menu "内存布局"

config MEM_INTERRUPT_STACK_SIZE
	hex "中断栈大小"
	default 0x1000

config MEM_HEAP_SIZE
	int "堆大小（字节）"
	default 512

menu "SRAM"
config MEM_SRAM_BASE
	hex "SRAM 起始地址"
	default 0x20009000 if VENUSA_AP_CORE
	default 0x20016000 if VENUSA_CP_CORE
	default 0x20009000
	help
		VenusA 当前镜像普通 SRAM 起始地址。低 128KB 默认划分为
		CIDU IPC、LUNA 共享段、AP SRAM 和 CP SRAM；默认 AP 使用
		0x20009000 起始的 52KB，CP 使用 0x20016000 起始的 40KB。
		可在 prj.conf 中按项目需求覆盖；链接阶段只检查当前镜像
		SRAM 是否和 LUNA 共享段、IPC、APRAM、LUNA 专属区重叠。
		AP和CP的SRAM需要保证不踩踏，由用户自行保证，链接脚本无法检查。

config MEM_SRAM_SIZE
	hex "SRAM 大小"
	default 0x0000D000 if VENUSA_AP_CORE
	default 0x0000A000 if VENUSA_CP_CORE
	default 0x0000D000
	help
		VenusA 当前镜像普通 SRAM 大小。默认 CIDU IPC 预留 4KB
		[0x20000000, 0x20001000)，LUNA 共享段预留 32KB
		[0x20001000, 0x20009000)，AP 预留 52KB
		[0x20009000, 0x20016000)，CP 预留 40KB
		[0x20016000, 0x20020000)。
endmenu

menu "PSRAM"
config MEM_PSRAM_BASE
	hex "PSRAM 起始地址"
	default 0x38000000
	help
		VenusA 外部 PSRAM 芯片映射起始地址，默认使用硬件窗口
		0x38000000。AP/CP 双镜像如需分区，应在工程 prj.conf 中
		按产品内存布局显式覆盖。

config MEM_PSRAM_SIZE
	hex "PSRAM 大小"
	default 0x00800000 if !SOC_SERIES_CSK70XX
	help
		外部 PSRAM 可用大小。csk70xx 具体芯片在 defconfig 中给出
		容量默认值，这里只提供非 csk70xx VenusA 平台的兜底值。
endmenu

menu "Flash"
config MEM_FLASH_BASE
	hex "Flash XIP 起始地址"
	default 0x30000000
	help
		VenusA Flash XIP 芯片映射起始地址，默认使用硬件窗口
		0x30000000。AP/CP 双镜像或多镜像场景应在工程 prj.conf
		中按烧录分区显式覆盖。

config MEM_FLASH_SIZE
	hex "Flash 大小"
	default 0x00800000 if !SOC_SERIES_CSK70XX
	help
		Flash 可用大小。csk70xx 具体芯片在 defconfig 中给出容量
		默认值，这里只提供非 csk70xx VenusA 平台的兜底值。可在工程 prj.conf 中覆盖。
endmenu

menu "本地内存（TCM）"
config MEM_ILM_BASE
	hex "ILM 起始地址"
	default 0x00000000
	help
		VenusA 没有 ILM，保留该配置用于兼容公共链接脚本。

config MEM_ILM_SIZE
	hex "ILM 大小"
	default 0x0

config MEM_DLM_BASE
	hex "DLM 起始地址"
	default 0x00000000
	help
		VenusA 没有 DLM，保留该配置用于兼容公共链接脚本。

config MEM_DLM_SIZE
	hex "DLM 大小"
	default 0x0
endmenu

menu "LUNA RAM"
config MEM_LUNA_BASE
	hex "LUNA 专属 SRAM 起始地址"
	default 0x20080000
	help
		LUNA 核专属 SRAM 起始地址。该区域由 LUNA 核内部使用，不用于
		放置 AP/CP 侧 .sharedmem.* 段。

config MEM_LUNA_SIZE
	hex "LUNA 专属 SRAM 大小"
	default 0x00006000
	help
		LUNA 核专属 SRAM 大小，默认按 ARCS 保持 24KB。

config MEM_LUNA_SHARED_BASE
	hex "LUNA 共享内存起始地址"
	default 0x20001000
	help
		LUNA 共享内存起始地址。默认位于低 128KB 中 CIDU IPC 之后，
		只用于放置 libluna.a 的 .sharedmem.text/.data/.bss，
		不能占用 0x20020000 起始的 384KB 算法 SRAM。

config MEM_LUNA_SHARED_SIZE
	hex "LUNA 共享内存大小"
	default 0x00008000
	help
		LUNA 共享内存大小，默认 32KB。设为 0 会禁用 SoC 级
		.sharedmem.* 专用链接段。若 libluna.a 的共享段增长，
		应优先评估低 128KB 内 AP/CP/IPC 的重新划分。
endmenu

menu "IPC 共享内存"
config MEM_IPC_ISOLATED
	bool "预留独立 IPC 共享内存区域"
	default y
	help
		VenusA 默认在低 128KB 起始位置预留 4KB IPC 共享内存：
		[0x20000000, 0x20001000)。当前 CIDU IPC 后端默认使用这块
		区域作为 AP/CP 共享邮箱。

config MEM_IPC_BASE
	hex "IPC 共享内存起始地址"
	default 0x20000000
	depends on MEM_IPC_ISOLATED
	help
		VenusA IPC 共享内存的布局级起始地址。CIDU IPC 默认通过
		IPC_CIDU_SHMEM_BASE 跟随该地址。

config MEM_IPC_SIZE
	hex "IPC 共享内存大小"
	default 0x00001000
	depends on MEM_IPC_ISOLATED
	help
		VenusA IPC 共享内存大小，默认 4KB。CIDU IPC 默认通过
		IPC_CIDU_SHMEM_SIZE 跟随该大小。
endmenu

menu "CIDU IPC 共享内存"
config IPC_CIDU_SHMEM_BASE
	default MEM_IPC_BASE if MEM_IPC_ISOLATED
	default 0x20000000
	help
		CIDU IPC 共享邮箱起始地址。默认跟随 VenusA 布局级
		MEM_IPC_BASE，对应低 128KB 中的 IPC 共享内存区域。
		只有在需要让 CIDU 使用非默认 mailbox 时才建议覆盖。

config IPC_CIDU_SHMEM_SIZE
	default MEM_IPC_SIZE if MEM_IPC_ISOLATED
	default 0x00001000
	help
		CIDU IPC 共享邮箱大小。默认跟随 VenusA 布局级
		MEM_IPC_SIZE。AP/CP 两侧镜像必须使用相同配置。
endmenu

menu "算法 RAM"
config MEM_APRAM_BASE
	hex "算法 SRAM 起始地址"
	default 0x20020000
	help
		算法专用 SRAM 起始地址。VenusA 默认把 0x20020000 起始的
		384KB 留给 FD/LSFace 等算法工作区。

config MEM_APRAM_SIZE
	hex "算法 SRAM 大小"
	default 0x00060000
	help
		算法专用 SRAM 大小，默认 384KB。该区域不能被
		.sharedmem.text/.data/.bss 占用。
endmenu

endmenu # 内存布局
```

## arcs-sdk/soc/venusa/Kconfig
```kconfig
# Copyright (c) 2025, LISTENAI
# SPDX-License-Identifier: Apache-2.0

config SOC_VENUSA
	bool

if SOC_VENUSA

config HARTID
	int "Hart ID (0=AP, 1=CP)"
	range 0 1
	help
		Hart ID (0=AP, 1=CP)。直接嵌入 image header reserved[0],
		boot 在 CONFIG_BOOT_APP_CORE_AUTO 场景下据此选择目标核。
		加 prompt 让 prj.conf 能覆盖 SoC defconfig 给的默认值。

config VENUSA_AP_CORE
	bool
	default y if HARTID = 0
	help
		当前镜像运行在 VenusA AP 核（Hart 0）。内存默认布局会据此
		选择 AP 侧 SRAM、Flash 和 PSRAM 窗口。

config VENUSA_CP_CORE
	bool
	default y if HARTID = 1
	help
		当前镜像运行在 VenusA CP 核（Hart 1）。内存默认布局会据此
		选择 CP 侧 SRAM、Flash 和 PSRAM 窗口。

config SOC_HAS_NPU
	bool "SoC has NPU"
	help
		SoC 集成 NPU（神经网络处理单元）。
		由具体型号的 defconfig 自动设置，无需手动开启。

config DCACHE_ENABLE
	bool "Enable DCACHE"
	default y

config ICACHE_ENABLE
	bool "Enable ICACHE"
	default y

config PSRAM_INIT
	bool "PSRAM init"
	default y

config CLOCK_INIT
	bool "CLOCK init"
	default y

rsource "../common/Kconfig.mem.venusa"

endif # SOC_VENUSA

rsource "csk70xx/Kconfig"
```

## arcs-sdk/soc/venusa/csk70xx/Kconfig
```kconfig
# Copyright (c) 2025, LISTENAI
# SPDX-License-Identifier: Apache-2.0

config SOC_SERIES_CSK70XX
	bool
	select SOC_VENUSA

config SOC_CSK7002G6U
	bool "CSK7002G6U"
	select SOC_SERIES_CSK70XX
	help
		Dual Core RISC-V 300MHz, 4M PSRAM, no NPU

config SOC_CSK7004J8U
	bool "CSK7004J8U"
	select SOC_SERIES_CSK70XX
	help
		Dual Core RISC-V 400MHz, 16M PSRAM, with NPU

if SOC_SERIES_CSK70XX

rsource "csk7002g6u/Kconfig.defconfig"
rsource "csk7004j8u/Kconfig.defconfig"

endif # SOC_SERIES_CSK70XX
```

## arcs-sdk/soc/venusa/csk70xx/csk7002g6u/Kconfig.defconfig
```kconfig
# Copyright (c) 2025, LISTENAI
# SPDX-License-Identifier: Apache-2.0

if SOC_CSK7002G6U

config HARTID
	default 0    # VenusA sample 默认不合并 boot, app 跑 AP

config MEM_PSRAM_SIZE
	default 0x00400000    # 4MB

config MEM_FLASH_SIZE
	default 0x00400000    # 4MB

endif # SOC_CSK7002G6U
```

## arcs-sdk/soc/venusa/csk70xx/csk7004j8u/Kconfig.defconfig
```kconfig
# Copyright (c) 2025, LISTENAI
# SPDX-License-Identifier: Apache-2.0

if SOC_CSK7004J8U

config HARTID
	default 0    # VenusA sample 默认不合并 boot, app 跑 AP

config MEM_PSRAM_SIZE
	default 0x01000000    # 16MB

config MEM_FLASH_SIZE
	default 0x01000000    # 16MB

endif # SOC_CSK7004J8U
```

## arcs-sdk/startup/Kconfig
```kconfig
menu "ARCS System Startup Configuration"

rsource "arcs/Kconfig"

config ARCS_STARTUP_CONFIG
    bool "ARCS startup config"
    default y
    imply MODULE_FREERTOS
    imply MODULE_HEAP
    imply LOG
    imply ARCS_HAL_WARNING_DISABLE
    imply BOOT_HART

if ARCS_STARTUP_CONFIG


config ARCS_STARTUP_CUSTOM_LINKER_FILE
    bool "ARCS startup custom linker file"
    default n

config PSRAM_INIT
    bool "PSRAM init"
    default y if ARCS_AP_CORE

config CLOCK_INIT
    bool "CLOCK init"
    default y if ARCS_AP_CORE

config BOOT
    bool "BOOT embedded"
    default y if ARCS_CP_CORE

endif
endmenu

if BOOT
    orsource "boot/Kconfig.boot"
endif
```

## arcs-sdk/startup/arcs/Kconfig
```kconfig
config MAIN_TASK_STACK_SIZE
    int "main task stack size"
    default 2048

config MAIN_TASK_PRIORITY
    int "main task priority"
    default 1

config DCACHE_ENABLE
    bool "Enable DCACHE"
    default y

config ICACHE_ENABLE
    bool "Enable ICACHE"
    default y

config LINK_CPP_RUNTIME_SECTIONS
    bool "link cpp runtime sections"
    default y
    help
        Link the C++ runtime sections

config CPP_EXCEPTIONS
    bool "Enable C++ exceptions"
    default y

config EXCEPTION_REBOOT_IMMEDIATELY
    bool "reboot immediately in exception handler"
    default n

config BOOT_WITH_WATCHDOG
    bool "boot with watchdog"
    default n
    help
        Enable the watchdog in boot

config WATCHDOG_ENABLE
    bool "watchdog enable"
    default y if BOOT_WITH_WATCHDOG
    help
        Enable the watchdog

config SYS_INIT
    bool "Enable system initialization framework"
    default y
    help
        Enable the SYS_INIT framework for multi-level system initialization.

        This framework provides 5 initialization levels that match ARCS boot flow:

        - PRE_SYSTEM_INIT:   BEFORE scatload (in platform_pre_startup)
                             ⚠️ WARNING: .data NOT copied, .bss NOT zeroed!
                             DO NOT use global variables!
        - PRE_DEVICES_INIT:  Before lisa_device_init()
        - PRE_KERNEL:        Before vTaskStartScheduler()
        - POST_KERNEL:       After vTaskStartScheduler()
        - PRE_APPLICATION:   Before main()

        Use SYS_INIT macro to register initialization functions at different levels.

        If unsure, say Y.

config SYS_INIT_DEBUG
    bool "Enable system initialization debug output"
    depends on SYS_INIT
    default n
    help
        Enable detailed debug logging for system initialization.

rsource "Kconfig.mem"
rsource "Kconfig.syslog"
rsource "Kconfig.debug"
```

## arcs-sdk/startup/arcs/Kconfig.debug
```kconfig
menu "back trace"

config BACK_TRACE
    bool "backtrace support"
    default n
    help
        Enable the exception back trace

endmenu
```
