## arcs-sdk/soc/arcs/hal/chip/arcs/lib/Kconfig.wifi
```kconfig
choice WIFI_LWIP_CORE_MODE
    prompt "WiFi and LWIP Core Mode"
    default WIFI_LWIP_NONE
    help
        Select the core mode for WiFi and LWIP.
        For compatibility, please choose according to your hardware and software configuration.

config WIFI_LWIP_NONE
    bool "No WiFi/LWIP support"
    help
        Select this if you don't need WiFi or LWIP support.

config WIFI_LWIP_SAME_CORE
    bool "WiFi and LWIP run on the same core"
    select WIFI
    select LWIP
    help
        Select this if both WiFi stack and LWIP stack run on the same CPU core.

config WIFI_LWIP_DIFF_CORE
    bool "WiFi and LWIP run on different cores"
    select ARCS_HAL_IPC
    help
        Select this if WiFi stack and LWIP stack run on different CPU cores.
        This mode may be used for specific performance optimization or multi-core architecture.
        NOTE: You need to manually enable WIFI or LWIP in each core's prj.conf:
          - WiFi core: CONFIG_WIFI=y, CONFIG_ARCS_HAL_SIMSOCKET=y
          - LWIP core: CONFIG_LWIP=y

endchoice

menuconfig WIFI
    bool "WiFi Support"
    default n
    select ARCS_HAL_VRTC
    select ARCS_HAL_WCND
    select RTOS_AL
    select SDK_MODULE_MBEDTLS
    select MBEDTLS_HSU
    help
        Enable WiFi support including core WiFi functionality


if WIFI

config MEM_WIFI_LA_DUMP_SIZE
    int "WiFi LA dump size"
    default 32768
    help
        WiFi LA dump size

config WIFI_CALI_BUF
    bool "Enable exclusive calibration buffer"
    default n
    help
        Enable exclusive calibration buffer

config WIFI_TX_BUF_COPY
    bool "Enable WiFi TX buffer copy"
    default n
    help
        Enable WiFi TX buffer copy


choice
    prompt "WiFi Mode"
    default WIFI_STA
    config WIFI_AP
        bool "WiFi Access Point Mode"
        default n
        help
        Enable WiFi Access Point (AP) mode support

    config WIFI_STA
        bool "WiFi Station Mode"
        default n
        help
        Enable WiFi Station (STA) mode support

endchoice

endif # WIFI
```

## arcs-sdk/soc/arcs/hal/chip/arcs/lib/ble/Kconfig
```kconfig
menuconfig BLE
    bool "BLE Support"
    default n
    select ARCS_HAL_WCND
    select RTOS_AL
    select ARCS_HAL_BTOS
    select ARCS_HAL_EVENT if !ARCS_HAL_IPC
    select BLE_PROFILE_DISS
    help
        Enable BLE support including core BLE functionality
```

## arcs-sdk/soc/arcs/hal/chip/arcs/lib/bt_dual/Kconfig
```kconfig
menuconfig BT_DUAL
    bool "BT Dual Support"
    default n
    select BLE
    select ARCS_HAL_WCND
    select RTOS_AL
    select ARCS_HAL_BTOS
    select BLE_PROFILE_DISS
    help
        Enable BT Dual(BLE + Bluetooth Classic) support
```

## arcs-sdk/soc/arcs/hal/chip/arcs/lwip/Kconfig
```kconfig
config LWIP
    bool "LwIP TCP/IP Stack"
    default n
    select RTOS_AL
    select ARCS_HAL_WLIF
    select ARCS_HAL_EVENT
    select ARCS_HAL_CLI_CMD
    help
        Lightweight TCP/IP stack (LwIP)

config LWIP_VERSION
    string "LwIP Version" if LWIP
    default "2.2.0"
    help
        LwIP version. You have to select one even if you don't enable LWIP. Because WiFi need it.

if LWIP

choice LWIP_NET_IMPL
    prompt "Network Implementation"
    default LWIP_NET_REAL

    config LWIP_NET_REAL
        bool "Real Network Implementation"
        help
            Use real network implementation from net_al directory

    config LWIP_NET_SIM
        bool "Simulated Network Implementation"
        help
            Use simulated network implementation (simsocket)

endchoice

config LWIP_TX_BUF_COPY
    bool "Enable TX buffer copy for LWIP"
    default n
    help
        Enable TX buffer copy for LWIP

config LWIP_SOCKET_UDP_TX_COPY
    bool "Enable UDP socket TX copy for lwIP sockets"
    default n
    help
        Copy UDP and RAW socket payloads into lwIP-owned buffers in
        sendto/sendmsg without enabling the broader WiFi/L2 TX_BUF_COPY path.

config LWIP_USB_ECM_TUNING
    bool "Use USB ECM tuned lwIP TCP options"
    default n
    help
        Enable TCP defaults tuned for USB CDC ECM/cellular links. The default
        keeps the historical lwIP values so existing WiFi projects are not
        changed unless a project selects this profile or overrides the values
        below explicitly.

config LWIP_TCPIP_CORE_LOCKING_INPUT
    int "lwIP TCP/IP core locking input"
    default 1
    range 0 1
    help
        Value assigned to LWIP_TCPIP_CORE_LOCKING_INPUT in lwipopts.h.
        The default keeps the existing input processing model.

config LWIP_PBUF_POOL_SIZE
    int "lwIP pbuf pool size"
    default 0
    range 0 4096
    help
        Value assigned to PBUF_POOL_SIZE in lwipopts.h.
        The default keeps the existing project behavior. Increasing this
        value allocates more lwIP pbuf pool memory and may affect RAM usage.

config LWIP_TCP_WND_MSS_MULTIPLIER
    int "lwIP TCP receive window multiplier of TCP_MSS"
    default 128 if LWIP_USB_ECM_TUNING
    default 20
    range 1 256
    help
        Value assigned to TCP_WND as a multiplier of TCP_MSS. The default 20
        keeps the historical SDK value. USB ECM tuning uses a larger window
        for cellular throughput.

config LWIP_TCP_OOSEQ_MAX_BYTES_MSS_MULTIPLIER
    int "lwIP TCP OOSEQ max bytes multiplier of TCP_MSS"
    default 64 if LWIP_USB_ECM_TUNING
    default 0
    range 0 1024
    help
        Value assigned to TCP_OOSEQ_MAX_BYTES as a multiplier of TCP_MSS.
        Set to 0 to leave TCP_OOSEQ_MAX_BYTES undefined, matching the
        historical SDK behavior.

config LWIP_TCP_OOSEQ_MAX_PBUFS
    int "lwIP TCP OOSEQ max pbufs"
    default 96 if LWIP_USB_ECM_TUNING
    default 0
    range 0 4096
    help
        Value assigned to TCP_OOSEQ_MAX_PBUFS. Set to 0 to leave it
        undefined, matching the historical SDK behavior.

config LWIP_TCP_RTO_TIME
    int "lwIP initial TCP retransmission timeout in ms"
    default 3000 if LWIP_USB_ECM_TUNING
    default 1000
    range 250 60000
    help
        Value assigned to LWIP_TCP_RTO_TIME in lwipopts.h. The default 1000
        keeps the historical SDK value; USB ECM tuning restores the standard
        3000 ms initial timeout for weak cellular links.

config LWIP_NETAL_TX_BUF_SIZE
    int "lwip net-al tx buffer size"
    default 1536

config LWIP_NETAL_TX_BUF_CNT
    int "lwip net-al tx buffer count"
    default 10

config LWIP_NETAL_TX_SAMLL_BUF_SIZE
    int "lwip net-al tx buffer size"
    default 128

config LWIP_NETAL_TX_SMALL_BUF_CNT
    int "lwip net-al tx small buffer count"
    default 6

config LWIP_OPTION_LWIP_DNS
    bool "Turn on DNS module. UDP must be available for DNS transport."
    default n

config LWIP_OPTION_SO_REUSE
    bool "Enable SO_REUSEADDR option"
    default n

config LWIP_DHCP_RESTORE_LAST_IP
    bool "Enable DHCP last IP address restore"
    default n
    help
        Enable restoring last valid IP address obtained from DHCP server
        after reset/power-up. This feature allows the device to quickly
        restore its previous IP configuration.

choice LWIP_DHCP_RESTORE_STORAGE_BACKEND
    prompt "DHCP IP restore storage backend"
    default LWIP_DHCP_RESTORE_LAST_IP_NONE
    depends on LWIP_DHCP_RESTORE_LAST_IP
    help
        Select the storage backend for DHCP IP address restoration.

    config LWIP_DHCP_RESTORE_LAST_IP_NONE
        bool "No persistent storage"
        help
            Do not use persistent storage for DHCP IP address.
            IP address will only be cached in RAM.

    config LWIP_DHCP_RESTORE_LAST_IP_FROM_NVS
        bool "Restore last IP from NVS"
        help
            Store and restore last DHCP IP address from Non-Volatile Storage (NVS).
            This allows the IP address to persist across power cycles.

    config LWIP_DHCP_RESTORE_LAST_IP_FROM_LISA_KV
        bool "Restore last IP from LISA KV"
        help
            Store and restore last DHCP IP address from LISA KV storage.
            This allows the IP address to persist across power cycles using
            the LISA KV key-value storage system.

endchoice

config LWIP_DHCP_IP_ADDR_KV_KEY
    string "DHCP IP address KV storage key"
    default "lwip.dhcp_ip_addr"
    depends on LWIP_DHCP_RESTORE_LAST_IP_FROM_LISA_KV
    help
        The key name used to store DHCP IP address in LISA KV storage.
        Default is "lwip.dhcp_ip_addr".

config LWIP_HOOK_NETCONN_EXTERNAL_RESOLVE
    bool "lwip dns custom hook"
    default n

endif # LWIP
```

## arcs-sdk/soc/arcs/hal/chip/arcs/mbedtls/Kconfig
```kconfig
config ARCS_HAL_MBEDTLS
    bool "Enable ARCS HAL mbedTLS"
    default n
    help
        Enable mbedTLS cryptographic library support in ARCS HAL.
        Provides ECC, RSA, and other cryptographic operations.

        HSU (Hardware Speed-Up) acceleration is automatically enabled for optimal
        WiFi performance. Without HSU, WiFi handshakes may fail due to slow crypto.

if ARCS_HAL_MBEDTLS

config ARCS_HAL_MBEDTLS_CFG_HSU
    bool "Internal config: Hardware Speed-Up (HSU) acceleration for mbedTLS crypto operations."
    default y
    depends on ARCS_HAL_MBEDTLS
    help
        Internal config: Hardware Speed-Up (HSU) acceleration for mbedTLS crypto operations.
        This is automatically enabled when ARCS_HAL_MBEDTLS is selected.


choice ARCS_HAL_MBEDTLS_VERSION
    prompt "mbedTLS Version"
    default ARCS_HAL_MBEDTLS_VERSION_2_28_9
    help
        Select the mbedTLS library version to use.

    config ARCS_HAL_MBEDTLS_VERSION_2_28_9
        bool "mbedTLS 2.28.9"
        help
            Use mbedTLS version 2.28.9 (LTS version)

    config ARCS_HAL_MBEDTLS_VERSION_3_6_4
        bool "mbedTLS 3.6.4"
        help
            Use mbedTLS version 3.6.4 (Latest stable version)
endchoice

config ARCS_HAL_MBEDTLS_VER
    string
    default "mbedtls-2.28.9" if ARCS_HAL_MBEDTLS_VERSION_2_28_9
    default "mbedtls-3.6.4" if ARCS_HAL_MBEDTLS_VERSION_3_6_4

config ARCS_HAL_MBEDTLS_MAJOR_VER
    int
    default 2 if ARCS_HAL_MBEDTLS_VERSION_2_28_9
    default 3 if ARCS_HAL_MBEDTLS_VERSION_3_6_4

endif # ARCS_HAL_MBEDTLS
```

## arcs-sdk/soc/arcs/hal/chip/arcs/pm_impl/Kconfig
```kconfig
config ARCS_HAL_PM
    bool "Power Management implementation"
    default n
    select ARCS_HAL_IC_LOCK
    help
        Power Management implementation

if ARCS_HAL_PM

config PM_SNAPSHOT_PSRAM_SIZE
    hex "PM PSRAM snapshot region size"
    default 0x10000
    help
        睡眠/唤醒 RAM 镜像保存区大小，从 PSRAM 尾部预留。
        实际工程把 ILM/DLM/SRAM 用满后需要相应放大此值。
        默认 64KB。

config ARCS_HAL_PM_UART_WAKEUP
    bool "PM UART wakeup support"
    default n
    help
        Enable UART as wakeup source from sleep mode.

config ARCS_HAL_PM_CLOSE_AP
    bool "PM close AP subsystem"
    default n
    help
        Power down AP subsystem during low power mode.

config ARCS_HAL_PM_KEEP_ALIVE
    bool "PM ARP keep-alive"
    default n
    help
        Enable ARP keep-alive mechanism during sleep.

config ARCS_HAL_PM_DEBUG
    bool "PM debug mode"
    default n
    help
        Enable PM debug logging and GPIO tracing.

endif # ARCS_HAL_PM
```

## arcs-sdk/soc/arcs/hal/chip/arcs/simsocket/Kconfig
```kconfig
config ARCS_HAL_SIMSOCKET
    bool "Simulated Socket"
    default n
    select RTOS_AL
    select ARCS_HAL_IPC
    help
        Simulated socket
```

## arcs-sdk/soc/arcs/hal/chip/arcs/utils/Kconfig
```kconfig
config ARCS_HAL_UTILS
    bool "Utils"
    default n
    help
        Inter-cores Lock

if ARCS_HAL_UTILS

endif
```

## arcs-sdk/soc/arcs/hal/chip/arcs/wcnd/Kconfig
```kconfig
config ARCS_HAL_WCND
    bool "Enable ARCS HAL WCND"
    depends on WIFI || BLE || BT
    default n
    help
        Enable WCND (Wireless Controller Network) support.
        Required by WiFi, BLE and BT for shared RF hardware initialization.

if ARCS_HAL_WCND
    choice
        prompt "mac addr implementation"
        default ARCS_HAL_WCND_MAC_TRUE
        
        config ARCS_HAL_WCND_MAC_TRUE
            bool "true mac address from efuse"
        config ARCS_HAL_WCND_MAC_FAKE
            bool "fake mac address"
    endchoice

    config ARCS_HAL_WCND_CFG_DPD_LUNA
        bool "Enable DPD Luna"
        default n
        help
            Enable DPD Luna support

    config ARCS_HAL_WCND_GPADC_IC_MUTEX
        bool "Enable GPADC IC Mutex for multi cores"
        depends on ARCS_HAL_IC_MUTEX
        default n
        help
            Enable GPADC IC Mutex for multi cores
    
    config ARCS_HAL_WCND_RF_SELFCALI_FROM_NV
        bool "Enable RF selfcali from nv"
        default n
        help
            Enable RF selfcali from nv
    
    config ARCS_HAL_WCND_RF_SELFCALI_WRITE_TO_NV
        bool "Enable RF selfcali write to nv"
        default n
        help
            Enable RF selfcali write to nv
    
    config ARCS_HAL_WCND_USE_FLASH_OTP
        bool "Enable RF flash otp"
        default y
        help
            Enable RF flash otp

    config ARCS_HAL_WCND_RF_BOARD_VER
        int "RF Board Version"
        default 0
        help
            RF Board Version

    config ARCS_HAL_WCND_FLASH_WF_MFG_CONF_BASE_ADDR
        hex "WiFi RF mfg conf flash base address"
        default 0
        help
            Flash base address for WiFi PHY/RF manufacture configuration
            (mac address, xo_cap, power offset, rssi offset, power table, ppa gain...).
            Partition size must be no less than 512 bytes.

    config ARCS_HAL_WCND_WIFI_RF_SET_GOLDEN
        int "WiFi RF set golden value enable (1=enable, 0=disable)"
        default 0
        help
            Set to 1 to enable WiFi RF golden value configuration.

    config ARCS_HAL_WCND_XO_CAP_GOLDEN_VAL
        int "XO cap golden value"
        default 0
        help
            Golden value for XO 24M capacitor.

    config ARCS_HAL_WCND_PWR_OFFSET_LOW_GOLDEN_VAL
        int "Power offset golden value for low channel"
        default 0
        help
            Golden value for WiFi power offset on low channel.

    config ARCS_HAL_WCND_PWR_OFFSET_MID_GOLDEN_VAL
        int "Power offset golden value for mid channel"
        default 0
        help
            Golden value for WiFi power offset on mid channel.

    config ARCS_HAL_WCND_PWR_OFFSET_HIGH_GOLDEN_VAL
        int "Power offset golden value for high channel"
        default 0
        help
            Golden value for WiFi power offset on high channel.

    config ARCS_HAL_WCND_RSSI_OFFSET_DSSS_GOLDEN_VAL
        int "RSSI offset golden value for DSSS"
        default 0
        help
            Golden value for WiFi RSSI offset on DSSS mode.

    config ARCS_HAL_WCND_RSSI_OFFSET_OFDM_GOLDEN_VAL
        int "RSSI offset golden value for OFDM"
        default 0
        help
            Golden value for WiFi RSSI offset on OFDM mode.

endif
```

## arcs-sdk/soc/arcs/hal/modules/audio/Kconfig
```kconfig
# BT AUDIO Kconfig 

menu "BT AUDIO"

config BT_AUDIO
    bool "Enable BT Audio"
    default n
    help
        Enable BT Audio support

endmenu
```

## arcs-sdk/soc/arcs/hal/modules/codec/Kconfig
```kconfig
# AUDIO_CODEC Kconfig

menu "Audio AUDIO_CODEC"

config AUDIO_CODEC
    bool "Enable Audio AUDIO_CODEC"
    default n
    help
        Enable audio AUDIO_CODEC support (LC3, SBC, mSBC)

if AUDIO_CODEC

config AUDIO_CODEC_LC3
    bool "Enable LC3 AUDIO_CODEC"
    default y
    help
        Enable LC3 (Low Complexity Communication AUDIO_CODEC) support

config AUDIO_CODEC_SBC
    bool "Enable SBC AUDIO_CODEC"
    default y
    help
        Enable SBC (Subband AUDIO_CODEC) support

config AUDIO_CODEC_MSBC
    bool "Enable mSBC AUDIO_CODEC"
    default y
    help
        Enable mSBC (Modified SBC) support for wideband speech

endif

endmenu
```

## arcs-sdk/soc/arcs/hal/modules/nvs/Kconfig
```kconfig
config ARCS_HAL_NVS
    bool "NVS Support in HAL"
    default n
    help
        Enable NVS support in HAL

if ARCS_HAL_NVS
    config NVS_FLASH_XIP
        bool "NVS Flash XIP"
        default n
        help
            Enable NVS Flash XIP
endif
```
