## arcs-sdk/soc/Kconfig
```kconfig
# Copyright (c) 2025, LISTENAI
# SPDX-License-Identifier: Apache-2.0

rsource "arcs/Kconfig"
```

## arcs-sdk/soc/arcs/Kconfig
```kconfig
# Copyright (c) 2025, LISTENAI
# SPDX-License-Identifier: Apache-2.0

config SOC_ARCS
	bool

if SOC_ARCS

config SOC_HAS_NPU
	bool "SoC has NPU"
	help
		SoC 集成 NPU（神经网络处理单元）。
		由具体型号的 defconfig 自动设置，无需手动开启。

rsource "../common/Kconfig.mem.arcs"

rsource "hal/Kconfig"
rsource "common/startup/Kconfig"
endif # SOC_ARCS

rsource "ls26xx/Kconfig"
```

## arcs-sdk/soc/arcs/common/startup/Kconfig
```kconfig
# Copyright (c) 2025, LISTENAI
# SPDX-License-Identifier: Apache-2.0

config DCACHE_ENABLE
	bool "Enable DCACHE"
	default y

config ICACHE_ENABLE
	bool "Enable ICACHE"
	default y

config BOOT_WITH_WATCHDOG
	bool "boot with watchdog"
	help
		Enable the watchdog in boot

config WATCHDOG_ENABLE
	bool "watchdog enable"
	default y if BOOT_WITH_WATCHDOG
	help
		Enable the watchdog

config PSRAM_INIT
	bool "PSRAM init"
	default y if ARCS_AP_CORE

config CLOCK_INIT
	bool "CLOCK init"
	default y if ARCS_AP_CORE

config ARCS_STARTUP_CUSTOM_LINKER_FILE
	bool "ARCS custom linker file"
```

## arcs-sdk/soc/arcs/hal/Kconfig
```kconfig
menu "arcs hal"

config ARCS_HAL_WARNING_DISABLE
    bool "disable hal warnings"
    default n

config ARCS_FREE_RTOS
    bool "Enable FreeRTOS support"
    default n

choice
    prompt "core type"
    default ARCS_CP_CORE

    config ARCS_AP_CORE
        bool "ap core"
        imply FPU

    config ARCS_CP_CORE
        bool "cp core"

endchoice

config BOOT_HART
    bool "boot hart"
    default y

config HARTID
    int
    default 0 if ARCS_AP_CORE
    default 1 if ARCS_CP_CORE

choice
    prompt "GPDMA initialization level"
    default ARCS_GPDMA_FULL_INIT
    help
      In AP/CP dual-core systems, GPDMA registers only need to be initialized by one core.
      Select the appropriate initialization level for the current core.

    config ARCS_GPDMA_FULL_INIT
        bool "Complete GPDMA initialization"
        help
          Enable full GPDMA initialization including register configuration.
          Only one core in a dual-core system should use this option.

    config ARCS_GPDMA_DATA_ONLY
        bool "GPDMA data structure only"
        help
          Initialize only data structures but skip register initialization.
          Use this for cores that need to use GPDMA but rely on another core
          to initialize the GPDMA hardware registers.
endchoice

config SMP_CPU_COUNT
    int "cpu count"
    default 1

config ARCS_HAL_FAST_FUNC_SRAM_SECTION
    string "_FAST_FUNC_SRAM section"
    default ".fast_text"

rsource "chip/arcs/event/Kconfig"
rsource "chip/arcs/wlif/Kconfig"
rsource "chip/arcs/cli_cmd/Kconfig"
rsource "chip/arcs/driver/Kconfig"
rsource "chip/arcs/wcnd/Kconfig"
rsource "chip/arcs/simsocket/Kconfig"
rsource "chip/arcs/ipc/Kconfig"
rsource "modules/shell/Kconfig"
rsource "modules/vrtc/Kconfig"
rsource "modules/nvs/Kconfig"
rsource "chip/arcs/lwip/Kconfig"
rsource "chip/arcs/lib/Kconfig.wifi"
rsource "chip/arcs/atcmd/Kconfig"
rsource "chip/arcs/flash_if/Kconfig"
rsource "chip/arcs/ic_lock/Kconfig"
rsource "chip/arcs/utils/Kconfig"
rsource "chip/arcs/lib/Kconfig.ble"
rsource "chip/arcs/btos/Kconfig"
rsource "chip/arcs/pm_impl/Kconfig"
rsource "chip/arcs/mbedtls/Kconfig"
rsource "modules/profiles/Kconfig"
rsource "modules/audio/Kconfig"
rsource "modules/codec/Kconfig"

endmenu
```

## arcs-sdk/soc/arcs/hal/chip/arcs/atcmd/Kconfig
```kconfig
config ARCS_HAL_AT_CMD
    bool "Enable ARCS HAL AT CMD"
    default n
    select ARCS_HAL_MODULE_SHELL
    help
        Enable AT CMD support

 config ARCS_HAL_AT_CMD_BT_HCI_MODE
     bool "Enable AT+BT_HCI_MODE (BT HCI test mode)"
     default n
     depends on ARCS_HAL_AT_CMD
     help
         Enable BT HCI test mode handler and its dispatch entry.
```

## arcs-sdk/soc/arcs/hal/chip/arcs/btos/Kconfig
```kconfig
config ARCS_HAL_BTOS_INCLUDE
    bool "Enable ARCS HAL BTOS headers only"
    default n
    help
        Only expose BTOS header files without compiling source.
        Used by CP core for IPC type definitions.

config ARCS_HAL_BTOS
    bool "Enable ARCS HAL BTOS"
    default n
    select ARCS_HAL_BTOS_INCLUDE
    help
        Enable BTOS support
```

## arcs-sdk/soc/arcs/hal/chip/arcs/driver/Kconfig
```kconfig
choice
    prompt "log level"
    default ARCS_HAL_LOG_LEVEL_INFO
    config ARCS_HAL_LOG_LEVEL_NONE
        bool "none"
    config ARCS_HAL_LOG_LEVEL_ERROR
        bool "error"
    config ARCS_HAL_LOG_LEVEL_WARN
        bool "warning"
    config ARCS_HAL_LOG_LEVEL_INFO
        bool "info"
    config ARCS_HAL_LOG_LEVEL_DEBUG
        bool "debug"
    config ARCS_HAL_LOG_LEVEL_VERBOSE
        bool "verbose"
endchoice

config ARCS_HAL_LSF
    bool "Enable ARCS HAL LSF"
    select ARCS_HAL_IC_LOCK
    default n

if ARCS_HAL_LSF
    choice
        prompt "hal lsf type"
        default HAL_LSF_SERVER if ARCS_AP_CORE
        default HAL_LSF_CLIENT if ARCS_CP_CORE

        config HAL_LSF_SERVER
            bool "LSF Server"

        config HAL_LSF_CLIENT
            bool "LSF Client"
    endchoice

    config ARCS_HAL_IC_MUTEX
        bool "Enable ARCS HAL IC Mutex"
        default y

    config ARCS_HAL_SUPPORT_ATOMIC_INSTRUCTIONS
        bool "Enable ARCS HAL Support Atomic Instructions"
        depends on ARCS_HAL_IC_MUTEX
        default y
endif

config ARCS_HAL_DCACHE_COHERENT
    bool "Enable ARCS HAL DCACHE COHERENT"
    default y

config DUAL_FLASH
    bool "Enable ARCS HAL Dual Flash"
    default n
    help
        Enable support for dual flash memory configuration.

config ARCS_HAL_EXT_RAM_SECTION
    string "EXT RAM Section"
    default ".ramcode"
    help
        The section name for the EXT RAM.
        This is used to store the EXT RAM code.

config DUAL_FLASH
    bool "Enable ARCS HAL Dual Flash"
    default n
    help
        Enable support for dual flash memory configuration.
```

## arcs-sdk/soc/arcs/hal/chip/arcs/event/Kconfig
```kconfig
config ARCS_HAL_EVENT
    bool "Enable ARCS HAL Event"
    default n
    help
        Enable Event (Inter-Thread Communication) support
```

## arcs-sdk/soc/arcs/hal/chip/arcs/ipc/Kconfig
```kconfig
config ARCS_HAL_IPC
    bool "Enable ARCS HAL IPC"
    select ARCS_HAL_IC_LOCK
    select RTOS_AL
    default n
    help
        Enable IPC (Inter-Process Communication) support

if ARCS_HAL_IPC
    config ARCS_HAL_IPC_UTILS_IPC_FUNC_SECTION
        string "IPC utils function section"
        default ".itcm_text"
        help
            Enable IPC utils function section

    choice
        prompt "arcs hal wifi/lwip ipc type"
        default ARCS_HAL_IPC_MASTER if LOG_BACKEND_IPC_READER
        default ARCS_HAL_IPC_SLAVE if LOG_BACKEND_IPC_WRITER
        default ARCS_HAL_IPC_MASTER if LWIP
        default ARCS_HAL_IPC_SLAVE if WIFI
        config ARCS_HAL_IPC_SLAVE
            bool "IPC Slave"
            select ARCS_HAL_IPC_MRPC_SERVER_WIFI if WIFI_LWIP_DIFF_CORE
            select ARCS_HAL_IPC_MRPC_CLIENT_LWIP if WIFI_LWIP_DIFF_CORE
        config ARCS_HAL_IPC_MASTER
            bool "IPC Master"
            select ARCS_HAL_IPC_MRPC_CLIENT_WIFI if WIFI_LWIP_DIFF_CORE
            select ARCS_HAL_IPC_MRPC_SERVER_LWIP if WIFI_LWIP_DIFF_CORE
    endchoice

    config ARCS_HAL_IPC_MRPC_SERVER
        bool "Enable MRPC server"
        default y
        help
            Enable MRPC (Message Remote Procedure Call) server support

    config ARCS_HAL_IPC_MRPC_CLIENT
        bool "Enable MRPC client"
        default y
        help
            Enable MRPC (Message Remote Procedure Call) client support

    config ARCS_HAL_IPC_MRPC_SERVER_LWIP
        bool "Enable LWIP MRPC server"
        default n
        select ARCS_HAL_IPC_MRPC_SERVER
        help
            Enable MRPC server for LWIP API

    config ARCS_HAL_IPC_MRPC_CLIENT_LWIP
        bool "Enable LWIP MRPC client"
        default n
        select ARCS_HAL_IPC_MRPC_CLIENT
        help
            Enable MRPC client for LWIP API

    config ARCS_HAL_IPC_MRPC_SERVER_WIFI
        bool "Enable WIFI MRPC server"
        default n
        select ARCS_HAL_IPC_MRPC_SERVER
        help
            Enable MRPC server for WIFI API

    config ARCS_HAL_IPC_MRPC_CLIENT_WIFI
        bool "Enable WIFI MRPC client"
        default n
        select ARCS_HAL_IPC_MRPC_CLIENT
        help
            Enable MRPC client for WIFI API

    config ARCS_HAL_IPC_MRPC_SERVER_NVS
        bool "Enable NVS MRPC server"
        default n
        select ARCS_HAL_IPC_MRPC_SERVER
        help
            Enable MRPC server for NVS API

    config ARCS_HAL_IPC_MRPC_CLIENT_NVS
        bool "Enable NVS MRPC client"
        default n
        select ARCS_HAL_IPC_MRPC_CLIENT
        help
            Enable MRPC client for NVS API

    config ARCS_HAL_IPC_MRPC_SERVER_BT
        bool "Enable BT MRPC server"
        default n
        select ARCS_HAL_IPC_MRPC_SERVER
        help
            Enable MRPC server for BT API (runs on AP core with BLE stack)

    config ARCS_HAL_IPC_MRPC_CLIENT_BT
        bool "Enable BT MRPC client"
        default n
        select ARCS_HAL_IPC_MRPC_CLIENT
        select ARCS_HAL_BTOS_INCLUDE
        help
            Enable MRPC client for BT API (runs on CP core to call BLE remotely)

    config ARCS_HAL_IPC_MRPC_SERVER_BT_S2M
        bool "Enable BT slave-to-master MRPC server"
        default n
        select ARCS_HAL_IPC_MRPC_SERVER
        help
            Enable MRPC server for BT callbacks from the slave/AP image to the
            master/CP image.

    config ARCS_HAL_IPC_MRPC_CLIENT_BT_S2M
        bool "Enable BT slave-to-master MRPC client"
        default n
        select ARCS_HAL_IPC_MRPC_CLIENT
        help
            Enable MRPC client for BT callbacks from the slave/AP image to the
            master/CP image.

    config ARCS_HAL_IPC_MRPC_CLIENT_FLASH_IF
        bool "Enable flash if MRPC client"
        default n
        select ARCS_HAL_IPC_MRPC_CLIENT
        help
            Enable MRPC client for flash if API

    config ARCS_HAL_IPC_MRPC_SERVER_FLASH_IF
        bool "Enable flash if MRPC server"
        default n
        select ARCS_HAL_IPC_MRPC_SERVER
        help
            Enable MRPC server for flash if API

    config ARCS_HAL_IPC_MRPC_CLIENT_UTILS_S2M
        bool "Enable utils MRPC client S2M"
        default n
        select ARCS_HAL_IPC_MRPC_CLIENT
        help
            Enable MRPC client for utils API
    
    config ARCS_HAL_IPC_MRPC_SERVER_UTILS_S2M
        bool "Enable utils MRPC server S2M"
        default n
        select ARCS_HAL_IPC_MRPC_SERVER
        help
            Enable MRPC server for utils API

    config ARCS_HAL_IPC_MRPC_CLIENT_UTILS_M2S
        bool "Enable utils MRPC client M2S"
        default n
        select ARCS_HAL_IPC_MRPC_CLIENT
        help
            Enable MRPC client for utils API
    
    config ARCS_HAL_IPC_MRPC_SERVER_UTILS_M2S
        bool "Enable utils MRPC server M2S"
        default n
        select ARCS_HAL_IPC_MRPC_SERVER
        help
            Enable MRPC server for utils API

    config ARCS_HAL_IPC_MRPC_SERVER_AP_PM_LOCK
        bool "Enable AP PM lock MRPC server"
        default n
        select ARCS_HAL_IPC_MRPC_SERVER
        help
            Enable MRPC server for AP-side remote PM lock control.

    config ARCS_HAL_IPC_MRPC_CLIENT_AP_PM_LOCK
        bool "Enable AP PM lock MRPC client"
        default n
        select ARCS_HAL_IPC_MRPC_CLIENT
        help
            Enable MRPC client for CP-side AP remote PM lock control.
 
    config ARCS_HAL_IPC_HALT_BY_PEER_CORE
        bool "Halt by peer core"
        default n
        help
            Halt by peer core

    config ARCS_HAL_IPC_HALT_PEER_CORE
        bool "Halt peer core"
        default n
        help
            Halt peer core
    
    config ARCS_HAL_IPC_FLASH_AGENT
        bool "Enable flash agent"
        default n
        depends on ARCS_HAL_FLASH_IF
        help
            Enable flash agent

    config ARCS_HAL_IPC_PRINT
        bool "Enable IPC log forwarding"
        default n
        help
            Enable IPC log forwarding through the shared debug ring buffer.
            The forwarding direction is set by ARCS_HAL_IPC_PRINT_WRITER /
            ARCS_HAL_IPC_PRINT_READER and is independent of the IPC
            master/slave role. When neither direction option is set, the
            legacy behavior applies: slave builds forward local logs to the
            peer (writer) and master builds print peer logs (reader).

    config ARCS_HAL_IPC_PRINT_WRITER
        bool "IPC log writer (forward local logs to peer)"
        default n
        select ARCS_HAL_IPC_PRINT
        help
            Forward local logs into the shared IPC debug ring buffer so the
            peer core can print them. Works on either IPC role. The peer
            image must enable ARCS_HAL_IPC_PRINT_READER.

    config ARCS_HAL_IPC_PRINT_READER
        bool "IPC log reader (print peer logs locally)"
        default n
        select ARCS_HAL_IPC_PRINT
        help
            Initialize the shared IPC debug ring buffer and print logs
            forwarded by the peer core. Works on either IPC role. The peer
            image must enable ARCS_HAL_IPC_PRINT_WRITER. Only one image may
            enable the reader.

    if ARCS_HAL_IPC_PRINT

    config ARCS_HAL_IPC_PRINT_BUF_SIZE
        hex "IPC log ring buffer size"
        default 0x00000400
        help
            Shared IPC debug ring buffer size for forwarded log bytes.

    config ARCS_HAL_IPC_PRINT_NOTIFY_THRESHOLD
        int "IPC log notify threshold"
        default 128
        help
            Minimum pending IPC log bytes before the sender actively notifies
            the peer core to drain the shared log ring buffer.

    config ARCS_HAL_IPC_PRINT_POLL_TIMEOUT_MS
        int "IPC log poll timeout (ms)"
        default 3000
        help
            Maximum wait time for the IPC print receive task before it wakes up
            and polls the shared log ring buffer again.

    config ARCS_HAL_IPC_PRINT_SOURCE_TAG
        string "IPC log source tag"
        default "AP"
        help
            Source tag prepended on the IPC master side when printing
            forwarded peer-core logs.

    endif

endif
```

## arcs-sdk/soc/arcs/hal/chip/arcs/lib/Kconfig.ble
```kconfig
menuconfig BLE
    bool "BLE Support"
    default n
    select ARCS_HAL_WCND
    select RTOS_AL
    select ARCS_HAL_BTOS
    select BLE_PROFILE_DISS
    help
        Enable BLE support including core BLE functionality
```
