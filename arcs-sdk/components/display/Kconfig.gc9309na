## arcs-sdk/components/lisa_bluetooth/Kconfig
```kconfig
# LISA Bluetooth Configuration
#
# Copyright (c) 2025, LISTENAI
# SPDX-License-Identifier: Apache-2.0

menuconfig LISA_BLUETOOTH
	bool "Enable Lisa Bluetooth"
	select SDK_MODULE_MBEDTLS
	select ARCS_HAL_CRYPTO
	help
		Enable Lisa Bluetooth component.

if LISA_BLUETOOTH

	config LISA_BLUETOOTH_DEVICE_NAME
		string "Bluetooth device name"
		default "ARCS"
		help
			Device name used for BLE advertising / BT classic.

	config LISA_BLUETOOTH_MAX_DISCOVERED_DEVICES
		int "Maximum discovered Bluetooth devices"
		default 10
		range 1 255
		help
			Maximum number of devices cached during Bluetooth discovery.
			BT Classic inquiry uses the same value as the controller
			response limit for time-based scans.

	config LISA_BLUETOOTH_CLASSIC
		bool "Enable Lisa Bluetooth Classic"
		help
			Enable Lisa Bluetooth Classic component.

	if LISA_BLUETOOTH_CLASSIC
		config LISA_BLUETOOTH_CLASSIC_HFP
			bool "Enable Lisa Bluetooth Classic HFP"
			help
				Enable Lisa Bluetooth Classic HFP component.

		config LISA_BLUETOOTH_HFP_MSBC_SUPPORT
			bool "Enable HFP mSBC wideband speech"
			depends on LISA_BLUETOOTH_CLASSIC_HFP
			default y
			select AUDIO_CODEC
			select AUDIO_CODEC_MSBC
			help
				Enable mSBC/WBS negotiation for HFP calls. Disable this to
				force CVSD/NBS 8 kHz HFP audio.

		config LISA_BLUETOOTH_CLASSIC_AUDIO
			bool "Enable Lisa Bluetooth Classic Audio"
			select LISA_BLUETOOTH_BLE  # Have to enable BLE for now
			select BT_AUDIO
			select BT_MUSIC
			select ARCS_HAL_BT_MUSIC
			select ARCS_HAL_BT_LEA
			select AUDIO_CODEC
			select LISA_BT_AUDIO_FRAMEWORK
			help
				Enable Lisa Bluetooth Classic Audio component.

		if LISA_BLUETOOTH_CLASSIC_AUDIO

			choice
				prompt "BT Classic Audio Role"
				default BT_CLASSIC_ROLE_SINK
				help
					Select the Bluetooth classic audio role.

			config BT_CLASSIC_ROLE_SINK
				bool "Sink Mode (Receiver)"
				help
					Device acts as audio sink (e.g., Bluetooth headset, speaker).
					Receives audio from remote device and plays locally.

					Audio Framework: Auto-selects Local Audio interface

			config BT_CLASSIC_ROLE_SOURCE
				bool "Source Mode (Sender)"
				help
					Device acts as audio source (e.g., smartphone, tablet).
					Captures local audio and sends to remote device.

					Audio Framework: Auto-selects Virtual Audio interface

			endchoice

			config LISA_BLUETOOTH_AUD_TASK_STACK_SIZE
				int "Bluetooth audio task stack size(x4 bytes)"
				default 2048
				help
					AUD task stack size in words. Default matches wifi_bt_demo.

			config LISA_BLUETOOTH_AUD_TASK_PRIORITY
				int "Bluetooth audio task priority"
				default LISA_BLUETOOTH_TASK_PRIORITY
				help
					AUD task priority. Default follows Bluetooth task priority.

			config LISA_BLUETOOTH_AUD_PRO_TASK_STACK_SIZE
				int "Bluetooth audio process task stack size(x4 bytes)"
				default 1536
				help
					AUD_PRO task stack size in words. Default matches wifi_bt_demo.

			config LISA_BLUETOOTH_AUD_PRO_TASK_PRIORITY
				int "Bluetooth audio process task priority"
				default LISA_BLUETOOTH_TASK_PRIORITY
				help
					AUD_PRO task priority. Default follows Bluetooth task priority.

		endif # LISA_BLUETOOTH_CLASSIC_AUDIO
	endif # LISA_BLUETOOTH_CLASSIC

config LISA_BLUETOOTH_BLE
	bool "Enable Lisa Bluetooth BLE"
	help
		Enable Lisa Bluetooth BLE capability for the current image.

config LISA_BLUETOOTH_BLE_NETCFG
	bool "Enable Lisa Bluetooth BLE netcfg"
	depends on LISA_BLUETOOTH_BLE
	help
		Enable BLE-based network configuration support for the current
		image. The local Bluetooth stack image builds the netcfg server,
		while the IPC caller image only keeps the netcfg API bridge.

choice LISA_BLUETOOTH_ROLE
	prompt "Bluetooth role for this image"
	depends on LISA_BLUETOOTH_BLE
	default LISA_BLUETOOTH_ROLE_LOCAL
	help
		Select the Bluetooth responsibility of the current image.

config LISA_BLUETOOTH_ROLE_LOCAL
	bool "Local Bluetooth"
	help
		Build and run the local Bluetooth stack in this image.

config LISA_BLUETOOTH_ROLE_IPC_CALLER
	bool "Bluetooth IPC caller"
	depends on ARCS_HAL_IPC
	help
		Send Bluetooth task/API requests to the peer image through IPC.

config LISA_BLUETOOTH_ROLE_IPC_RECEIVER
	bool "Bluetooth IPC receiver"
	depends on ARCS_HAL_IPC
	help
		Receive Bluetooth task/API requests from the peer image and run
		the local Bluetooth stack in this image.

endchoice

config LISA_BLUETOOTH_BUILD_LOCAL_STACK
	bool
	default y if LISA_BLUETOOTH_BLE && (LISA_BLUETOOTH_ROLE_LOCAL || LISA_BLUETOOTH_ROLE_IPC_RECEIVER)
	select BLE
	select ARCS_HAL_AT_CMD

config LISA_BLUETOOTH_BUILD_HOGPD_PROFILE
	bool
	default y if LISA_BLUETOOTH_BUILD_LOCAL_STACK
	select BLE_PROFILE_HOGPD

config LISA_BLUETOOTH_BUILD_BASS_PROFILE
	bool
	default y if LISA_BLUETOOTH_BUILD_LOCAL_STACK
	select BLE_PROFILE_BASS

config LISA_BLUETOOTH_BUILD_NETCFG_BLE_SERVER
	bool
	default y if LISA_BLUETOOTH_BLE_NETCFG && LISA_BLUETOOTH_BUILD_LOCAL_STACK
	select BLE_PROFILE_NETCFG_BLES

config LISA_BLUETOOTH_CUSTOM_NETCFG
	bool "Use application-provided netcfg callback instead of the default"

config LISA_BLUETOOTH_BUILD_IPC_CLIENT
	bool
	depends on ARCS_HAL_IPC
	default y if LISA_BLUETOOTH_BLE && LISA_BLUETOOTH_ROLE_IPC_CALLER
	select ARCS_HAL_IPC_MRPC_CLIENT_BT
	select ARCS_HAL_IPC_MRPC_SERVER_BT_S2M if LISA_BLUETOOTH_BLE_NETCFG

config LISA_BLUETOOTH_BUILD_IPC_SERVER
	bool
	depends on ARCS_HAL_IPC
	default y if LISA_BLUETOOTH_BLE && LISA_BLUETOOTH_ROLE_IPC_RECEIVER
	select ARCS_HAL_IPC_MRPC_SERVER_BT
	select ARCS_HAL_IPC_MRPC_CLIENT_BT_S2M if LISA_BLUETOOTH_BLE_NETCFG

config LISA_BLUETOOTH_WHITE_LIST_ADD
	bool "Enable BLE white list add"
	default y
	help
		If enabled, add discovered devices to BLE white list.

config LISA_BLUETOOTH_RESOVLE_LIST_ADD
	bool "Enable BLE resolve list add"
	default y
	help
		If enabled, add devices to BLE resolve list (RAL).

config LISA_BLUETOOTH_NVDS
	bool "Enable Lisa Bluetooth NVDS"
	help
		Enable Lisa Bluetooth NVDS component.

choice LISA_BLUETOOTH_STORAGE_BACKEND
	prompt "Bluetooth pairing storage backend"
	default LISA_BLUETOOTH_STORAGE_NONE
	help
		Select where Bluetooth pairing data is persisted.

	config LISA_BLUETOOTH_STORAGE_NONE
		bool "Disabled"
		help
			Do not persist Bluetooth pairing data.

	config LISA_BLUETOOTH_STORAGE_NVS
		bool "NVS"
		depends on ARCS_HAL_NVS || ARCS_HAL_IPC_MRPC_CLIENT_NVS
		help
			Save Bluetooth pairing data through the legacy NVDS/NVS backend.

	config LISA_BLUETOOTH_STORAGE_KV
		bool "Lisa KV"
		select LISA_KV
		help
			Save Bluetooth pairing data through Lisa KV.

endchoice

config LISA_BLUETOOTH_TASK_STACK_SIZE
	int "Bluetooth task stack size(x4 bytes)"
	default 2048
	help
		Bluetooth task stack size in words.

config LISA_BLUETOOTH_TASK_PRIORITY
	int "Bluetooth task priority"
	default 9
	help
		Bluetooth task priority.

endif # LISA_BLUETOOTH
```

## arcs-sdk/components/lisa_evs/Kconfig
```kconfig
menu "lisa evs configuration"

    config LISA_EVS
        bool "lisa evs support"
        default n

endmenu
```

## arcs-sdk/components/lisa_evt_pub/Kconfig
```kconfig
# Copyright (c) 2025, LISTENAI
# SPDX-License-Identifier: Apache-2.0

config LISA_EVT_PUBLISHER
	bool "event publisher for lisa"
	select SDK_MODULE_COLLECTIONS_C
```

## arcs-sdk/components/lisa_http/Kconfig
```kconfig
# Copyright (c) 2025, LISTENAI
# SPDX-License-Identifier: Apache-2.0

menuconfig LISA_HTTP
	bool "lisa http"
	help
		Enable LISA HTTP client library for HTTP/HTTPS requests.
```

## arcs-sdk/components/lisa_jpeg/Kconfig
```kconfig
# Copyright (c) 2025, LISTENAI
# SPDX-License-Identifier: Apache-2.0

menuconfig LISA_JPEG
	bool "LISA JPEG codec"
	help
	  JPEG codec component migrated from soc/arcs/hal/chip/arcs/ls_jpeg,
	  providing hardware JPEG encode/decode interfaces.

if LISA_JPEG

config LISA_JPEG_DECODER_RGB565_ONLY
	bool "JPEG decoder RGB565 only"
	help
	  Force decoder output format to RGB565 only.

config LISA_JPEG_DECODER_WAIT_TIMEOUT_US
	int "JPEG decoder DMA wait timeout (us)"
	range 1000 1000000
	default 50000
	help
	  Timeout for waiting JPEG decode DMA completion.
	  Shorter timeout avoids long stalls on occasional hardware timeout.

config LISA_JPEG_ENCODE_GPDMA_IN_CH
	int "JPEG encode GPDMA input channel"
	range 0 15
	default 0

config LISA_JPEG_ENCODE_DMA2D_OUT_CH
	int "JPEG encode DMA2D output channel"
	range 0 15
	default 6

config LISA_JPEG_ENCODE_EXT_DMA2D_IN_CH
	int "JPEG encode-ext DMA2D input channel"
	range 0 15
	default 6

config LISA_JPEG_ENCODE_EXT_DMA2D_TRANSFER_CH
	int "JPEG encode-ext DMA2D transfer channel"
	range 0 15
	default 7

config LISA_JPEG_ENCODE_EXT_DMA2D_OUT_CH
	int "JPEG encode-ext DMA2D output channel"
	range 0 15
	default 8

config LISA_JPEG_DECODE_GPDMA_IN_CH
	int "JPEG decode GPDMA input channel"
	range 0 15
	default 2

config LISA_JPEG_DECODE_GPDMA_OUT_CH
	int "JPEG decode GPDMA output channel"
	range 0 15
	default 3

endif
```

## arcs-sdk/components/lisa_log/Kconfig
```kconfig
menu "log configuration"

config LOG
    bool "enable log"
    default n

if LOG

choice
    prompt "log frontend"
    default LOG_FRONTEND_EASYLOGGER
    config LOG_FRONTEND_EASYLOGGER
        bool "easylogger frontend"
        select SDK_MODULE_EASYLOGGER
endchoice

choice
    prompt "log backend"
    default LOG_BACKEND_UART
    config LOG_BACKEND_UART
        bool "uart backend"
endchoice

config LOG_MODE_ASYNC
    bool "asynchronous mode"
    default y
    select EASYLOGGER_LOG_MODE_ASYNC if SDK_MODULE_EASYLOGGER
    help
        Enable asynchronous logging mode for better performance.
        Logs will be buffered and output in a separate task.

if LOG_MODE_ASYNC
config LOG_ASYNC_BUF_SIZE
    int "asynchronous buffer size"
    default 10240
    help
        Size of the buffer for asynchronous logging (in bytes).
        Larger buffer can handle more log messages but uses more memory.

config LOG_ASYNC_TASK_STACK_SIZE
    int "asynchronous task stack size"
    default 512
    help
        Stack size for the asynchronous logging task (in bytes).
        Increase this if you experience stack overflow in log task.

config LOG_ASYNC_TASK_PRIORITY
    int "asynchronous task priority"
    default 1
    help
        Priority of the asynchronous logging task.
        Higher value means higher priority (depends on your RTOS).
endif

config LOG_LINE_BUF_SIZE
    int "line buffer size"
    default 1024
    help
        Maximum size of a single log line (in bytes).
        Log messages longer than this will be truncated.

config LOG_USE_POSIX_TIME
    bool "use POSIX time"
    default n
    help
        Enable this to use POSIX time functions for timestamps.
        Requires POSIX time support in your system.

config LOG_BACKEND_SYS_NAME
    string "system log backend name"
    default "sys.log"
    help
        Define the name of the system log backend.
        This name will be used to identify the log backend in the system.
endif

choice
    prompt "log level"
    default LOG_LEVEL_INFO
    config LOG_LEVEL_ASSERT
        bool "assert"
        select EASYLOGGER_LOG_LEVEL_ASSERT if SDK_MODULE_EASYLOGGER
    config LOG_LEVEL_ERROR
        bool "error"
        select EASYLOGGER_LOG_LEVEL_ERROR if SDK_MODULE_EASYLOGGER
    config LOG_LEVEL_WARN
        bool "warning"
        select EASYLOGGER_LOG_LEVEL_WARN if SDK_MODULE_EASYLOGGER
    config LOG_LEVEL_INFO
        bool "info"
        select EASYLOGGER_LOG_LEVEL_INFO if SDK_MODULE_EASYLOGGER
    config LOG_LEVEL_DEBUG
        bool "debug"
        select EASYLOGGER_LOG_LEVEL_DEBUG if SDK_MODULE_EASYLOGGER
    config LOG_LEVEL_VERBOSE
        bool "verbose"
        select EASYLOGGER_LOG_LEVEL_VERBOSE if SDK_MODULE_EASYLOGGER
endchoice

endmenu
```
