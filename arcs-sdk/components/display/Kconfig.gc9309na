## arcs-sdk/components/display/Kconfig.gc9309na
```kconfig
menu "display gc9309na configuration"


if LISA_DISPLAY_GC9309NA

    config DISPLAY_GC9309NA_WIDTH
        int "display screen width"
        default 170
        help
        The pixel length in the x-axis direction of the display screen, the maximum value is 172.
        
    config DISPLAY_GC9309NA_HEIGHT
        int "display screen height"
        default 320
        help
        The pixel length in the y-axis direction of the display screen, the maximum value is 640.

    config DISPLAY_GC9309NA_X_OFFSET
        int "display screen x offset"
        default 35
        help
        The pixel offset in the x-axis direction of the display screen.

    config DISPLAY_GC9309NA_Y_OFFSET
        int "screen y offset"
        default 0
        help
        The pixel offset in the y-axis direction of the display screen.
    
    config ROTATE_BUF_MAX_HEIGHT
        int "roate buffer buffer max height"
        default DISPLAY_GC9309NA_WIDTH

    config USE_TRANS_CTX
        bool "use trans context"
        default y
endif

endmenu
```

## arcs-sdk/components/display/Kconfig.nv3030b
```kconfig
# Kconfig.nv3030b
#
# Copyright (c) 2024, LISTENAI
#
# SPDX-License-Identifier: Apache-2.0

if LISA_DISPLAY_NV3030B

config DISPLAY_NV3030B_WIDTH
    int "Width of the NV3030B display"
    default 170

config DISPLAY_NV3030B_HEIGHT
    int "Height of the NV3030B display"
    default 320

config DISPLAY_NV3030B_X_OFFSET
    int "X offset of the NV3030B display"
    default 35

config DISPLAY_NV3030B_Y_OFFSET
    int "Y offset of the NV3030B display"
    default 0

    config ROTATE_BUF_MAX_HEIGHT
        int "Rotate buffer max height for NV3030B"
        default DISPLAY_NV3030B_WIDTH
        help
          Specifies the maximum height of the buffer used for rotation operations.
          This is typically related to the display's width or height.

    config USE_TRANS_CTX
        bool "Use transaction context for NV3030B"
        default y
        select LISA_DISPLAY_INTERFACE_SPI_4_LINE
        help
          Enables the transaction context layer for the NV3030B driver,
          which is required for its operation and 4-line SPI interface.

endif # LISA_DISPLAY_NV3030B
```

## arcs-sdk/components/display/Kconfig.ssd1683
```kconfig
menu "display ssd1683 configuration"


if LISA_DISPLAY_SSD1683

    config DISPLAY_SSD1683_WIDTH
        int "screen width"
        default 400
        help
        The pixel length in the x-axis direction of the display screen, the maximum value is 240.

    config DISPLAY_SSD1683_HEIGHT
        int "screen height"
        default 300
        help
        The pixel length in the y-axis direction of the display screen, the maximum value is 416.

    config DISPLAY_SSD1683_X_OFFSET
        int "screen x offset"
        default 0
        help
        The pixel offset in the x-axis direction of the display screen.

    config DISPLAY_SSD1683_Y_OFFSET
        int "screen y offset"
        default 0
        help
        The pixel offset in the y-axis direction of the display screen.

    config ROTATE_BUF_MAX_HEIGHT
        int "roate buffer buffer max height"
        default DISPLAY_SSD1683_WIDTH

    config USE_TRANS_CTX
        bool "use trans context"
        default y
        select LISA_DISPLAY_INTERFACE_SPI_4_LINE

    config USE_OPT_LUT_TABLE
        bool "use <One-Time Programming> LUT table"
        default n
        help
            If enabled, the LUT table stored in the SSD1683 OTP memory will be used.
            Otherwise, the default LUT table defined in the driver will be used.

endif

endmenu
```

## arcs-sdk/components/display/Kconfig.st7789p3
```kconfig
menu "display st7789p3 configuration"


if LISA_DISPLAY_ST7789P3

    config DISPLAY_ST7789P3_WIDTH
        int "screen width"
        default 170
        help
        The pixel length in the x-axis direction of the display screen, the maximum value is 170.

    config DISPLAY_ST7789P3_HEIGHT
        int "screen height"
        default 320
        help
        The pixel length in the y-axis direction of the display screen, the maximum value is 320.

    config DISPLAY_ST7789P3_X_OFFSET
        int "screen x offset"
        default 35
        help
        The pixel offset in the x-axis direction of the display screen.

    config DISPLAY_ST7789P3_Y_OFFSET
        int "screen y offset"
        default 0
        help
        The pixel offset in the y-axis direction of the display screen.

    config ROTATE_BUF_MAX_HEIGHT
        int "roate buffer buffer max height"
        default DISPLAY_ST7789P3_WIDTH

    config USE_TRANS_CTX
        bool "use trans context"
        default y
        select LISA_DISPLAY_INTERFACE_SPI_4_LINE
endif

endmenu
```

## arcs-sdk/components/display/Kconfig.st7789v
```kconfig
menu "display st7789v configuration"


if LISA_DISPLAY_ST7789V

    config DISPLAY_ST7789V_WIDTH
        int "screen width"
        default 240
        help
        The pixel length in the x-axis direction of the display screen, the maximum value is 240.

    config DISPLAY_ST7789V_HEIGHT
        int "screen height"
        default 320
        help
        The pixel length in the y-axis direction of the display screen, the maximum value is 320.

    config DISPLAY_ST7789V_X_OFFSET
        int "screen x offset"
        default 0
        help
        The pixel offset in the x-axis direction of the display screen.

    config DISPLAY_ST7789V_Y_OFFSET
        int "screen y offset"
        default 0
        help
        The pixel offset in the y-axis direction of the display screen.

    config ROTATE_BUF_MAX_HEIGHT
        int "roate buffer buffer max height"
        default DISPLAY_ST7789V_WIDTH

    config USE_TRANS_CTX
        bool "use trans context"
        default y
        select LISA_DISPLAY_INTERFACE_SPI_4_LINE
endif

endmenu
```

## arcs-sdk/components/display/Kconfig.st77926
```kconfig
menu "display st77926 configuration"


if LISA_DISPLAY_ST77926

    config DISPLAY_ST77926_WIDTH
        int "screen width"
        default 320
        help
        The pixel length in the x-axis direction of the display screen, the maximum value is 320.

    config DISPLAY_ST77926_HEIGHT
        int "screen height"
        default 480
        help
        The pixel length in the y-axis direction of the display screen, the maximum value is 480.

    config DISPLAY_ST77926_X_OFFSET
        int "screen x offset"
        default 0
        help
        The pixel offset in the x-axis direction of the display screen.

    config DISPLAY_ST77926_Y_OFFSET
        int "screen y offset"
        default 0
        help
        The pixel offset in the y-axis direction of the display screen.

endif

endmenu
```

## arcs-sdk/components/display/Kconfig.uc8253c
```kconfig
menu "display uc8253c configuration"


if LISA_DISPLAY_UC8253C

    config DISPLAY_UC8253C_WIDTH
        int "screen width"
        default 240
        help
        The pixel length in the x-axis direction of the display screen, the maximum value is 240.

    config DISPLAY_UC8253C_HEIGHT
        int "screen height"
        default 416
        help
        The pixel length in the y-axis direction of the display screen, the maximum value is 416.

    config DISPLAY_UC8253C_X_OFFSET
        int "screen x offset"
        default 0
        help
        The pixel offset in the x-axis direction of the display screen.

    config DISPLAY_UC8253C_Y_OFFSET
        int "screen y offset"
        default 0
        help
        The pixel offset in the y-axis direction of the display screen.

    config ROTATE_BUF_MAX_HEIGHT
        int "roate buffer buffer max height"
        default DISPLAY_UC8253C_WIDTH

    config USE_TRANS_CTX
        bool "use trans context"
        default y
        select LISA_DISPLAY_INTERFACE_SPI_4_LINE
endif

endmenu
```

## arcs-sdk/components/display/trans_ctx/Kconfig.trans_ctx
```kconfig
menu "display transfer context"

    choice LISA_DISPLAY_INTERFACE
        prompt "lisa display interface"
        default LISA_DISPLAY_INTERFACE_QSPI

        config LISA_DISPLAY_INTERFACE_QSPI
            bool "Qspi interface"

        config LISA_DISPLAY_INTERFACE_SPI_4_LINE
            bool "4 line serial"

        config LISA_DISPLAY_INTERFACE_SPI_3_LINE
            bool "3 line serial"

        config LISA_DISPLAY_INTERFACE_RGB
            bool "rgb interface"
    endchoice

    config ROTATE_BUF_WIDTH
        int "rotate buf width"
        default 16

endmenu
```

## arcs-sdk/components/exclib/Kconfig
```kconfig
# Copyright (c) 2025, LISTENAI
# SPDX-License-Identifier: Apache-2.0

config EXCLIB
	bool "exclib"
	help
		exclib is a library for extending the Clib
```

## arcs-sdk/components/flash/Kconfig
```kconfig
menu "lisa flash msg configuration"

    config LISA_FLASH_MSG
        bool "lisa flash msg support"
        default n

endmenu
```

## arcs-sdk/components/h264dec/Kconfig
```kconfig
# SPDX-License-Identifier: Apache-2.0

menu "H264 decoder"

config H264DEC
    bool "Enable the H264 software decoder"
    default n
    help
        H.264 Baseline Profile (CAVLC, I/P slice) pure C software decoder,
        ported from TinyH264. Outputs YUV420P planar frames, intended to be
        paired with the DMA2D yuv420->RGB hardware converter for display.

config H264DEC_MAX_W
    int "Maximum supported video width"
    default 240
    range 16 1920
    depends on H264DEC
    help
        Frame buffer allocation ceiling. Streams whose SPS declares a larger
        resolution are rejected at runtime.

config H264DEC_MAX_H
    int "Maximum supported video height"
    default 240
    range 16 1920
    depends on H264DEC
    help
        Frame buffer allocation ceiling. Streams whose SPS declares a larger
        resolution are rejected at runtime.

config H264DEC_MAX_REFS
    int "Maximum reference frames"
    default 3
    range 1 3
    depends on H264DEC
    help
        Compile-time upper bound of stored reference pictures. Total picture
        memory is (1 + refs) * 1.5 * W * H bytes; the active count can be
        lowered at runtime via h264_dec_set_max_refs().

config H264DEC_MAX_NAL
    int "Maximum single NAL payload size in bytes"
    default 32768
    range 4096 262144
    depends on H264DEC
    help
        Scratch buffer size for emulation-prevention stripping, must cover
        the largest NAL unit the caller feeds.

endmenu
```

## arcs-sdk/components/httpdns/Kconfig
```kconfig
# Copyright (c) 2025, LISTENAI
# SPDX-License-Identifier: Apache-2.0

menu "HTTPDNS"

config HTTPDNS
	bool "Enable HTTPDNS support"
	imply LWIP_HOOK_NETCONN_EXTERNAL_RESOLVE
	help
			Enable HTTP-based DNS resolution to bypass DNS pollution.

choice HTTPDNS_PROVIDER
	prompt "HTTPDNS Provider"
	default HTTPDNS_USE_ALIYUN
	depends on HTTPDNS

config HTTPDNS_USE_ALIYUN
	bool "Aliyun HTTPDNS"
	imply CJSON
	help
			Use Aliyun HTTPDNS service.

endchoice

orsource "kconfig.httpdns.aliyun"

endmenu
```

## arcs-sdk/components/httpdns/kconfig.httpdns.aliyun
```kconfig
config HTTPDNS_ALIYUN_ACCOUNT_ID
    string "Aliyun HTTPDNS Account ID"
    default ""
    depends on HTTPDNS_USE_ALIYUN
    help
      Aliyun HTTPDNS account ID.
```

## arcs-sdk/components/ipclsf/Kconfig
```kconfig
# Copyright (c) 2025, LISTENAI
# SPDX-License-Identifier: Apache-2.0

menuconfig IPC_LSF
	bool "based on lsf's inter-core communication module"
	select ARCS_HAL_LSF
	help
		Enable inter-core communication module based on LSF (Low-Speed Framework).

if IPC_LSF

choice
prompt "lsf type"

config LSF_CLIENT
	bool "lsf client"
	depends on HAL_LSF_CLIENT

config LSF_SERVER
	bool "lsf server"
	depends on HAL_LSF_SERVER

endchoice

config LSF_IC_MESSAGE_DEPRECATED
	bool "lsf ic message api deprecated"
	help
			lsf ic message api deprecated

config LSF_IC_MESSAGE_EP_ID
	int "lsf ic message endpoint id"
	default 5
	range 0 15
	help
		lsf ic message endpoint id

orsource "Kconfig.diskmem"

endif

menuconfig IPC_CIDU
	bool "启用 VenusA CIDU 共享内存核间通信模块"
	depends on SOC_VENUSA
	depends on !IPC_LSF
	help
		启用基于 VenusA CIDU 中断和共享内存邮箱的 ic_message 后端。
		CIDU 只作为门铃使用，消息载荷存放在共享邮箱中。

if IPC_CIDU

config IPC_CIDU_SHMEM_BASE
	hex "CIDU IPC 共享内存起始地址"
	default MEM_IPC_BASE if MEM_IPC_ISOLATED
	default 0x20000000
	help
		AP/CP 两侧共同使用的共享邮箱起始地址。两侧镜像必须配置为
		同一个值，并且该区域必须从普通 SRAM 和算法 APRAM 中预留出来。

config IPC_CIDU_SHMEM_SIZE
	hex "CIDU IPC 共享内存大小"
	default MEM_IPC_SIZE if MEM_IPC_ISOLATED
	default 0x00001000
	help
		CIDU 共享邮箱大小。实现会在构建阶段检查配置的 ring 是否能放入
		该区域，AP/CP 两侧镜像必须保持一致。

config IPC_CIDU_RING_ENTRY_COUNT
	int "CIDU IPC ring entry count"
	default 16
	range 2 64
	help
		Number of entries in each one-way message ring. One entry is reserved
		to distinguish full and empty ring states.

config IPC_CIDU_PEER_CORE_AUTO
	bool "Automatically select peer core"
	default y
	help
		When enabled, the peer core is selected as local_core XOR 1. This is
		suitable for the two-core VenusA AP/CP topology.

config IPC_CIDU_PEER_CORE_ID
	int "CIDU IPC peer core id"
	default 0
	range 0 1
	depends on !IPC_CIDU_PEER_CORE_AUTO
	help
		Peer core id used when automatic peer selection is disabled.

config IPC_CIDU_IRQ_VECTOR
	int "CIDU IPC interrupt vector"
	default 19
	help
		VenusA HAL demos use IRQ_IDU_VECTOR (19) for CIDU ICI delivery.
		Override this only if the BSP routes CIDU ICI to a different vector.

config IPC_CIDU_SEMAPHORE_ID
	int "CIDU IPC hardware semaphore id"
	default 0
	range 0 31
	help
		CIDU semaphore used only to serialize shared mailbox initialization.

config IPC_CIDU_WORKER_STACK_SIZE
	int "CIDU IPC worker stack size"
	default 2048

config IPC_CIDU_WORKER_PRIORITY
	int "CIDU IPC worker priority"
	default 5
	range 0 10
	help
		FreeRTOS task priority used by the CIDU receive worker. The SDK
		FreeRTOS port uses configMAX_PRIORITIES=11, so valid values are
		0..10.

endif

config IC_MESSAGE_AUTO_INIT
	bool "Automatically initialize ic_message before device init"
	depends on SYS_INIT
	depends on IPC_LSF || IPC_CIDU
	help
		Initialize ic_message from SYS_INIT at PRE_DEVICES_INIT so device
		drivers can register ic_message callbacks during LISA device init.
```

## arcs-sdk/components/ipclsf/Kconfig.diskmem
```kconfig
config DISK_MEM
    bool "disk memory"
    default y

if DISK_MEM

config DISK_MEMORY_CACHE
    bool "disk memory cache "
    default n
    
config DISK_MEM_PSRAM_BASE
    hex "Disk memory PSRAM base address"
    default 0x28000000

config DISK_MEM_THREAD_PRIORITY
    int "Disk memory thread priority"
    default 10

config DISK_MEM_THREAD_STACK_SIZE
    int "Disk memory thread stack size"
    default 0x600

choice
    prompt "disk memory type"
    default DISK_MEM_SERVER if LSF_CLIENT
    default DISK_MEM_CLIENT if LSF_SERVER
    config DISK_MEM_CLIENT
        bool "disk memory client"
    
    config DISK_MEM_SERVER
        bool "disk memory server"

endchoice

if DISK_MEM_SERVER

    
    config DISK_MEM_SD_INDEX
        int "Disk memory SD index"
        default 0
endif

endif
```

## arcs-sdk/components/irq_proxy/Kconfig
```kconfig
# Copyright (c) 2025, LISTENAI
# SPDX-License-Identifier: Apache-2.0

menu "irq proxy configuration"

	config IRQ_PROXY
		bool "irq proxy support"

endmenu
```

## arcs-sdk/components/libs/Kconfig
```kconfig
# Copyright (c) 2019 Peter Bigot Consulting, LLC
# SPDX-License-Identifier: Apache-2.0

config SCANPEN_DICT
	bool "SCANPEN Dictionery"
	default n
```

## arcs-sdk/components/lis_algo/Kconfig
```kconfig
# Copyright (c) 2025, LISTENAI
# SPDX-License-Identifier: Apache-2.0

menu "lis algo"

config LIS_ALGO
	bool "lis algo"

config LIS_ALGO_WORDSEG
	bool "lis algo"

endmenu
```
