## arcs-sdk/components/lisa_porting/net/Kconfig
```kconfig
menu "lisa network configuration"

    config LISA_NETWORK
        bool "lisa network support"
        default n

endmenu
```

## arcs-sdk/components/lisa_porting/os/Kconfig
```kconfig
menu "lisa os configuration"

    config LISA_OS
        bool "lisa os support"
        default n

endmenu
```

## arcs-sdk/components/lisa_shell/Kconfig
```kconfig
# LISA Shell Configuration
#
# Copyright (c) 2025, LISTENAI
# SPDX-License-Identifier: Apache-2.0

menuconfig LISA_SHELL
	bool "Enable LISA Shell"
	select SDK_MODULE_LETTER_SHELL
	select LISA_PORTING
	help
			Enable LISA Shell component for command line interface support.

if LISA_SHELL

config SDK_MODULE_LETTER_SHELL_CONFIG_FILE
	string
	default "shell_cfg_user.h"

config LISA_SHELL_TASK_STACK_SIZE
	int "Shell task stack size"
	default 1024
	help
			Stack size for the shell task in bytes.

config LISA_SHELL_TASK_PRIORITY
	int "Shell task priority"
	default 5
	range 0 31
	help
			Priority for the shell task. Higher values mean higher priority.
			Range: 0 (lowest) to configMAX_PRIORITIES-1 (highest).

config LISA_SHELL_BUFFER_SIZE
	int "Shell command buffer size"
	default 512
	help
			Size of the shell command buffer in bytes.

config LISA_SHELL_RX_BUF_SIZE
	int "UART receive buffer size"
	default 128
	help
			Size of the UART receive buffer for shell input in bytes.

choice LISA_SHELL_RX_MODE
	prompt "Shell UART receive mode"
	default LISA_SHELL_RX_MODE_POLL_IN if LISA_PM
	default LISA_SHELL_RX_MODE_RECV_ASYNC
	help
			Select the UART receive mode used by LISA Shell.

config LISA_SHELL_RX_MODE_RECV_ASYNC
	bool "Receive with async UART buffer"
	help
			Use the original receive path: enable the UART circular receive
			buffer and read shell input through lisa_uart_read_sync().

config LISA_SHELL_RX_MODE_POLL_IN
	bool "Receive with poll_in"
	help
			Use lisa_uart_poll_in() to poll shell input. When no data is
			available, the shell task sleeps for the configured poll interval
			to reduce CPU usage.

endchoice

config LISA_SHELL_POLL_IN_INTERVAL_MS
	int "Shell poll_in interval in milliseconds"
	default 100
	depends on LISA_SHELL_RX_MODE_POLL_IN
	help
			Sleep interval used by the shell task when poll_in mode has no
			input data available.

config LISA_SHELL_SUPPORT_END_LINE
	bool "Support shell end line mode"
	default y
	help
			Enable shell end line mode support.

config LISA_SHELL_ENTER_LF
	bool "Use LF as command line enter trigger"
	default y
	help
			Use LF (Line Feed, '\n') as command line enter trigger.
			Can be enabled together with SHELL_ENTER_CR.

config LISA_SHELL_ENTER_CR
	bool "Use CR as command line enter trigger"
	default y
	help
			Use CR (Carriage Return, '\r') as command line enter trigger.
			Can be enabled together with SHELL_ENTER_LF.

config LISA_SHELL_ENTER_CRLF
	bool "Use CRLF as command line enter trigger"
	help
			Use CRLF ('\r\n') as command line enter trigger.
			Cannot be enabled together with SHELL_ENTER_LF or SHELL_ENTER_CR.

config LISA_SHELL_SCAN_BUFFER
	int "Shell formatted input buffer size"
	default 128
	help
			Buffer size for shell formatted input. Set to 0 to disable.
			Note: Formatted input will block shellTask, only suitable for RTOS.

config LISA_SHELL_CLS_WHEN_LOGIN
	bool "Clear screen when logging in"
	help
			Clear the screen when logging in.

endif # LISA_SHELL
```

## arcs-sdk/components/lisa_sntp/Kconfig
```kconfig
# Copyright (c) 2025, LISTENAI
# SPDX-License-Identifier: Apache-2.0

menu "lisa sntp"

config LISA_SNTP
	bool "lisa sntp"

endmenu
```

## arcs-sdk/components/lisa_websocket/Kconfig
```kconfig
menuconfig LISA_WEBSOCKET
    bool "lisa websocket adapt layer"
    default n
    help
        Enable lisa websocket adapt layer.

config LISA_WEBSOCKET_SEND_RETRY_DELAY_NS
    int "lisa websocket send retry delay ns"
    default 10000
    depends on LISA_WEBSOCKET
    help
        Send retry delay ns if a message send failed.

config LISA_WEBSOCKET_SEND_RETRY_COUNT
    int "lisa websocket send retry count"
    default 10
    range 1 100
    depends on LISA_WEBSOCKET
    help
        Websocket send retry count if a message send failed.

config LISA_WEBSOCKET_THREAD_STACK_SIZE
    int "lisa websocket thread stack size"
    default 12288
    depends on LISA_WEBSOCKET
    help
        Stack size for websocket thread.

config LISA_WEBSOCKET_THREAD_PRIO
    int "lisa websocket thread prio"
    default 5
    depends on LISA_WEBSOCKET

config LISA_WEBSOCKET_QUEUE_COUNT
    int "lisa websocket queue count"
    default 150
    depends on LISA_WEBSOCKET
    help
        Websocket queue count for message.

config LISA_WEBSOCKET_PING_PONG_MSG
    bool "lisa websocket ping pong msg"
    default y
    depends on LISA_WEBSOCKET
    select NOPOLL_DELIVER_PONG_FRAME_ENABLED
    help
        If enable, the websocket will send ping pong message to check the connection.
        The connection will be closed if the ping pong message is not received within the timeout.

config LISA_WEBSOCKET_PING_PONG_TIMEOUT_MS
    int "lisa websocket ping pong timeout ms"
    default 2000
    depends on LISA_WEBSOCKET
    help
        Ping pong message timeout.

config LISA_WEBSOCKET_PING_PONG_RETRY_CNT
    int "lisa websocket ping pong retry cnt"
    default 5
    depends on LISA_WEBSOCKET
    help
        Ping pong message retry count if no response.

config LISA_WEBSOCKET_FRAGMENT_RECV_TIMEOUT_MS
    int "lisa websocket fragment recv timeout ms"
    default 10000
    depends on LISA_WEBSOCKET
    help
        A fragment message will be received within this time.

config LISA_WEBSOCKET_FRAGMENT_SIZE
    int "lisa websocket fragment size"
    default 512
    depends on LISA_WEBSOCKET
    help
        A message will be split into fragments if it is larger than this value.
```

## arcs-sdk/components/lisa_wifi/Kconfig
```kconfig
# LISA WiFi Configuration
#
# Copyright (c) 2025, LISTENAI
# SPDX-License-Identifier: Apache-2.0

menuconfig LISA_WIFI
	bool "Enable LISA WiFi"
	select LISA_OS
	select ARCS_HAL_UTILS if WIFI_LWIP_SAME_CORE
	select ARCS_HAL_SIMSOCKET if (WIFI_LWIP_DIFF_CORE && WIFI)
	select SDK_MODULE_MBEDTLS
	select LISA_DEVICE
	select LISA_ADC
	# 双核模式 - WiFi 协议栈侧配置
	select ARCS_HAL_IPC_HALT_BY_PEER_CORE if (WIFI_LWIP_DIFF_CORE && WIFI)
	select ARCS_HAL_IPC_MRPC_CLIENT_FLASH_IF if (WIFI_LWIP_DIFF_CORE && WIFI)
	select ARCS_HAL_IPC_MRPC_CLIENT_UTILS_S2M if (WIFI_LWIP_DIFF_CORE && WIFI)
	select ARCS_HAL_IPC_MRPC_SERVER_UTILS_M2S if (WIFI_LWIP_DIFF_CORE && WIFI)
	select ARCS_HAL_SIMSOCKET if (WIFI_LWIP_DIFF_CORE && WIFI)
	select WIFI_TX_BUF_COPY if (WIFI_LWIP_DIFF_CORE && WIFI)
	# 双核模式 - LWIP 侧配置
	select ARCS_HAL_FLASH_IF if (WIFI_LWIP_DIFF_CORE && LWIP)
	select ARCS_HAL_IPC_HALT_PEER_CORE if (WIFI_LWIP_DIFF_CORE && LWIP)
	select ARCS_HAL_IPC_FLASH_AGENT if (WIFI_LWIP_DIFF_CORE && LWIP)
	select ARCS_HAL_IPC_MRPC_SERVER_FLASH_IF if (WIFI_LWIP_DIFF_CORE && LWIP)
	select ARCS_HAL_IPC_MRPC_SERVER_UTILS_S2M if (WIFI_LWIP_DIFF_CORE && LWIP)
	select ARCS_HAL_IPC_MRPC_CLIENT_UTILS_M2S if (WIFI_LWIP_DIFF_CORE && LWIP)
	select ARCS_HAL_UTILS if (WIFI_LWIP_DIFF_CORE && LWIP)
	select LWIP_TX_BUF_COPY if (WIFI_LWIP_DIFF_CORE && LWIP)
	default n
	help
		Enable LISA WiFi component for using WiFi easier.

if LISA_WIFI

config LISA_WIFI_CB_TASK_STACK_SIZE
	int "WiFi callback task stack byte size"
	default 4096
	help
	  Stack byte size for the WiFi callback task.

config LISA_WIFI_CB_TASK_PRIORITY
	int "WiFi callback task priority"
	default 5
	help
	  Priority for the WiFi callback task.
	  Lower values indicate higher priority.

config LISA_WIFI_CB_QUEUE_LEN
	int "WiFi callback queue length"
	default 4
	help
	  Queue length for WiFi callback events.

endif # LISA_WIFI
```

## arcs-sdk/components/lite_adc/Kconfig
```kconfig
menu "adc configuration"

config LITE_ADC
    bool "ADC support"
    default n

config LITE_ADC_PROXY
    bool "ADC proxy support"
    default n
config LITE_AADC_RECV_CNTS
    int "AADC Recv Count"
    default 12

config AUDIO_STEP_SAMPS
    int "Audio Step Samples"
    default 256
    range 256 256
config AUDIO_SAMP_BITS
    int "Audio Sample Bits"
    default 16
    range 16 16

if LITE_ADC 
    choice
        prompt "ADC Channels"
        default AADC_L_ONLY
        config AADC_L_ONLY
            bool "Left Only"
        config AADC_R_ONLY
            bool "Right Only"
        config AADC_LR_MIX
            bool "Left + Right"
    endchoice

    config AADC_CHNS
        int
        default 1 if AADC_L_ONLY || AADC_R_ONLY
        default 2 if AADC_LR_MIX
    
    config GPDMA_ADC0_CHN
        int "GPDMA ADC0 Channel"
        depends on AADC_L_ONLY || AADC_LR_MIX
        default 0

    config GPDMA_ADC1_CHN
        int "GPDMA ADC1 Channel"
        depends on AADC_R_ONLY || AADC_LR_MIX
        default 1


    choice
        prompt "Microphone"
        default AADC_AMIC
        config AADC_AMIC
            bool "Analog/MEMS MIC"
        config AADC_DMIC
            bool "Digital/PDM MIC"
    endchoice

    config AADC_GAIN_A
        int "Analog Gain(*2dB)"
        default 30
        range -12 36
    config AADC_GAIN_D
        int "Digital Gain(*1dB)"
        default 0
        range -83 42
    config AADC_HPF
        bool "HPF(High Pass Filter)"
        default y
    config AADC_DIFF
        bool "Differential"
        default y
        help
            Input Signal Type:
            - yes for Differential
            - no  for Single-Ended
    config AADC_PIPO
        bool "Enable PIPO Mode"
        default y

endif
endmenu
```

## arcs-sdk/components/lite_dac/Kconfig
```kconfig
# Copyright (c) 2025, LISTENAI
# SPDX-License-Identifier: Apache-2.0

menu "dac configuration"

config LITE_DAC
	bool "DAC support"

config LITE_DAC_PROXY
	bool "DAC proxy support"

if LITE_DAC

config DAC_ECHO_ENABLE
	bool "DAC echo enable"

config ECHO_RECV_CNTS
	int "DAC echo receive cnts"
	depends on DAC_ECHO_ENABLE
	default 25

endif
endmenu
```

## arcs-sdk/components/ringbuf/Kconfig
```kconfig
config RINGBUF
    bool "Enable RINGBUF"
    default n
    help
        Enable RINGBUF
```

## arcs-sdk/components/simple_box/Kconfig
```kconfig
# Copyright (c) 2025, LISTENAI
# SPDX-License-Identifier: Apache-2.0

menu "SimpleBox (Simple BusyBox)"

config SIMPLE_BOX
	bool "Simple BusyBox"
	select LSFS
	select LVFS
	select LVFS_POSIX_API
	select LVFS_POSIX_API_ALIAS
	select DIRENT
	select SDK_MODULE_LETTER_SHELL
	select MODULE_HEAP
	select LOG

config SIMPLE_BOX_DEFAULT_MOUNT_PATH
	string "Default mount path"
	default "/SD:/"
	depends on SIMPLE_BOX

config SIMPLE_BOX_LS_SHOW_TIME
	bool "Show time in ls command"
	depends on SIMPLE_BOX

config SIMPLE_BOX_COPY_BUF_SIZE
	int "Buffer size for copy command"
	default 4096
	depends on SIMPLE_BOX

endmenu
```

## arcs-sdk/components/tinyusb-appclass/Kconfig
```kconfig
# Copyright (c) 2025, LISTENAI
# SPDX-License-Identifier: Apache-2.0

menu "tiny usb app class"

config TUSB_APP_CLASS
	bool "tiny usb app class"
	depends on TINY_USB

if TUSB_APP_CLASS
	rsource "adb/Kconfig"
endif

endmenu
```

## arcs-sdk/components/tinyusb-appclass/adb/Kconfig
```kconfig
menu "adb"

config ADB
    bool "adb"
    default n

config ADB_MAX_PAYLOAD_SIZE
    int "adb max payload size"
    default 51200
    range 1024 65536

config ADB_TASK_PRIORITY
    int "adb task priority"
    default 5

config ADB_SYNC
    bool "adb sync"
    default n
    select ADB
    select LSFS

config ADB_SHELL
    bool "adb shell"
    default n
    select ADB

config ADB_SHELL_BUFFER_SIZE
    int "adb shell buffer size"
    default 4096

config ADB_PUSH_PULL_DEFAULT_ROOT
    string "adb push/pull default root"
    default "/RAM:/adb/"
    depends on ADB_SYNC



endmenu
```

## arcs-sdk/components/touch/Kconfig
```kconfig
menu "touch configuration"

    config LISA_TOUCH
        bool "touch support"
        default n

if LISA_TOUCH

    choice LISA_TOUCH_DEVICE
        prompt "lisa touch device"
        default LISA_TOUCH_ST77921

        config LISA_TOUCH_AXS15231B
            bool "TOUCH  AXS15231B"

        config LISA_TOUCH_ST77921
            bool "TOUCH ST77921"

        config LISA_TOUCH_CST816D
            bool "TOUCH CST816D"

        config LISA_TOUCH_FT5336
            bool "TOUCH FT5336"

        config LISA_TOUCH_BL6133
            bool "TOUCH BL6133"
            help
              Enable support for BL6133 touch controller.

        config LISA_TOUCH_CST328
            bool "TOUCH CST328"
    endchoice

    config LISA_TOUCH_INTERRUPT
    	bool "Interrupt INT PIN support"
        default y
        help
        Enable interrupt support (requires INT PIN).

    config LISA_TOUCH_READ_FREQUENCY
        int "touch read frequency"
        default 20
        help
            set the touch read frequency

endif # LISA_TOUCH

endmenu

rsource "Kconfig.axs15231b"
rsource "Kconfig.st77921"
rsource "Kconfig.cst816d"
rsource "Kconfig.ft5336"
rsource "Kconfig.cst328"
```
