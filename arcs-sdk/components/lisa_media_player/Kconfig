## arcs-sdk/components/lisa_media_player/Kconfig
```kconfig
# Copyright (c) 2025, LISTENAI
# SPDX-License-Identifier: Apache-2.0

menuconfig LISA_MEDIA_PLAYER
	bool "LISA media player (AVI + render)"
	help
	  A lightweight media playback component that includes:
	  - AVI demux (SD/LSFS, optional HTTP Range)
	  - A/V render pipeline (audio as master clock)
	  - MJPEG decode + RGB565 LCD output

if LISA_MEDIA_PLAYER

rsource "av_render/Kconfig"
rsource "avi_player/Kconfig"

endif # LISA_MEDIA_PLAYER
```

## arcs-sdk/components/lisa_media_player/av_render/Kconfig
```kconfig
# Copyright (c) 2025, LISTENAI
# SPDX-License-Identifier: Apache-2.0
#
# av_render: render pipeline + sync + MJPEG decode + LCD output

menu "av_render"

comment "--- Audio ---"

config AVI_PLAYER_AUDIO_MP3
	bool "Enable MP3 audio decoder (mp3dec)"
	select SDK_MODULE_MP3_DECODER
	help
	  Enable built-in MP3 audio decoding via modules/mp3dec.
	  When disabled, AVI with MP3 audio can still work if the application
	  registers a custom audio decoder at runtime.

config AVI_PLAYER_MP3_DECODE_QUEUE_DEPTH
	int "MP3 decode queue depth"
	range 1 32
	default 8
	depends on AVI_PLAYER_AUDIO_MP3
	help
	  Number of compressed MP3 frames queued for decoding.

config AVI_PLAYER_MP3_DECODE_THREAD_STACK_SIZE
	int "MP3 decode thread stack size (bytes)"
	range 4096 65536
	default 12288
	depends on AVI_PLAYER_AUDIO_MP3

config AVI_PLAYER_MP3_DECODE_THREAD_PRIORITY
	int "MP3 decode thread priority"
	range 1 10
	default 3
	depends on AVI_PLAYER_AUDIO_MP3

comment "--- Video ---"

choice
	prompt "Video rotation mode"
	default AVI_PLAYER_ROTATE_NONE

config AVI_PLAYER_ROTATE_NONE
	bool "No rotation"

config AVI_PLAYER_ROTATE_90_CW
	bool "Rotate 90 degrees CW"

config AVI_PLAYER_ROTATE_90_CCW
	bool "Rotate 90 degrees CCW"

endchoice

config AVI_PLAYER_FIXED_FPS
	bool "Enable fixed video FPS"
	help
	  Override the AVI file's native frame rate with a fixed value.

config AVI_PLAYER_FIXED_FPS_VALUE
	int "Fixed video FPS"
	range 1 60
	default 15
	depends on AVI_PLAYER_FIXED_FPS

config AVI_PLAYER_MAX_VIDEO_AHEAD_MS
	int "Max video ahead (ms) in A/V sync"
	range 0 5000
	default 300
	help
	  Limit how far video PTS is allowed to run ahead of the audio clock
	  when av_render is in AV_RENDER_SYNC_AUDIO mode.

comment "--- MJPEG Decoder ---"

choice
	prompt "MJPEG decoder backend"
	default AVI_PLAYER_VIDEO_DECODER_LISA_JPEG
	help
	  Select the JPEG decoding backend for MJPEG video frames.

	  - Hardware (lisa_jpeg): Uses the on-chip JPEG hardware accelerator.
	    Fast and low CPU usage, but limited by hardware constraints
	    (e.g. max resolution, supported sub-sampling modes).

	  - Software (libjpeg-turbo): Pure software decode on CPU.
	    More compatible but higher CPU load and slower.

config AVI_PLAYER_VIDEO_DECODER_LISA_JPEG
	bool "Hardware decode (lisa_jpeg)"
	select LISA_JPEG
	help
	  Use the on-chip JPEG hardware accelerator for MJPEG decoding.
	  Recommended for best performance and lowest CPU usage.

config AVI_PLAYER_VIDEO_DECODER_MJPEG
	bool "Software decode (libjpeg-turbo)"
	select SDK_MODULE_LIBJPEG_TURBO
	help
	  Use libjpeg-turbo for pure software MJPEG decoding.
	  Higher CPU usage but supports all JPEG sub-sampling modes and
	  resolutions without hardware limitations.

endchoice

config AVI_PLAYER_LISA_JPEG_SOFT_FALLBACK
	bool "Software fallback on hardware decode failure"
	depends on AVI_PLAYER_VIDEO_DECODER_LISA_JPEG
	select SDK_MODULE_LIBJPEG_TURBO
	help
	  When hardware decode (lisa_jpeg) fails for a frame (e.g. unsupported
	  sub-sampling or resolution), automatically retry with libjpeg-turbo
	  software decode. Increases binary size but improves compatibility.

config AVI_PLAYER_MJPEG_DECODE_QUEUE_DEPTH
	int "MJPEG decode queue depth"
	range 1 8
	default 2
	help
	  Number of compressed MJPEG frames queued for decoding.

config AVI_PLAYER_MJPEG_DECODE_THREAD_STACK_SIZE
	int "MJPEG decode thread stack size (bytes)"
	range 4096 65536
	default 24576

config AVI_PLAYER_MJPEG_DECODE_THREAD_PRIORITY
	int "MJPEG decode thread priority"
	range 1 10
	default 2

comment "--- Debug ---"

config AVI_PLAYER_PROFILE_LOG
	bool "Enable performance profiling logs"

config AVI_PLAYER_STATS_LOG
	bool "Enable AVI statistics logs"

endmenu
```

## arcs-sdk/components/lisa_media_player/avi_player/Kconfig
```kconfig
# Copyright (c) 2025, LISTENAI
# SPDX-License-Identifier: Apache-2.0
#
# avi_player: AVI demux + IO backends

menu "avi_player"

comment "--- Buffer Pools ---"

config AVI_PLAYER_MJPEG_POOL
	bool "Enable MJPEG packet buffer pool"
	help
	  Use a dedicated buffer pool for MJPEG compressed frames.

config AVI_PLAYER_MJPEG_POOL_SLOTS
	int "MJPEG pool slot count"
	range 1 8
	default 2
	depends on AVI_PLAYER_MJPEG_POOL

config AVI_PLAYER_MJPEG_POOL_SLOT_BYTES
	int "MJPEG pool slot size (bytes)"
	range 4096 524288
	default 65536
	depends on AVI_PLAYER_MJPEG_POOL

config AVI_PLAYER_AUDIO_POOL
	bool "Enable PCM audio block pool"
	help
	  Use a dedicated buffer pool for decoded PCM audio blocks.

config AVI_PLAYER_AUDIO_POOL_SLOTS
	int "PCM pool slot count"
	range 1 8
	default 4
	depends on AVI_PLAYER_AUDIO_POOL

config AVI_PLAYER_AUDIO_POOL_SLOT_BYTES
	int "PCM pool slot size (bytes)"
	range 256 65536
	default 4096
	depends on AVI_PLAYER_AUDIO_POOL

comment "--- HTTP Data Source ---"

config AVI_PLAYER_HTTP_RANGE
	bool "Enable HTTP Range data source (httpclient)"
	select MODULE_HTTPCLIENT
	select WIFI_MANAGER
	help
	  Enable a minimal HTTP Range-based AVI data source.

config AVI_PLAYER_HTTP_URL
	string "HTTP URL for AVI playback"
	default "http://example.com/default.avi"
	depends on AVI_PLAYER_HTTP_RANGE

config AVI_PLAYER_WIFI_SSID
	string "WiFi SSID"
	default "your_wifi_ssid"
	depends on AVI_PLAYER_HTTP_RANGE

config AVI_PLAYER_WIFI_PWD
	string "WiFi Password"
	default "your_wifi_pwd"
	depends on AVI_PLAYER_HTTP_RANGE

config AVI_PLAYER_WIFI_CONNECT_TIMEOUT_S
	int "WiFi connect timeout (seconds)"
	range 5 120
	default 30
	depends on AVI_PLAYER_HTTP_RANGE

comment "--- Adaptive FPS ---"

config AVI_PLAYER_ADAPTIVE_DECODE_SLOW_FPS
	bool "Adaptive video FPS when decode is slow"
	help
	  Dynamically lower video target FPS when video push latency remains high,
	  then recover FPS when pressure is reduced. This helps stabilize audio.

config AVI_PLAYER_ADAPTIVE_DECODE_SLOW_FPS_MIN
	int "Adaptive FPS minimum"
	range 5 60
	default 12
	depends on AVI_PLAYER_ADAPTIVE_DECODE_SLOW_FPS

config AVI_PLAYER_ADAPTIVE_DECODE_SLOW_FPS_STEP
	int "Adaptive FPS step"
	range 1 10
	default 2
	depends on AVI_PLAYER_ADAPTIVE_DECODE_SLOW_FPS

config AVI_PLAYER_ADAPTIVE_DECODE_SLOW_WINDOW_FRAMES
	int "Adaptive window (video frames)"
	range 4 64
	default 16
	depends on AVI_PLAYER_ADAPTIVE_DECODE_SLOW_FPS

config AVI_PLAYER_ADAPTIVE_DECODE_SLOW_DOWN_MS
	int "Slow decode threshold (ms)"
	range 10 200
	default 45
	depends on AVI_PLAYER_ADAPTIVE_DECODE_SLOW_FPS

config AVI_PLAYER_ADAPTIVE_DECODE_SLOW_UP_MS
	int "Recover threshold (ms)"
	range 5 150
	default 32
	depends on AVI_PLAYER_ADAPTIVE_DECODE_SLOW_FPS

comment "--- Debug ---"

config AVI_PLAYER_POOL_STATS_LOG
	bool "Enable pool/queue statistics logs"

endmenu
```

## arcs-sdk/components/lisa_modem/Kconfig
```kconfig
# Copyright (c) 2025, LISTENAI
# SPDX-License-Identifier: Apache-2.0

config LISA_MODEM
	bool "Enable 4G Module Support"
	select RINGBUF
	help
	  Enable support for ML307 4G module.
	  This includes AT commands, TCP/UDP communication,
	  and modem control functionality.

if LISA_MODEM

config LISA_MODEM_DRIVER_ML307
	bool "Enable ML307 driver"
	default y
	help
	  Build and register the ML307 modem driver.

config LISA_MODEM_DRIVER_EC801E
	bool "Enable EC801E driver"
	help
	  Build and register the EC801E modem driver.
	  This driver can coexist with ML307 and relies on runtime probe selection.

endif
```

## arcs-sdk/components/lisa_net/Kconfig
```kconfig
# Copyright (c) 2025, LISTENAI
# SPDX-License-Identifier: Apache-2.0

menuconfig LISA_NET
	bool "Network Device Abstraction Layer"
	help
		Enable network device abstraction layer (SAL) for multi-network interface management.

if LISA_NET

config NET_NAME
	string "Module Name"
	default "net"

config SAL_SOCKETS_NUM
	int "Maximum number of sockets"
	default 16
	help
		Maximum number of sockets that can be allocated.

config SAL_INTERNET_CHECK
	bool "Enable internet connectivity check"
	help
		Enable automatic internet connectivity checking for network devices.

config SAL_USING_POSIX
	bool "using posix"
	default y

endif
```

## arcs-sdk/components/lisa_os/Kconfig
```kconfig
menuconfig LISA_OS
    bool "lisa os adapt layer"
    select MODULE_FREERTOS
    select FREERTOS_STATIC_ALLOCATION_ENABLE
    default n
    help
        lisa os adapt layer
```

## arcs-sdk/components/lisa_pm/Kconfig
```kconfig
# Copyright (c) 2025, LISTENAI
# SPDX-License-Identifier: Apache-2.0

menuconfig LISA_PM
	bool "Enable LISA PM Framework"
	select ARCS_HAL_PM
	# pm_impl light_sleep 路径硬依赖 vrtc（vrtc_get_time_us / vrtc_is_allow_sleep）；
	# lisa_pm_init 内部会自动调用 vrtc_init()，因此 vrtc.c 必须随 lisa_pm 一起编进来。
	select ARCS_HAL_VRTC
	# CP-core 应用：AP 由独立 remote 固件加载，睡眠时必须 tear-down AP 子系统。
	# PM 双核运行模式下 AP 是运行中的对端核心，不能关闭 AP 子系统。
	select ARCS_HAL_PM_CLOSE_AP if ARCS_CP_CORE && !LISA_PM_DUAL_CORE
	help
		Enable the LISA power management framework.
		Provides sleep statistics, system-policy control,
		optional WiFi extension APIs,
		and a phase-1 system PM device registry
		on top of the HAL PM implementation.

if LISA_PM

config LISA_PM_CORE_PRIMARY
	bool "Build this core as HAL PM primary core"
	default y if ARCS_CP_CORE
	default n if ARCS_AP_CORE
	default y
	help
		Select the HAL PM primary role for this lisa_pm instance.
		The primary core performs the final AON/PMU sleep entry after the
		peer core has entered idle. Clear this option for the peer that
		only coordinates with the primary core.

config LISA_PM_DUAL_CORE
	bool "Enable LISA PM AP/CP runtime dual-core mode"
	depends on ARCS_CP_CORE && ARCS_HAL_IPC
	help
		Enable this when the application runs with an active AP peer firmware.
		In this mode lisa_pm must not select ARCS_HAL_PM_CLOSE_AP, because
		the AP core participates in PM coordination instead of acting as a
		single-core PM boot shim.

config LISA_PM_STATS
	bool "Enable sleep statistics collection"
	default y
	help
		Collect sleep and wakeup statistics through PM hooks.

config LISA_PM_DEVICE_RUNTIME
	bool "Reserve Runtime PM option for phase 2"
	help
		Reserved for a later per-device runtime PM rollout.
		Phase-1 system PM registration does not depend on this option.

config LISA_PM_SYSTEM_DEVICE_MAX
	int "Maximum number of system PM devices"
	default 16
	help
		Maximum number of devices that can be discovered from lisa_device
		and copied into the internal lisa_pm system PM registry.

config LISA_PM_AFTER_WAKE_TASK_STACK_SIZE
	int "LISA PM after-wake task stack size"
	default 2048
	help
		Stack size of the internal task that dispatches application
		after_wake callbacks after the PM exit path has completed.

config LISA_PM_AFTER_WAKE_TASK_PRIORITY
	int "LISA PM after-wake task priority"
	default 5
	help
		FreeRTOS priority of the internal task that dispatches application
		after_wake callbacks.

config LISA_PM_WIFI
	bool "Enable LISA PM WiFi extension layer"
	default y
	depends on LISA_WIFI
	# WiFi 睡眠期间的 ARP keep-alive 只有在 WiFi PM 场景下才有意义
	select ARCS_HAL_PM_KEEP_ALIVE
	help
		Enable the new lisa_pm_wifi_* atomic APIs for WiFi power-save
		control and locks. This option aligns with CONFIG_LISA_PM_WIFI used
		in headers; prefer this switch when designing new code.

config LISA_PM_REMOTE_LOCK_CLIENT
	bool "Enable LISA PM remote lock client"
	depends on SOC_ARCS && ARCS_HAL_IPC
	select ARCS_HAL_IPC_MRPC_CLIENT_AP_PM_LOCK
	help
		Enable CP-side lisa_pm_remote_lock_acquire/release wrappers.
		The transport uses the AP PM lock MRPC service, so the request can
		wake an AP core that is waiting in the light-sleep MRPC wake path.

config LISA_PM_REMOTE_LOCK_SERVER
	bool "Enable LISA PM remote lock server"
	depends on SOC_ARCS && ARCS_HAL_IPC
	select ARCS_HAL_IPC_MRPC_SERVER_AP_PM_LOCK
	help
		Enable AP-side MRPC handlers that map remote requests to local
		lisa_pm_lock_acquire/release calls.

config LISA_PM_DEVICE_MAX
	int "Maximum number of Runtime PM devices"
	default 8
	depends on LISA_PM_DEVICE_RUNTIME

config LISA_PM_SNAPSHOT_DEFAULT_ILM_DLM
	bool "Auto-register ILM/DLM regions to PM snapshot at lisa_pm init"
	default y
	help
		Enable auto-registration of ILM .itcm and DLM .dtcm .data
		sections to the HAL PM snapshot framework at lisa_pm init.
		After deep-sleep wakeup, HAL restores these regions from PSRAM.

		Effective only when CONFIG_MEM_ILM_SIZE > 0.

config LISA_PM_SNAPSHOT_DEFAULT_SRAM
	bool "Auto-register non-AON SRAM region to PM snapshot at lisa_pm init"
	help
		Enable auto-registration of the fixed SRAM region
		0x20050000..0x200C0000 to the HAL PM snapshot framework at
		lisa_pm init.

		ARCS SRAM starts at 0x20000000 and is 0xC0000 bytes in total.
		The first 320 KiB (0x20000000..0x20050000) belongs to the AON
		domain and remains powered during sleep, so only the non-AON
		region 0x20050000..0x200C0000 needs snapshot restore.

		Effective only when CONFIG_MEM_ILM_SIZE > 0.

endif
```

## arcs-sdk/components/lisa_porting/Kconfig
```kconfig
menu "porting configuration"

config LISA_PORTING
        bool "enable lisa_porting"
        default y

orsource "kv/Kconfig"
orsource "log/Kconfig"
orsource "os/Kconfig"
orsource "net/Kconfig"

endmenu
```

## arcs-sdk/components/lisa_porting/kv/Kconfig
```kconfig
menuconfig LISA_KV
    prompt "lisa kv configuration"
    bool "lisa kv configuration"
    default n
    help
        lisa kv configuration

if LISA_KV

choice LISA_KV_TYPE
    prompt "lisa kv type"
    default LISA_KV_TYPE_LSFS

    config LISA_KV_TYPE_LSFS
        bool "lisa kv type lsfs"
        select LSFS
        help
            lisa kv type lsfs, please make sure the fs is mounted

    config LISA_KV_TYPE_EF
        bool "lisa kv type easyflash"
        select MODULE_EASYFLASH
        help
            lisa kv type easyflash
endchoice

config LISA_KV_FS_PATH
    string "lisa kv fs path"
    default "/NAND:/lisa_kv.ini"
    depends on LISA_KV_TYPE_LSFS
    help
        lisa kv fs path

config LISA_KV_POWEROFF_SAVE
    bool "lisa kv poweroff save support"
    depends on LISA_KV
    depends on LISA_KV_TYPE_LSFS
    default n
    help
        Enable automatic KV data save when system poweroff.
        This ensures KV data is persisted before shutdown.

endif
```

## arcs-sdk/components/lisa_porting/log/Kconfig
```kconfig
menu "log configuration"

config LOG
    bool "enable log"
    default n
    depends on LISA_PORTING

if LOG

choice
    prompt "log frontend"
    default LOG_FRONTEND_EASYLOGGER
    config LOG_FRONTEND_EASYLOGGER
        bool "easylogger frontend"
        select SDK_MODULE_EASYLOGGER
endchoice

choice
    prompt "log backend"
    default LOG_BACKEND_UART
    config LOG_BACKEND_UART
        bool "uart backend"
endchoice

config LOG_MODE_ASYNC
    bool "asynchronous mode"
    default y
    select EASYLOGGER_LOG_MODE_ASYNC if SDK_MODULE_EASYLOGGER
endif

choice
    prompt "log level"
    default LOG_LEVEL_INFO
    config LOG_LEVEL_ASSERT
        bool "assert"
        select EASYLOGGER_LOG_LEVEL_ASSERT if SDK_MODULE_EASYLOGGER
    config LOG_LEVEL_ERROR
        bool "error"
        select EASYLOGGER_LOG_LEVEL_ERROR if SDK_MODULE_EASYLOGGER
    config LOG_LEVEL_WARN
        bool "warning"
        select EASYLOGGER_LOG_LEVEL_WARN if SDK_MODULE_EASYLOGGER
    config LOG_LEVEL_INFO
        bool "info"
        select EASYLOGGER_LOG_LEVEL_INFO if SDK_MODULE_EASYLOGGER
    config LOG_LEVEL_DEBUG
        bool "debug"
        select EASYLOGGER_LOG_LEVEL_DEBUG if SDK_MODULE_EASYLOGGER
    config LOG_LEVEL_VERBOSE
        bool "verbose"
        select EASYLOGGER_LOG_LEVEL_VERBOSE if SDK_MODULE_EASYLOGGER
endchoice

endmenu
```
