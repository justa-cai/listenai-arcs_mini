## arcs-sdk/components/work_queue/Kconfig
```kconfig
menu "work_queue"

config WORK_QUEUE
    bool "Enable work queue component"
    default n
    help
        Enable the work queue component for asynchronous task execution.

endmenu
```

## arcs-sdk/demos/arcs/face_detect/sample.yaml
```yaml
tests:
  demos.arcs.face_detect:
    platform:
      arcs_evb
    build_only: true
```

## arcs-sdk/demos/arcs/face_detect/src/button/Kconfig
```kconfig
# Copyright (c) 2025, LISTENAI
# SPDX-License-Identifier: Apache-2.0

config BUTTON
	bool "include gpio button and adc button"

if BUTTON
	config BUTTON_THREAD_SCAN_FREQ_HZ
		int "button thread scan freq hz"
		default 50

	config BUTTON_THREAD_PRIORITY
		int "button thread priority"
		default 8

	config BUTTON_THREAD_STACK_SIZE
		int "button thread stack size"
		default 4096

	config GPIO_BUTTON
		bool "gpio button"

	config ADC_BUTTON
		bool "adc button"

if ADC_BUTTON
	config ADC_UNIT_NUM
		int "adc uint number"
		default 1

	config ADC_MAX_CHANNEL
		int "adc max channel"
		default 6
		range 1 6

	config ADC_BUTTON_MAX_BUTTON_PER_CHANNEL
		int "adc button max button per channel"
		default 10
		range 1 10

	config ADC_BUTTON_SAMPLE_TIMES
		int "adc button sample times"
		default 8
endif

endif
```

## arcs-sdk/demos/face_detect/src/button/Kconfig
```kconfig
config BUTTON
    bool "include gpio button and adc button"
    default n

if BUTTON
    config BUTTON_THREAD_SCAN_FREQ_HZ
        int "button thread scan freq hz"
        default 50
    
    config BUTTON_THREAD_PRIORITY
        int "button thread priority"
        default 8
    
    config BUTTON_THREAD_STACK_SIZE
        int "button thread stack size"
        default 4096
    
    config GPIO_BUTTON
        bool "gpio button"
        default n

    config ADC_BUTTON
        bool "adc button"
        default n

if ADC_BUTTON
    config ADC_UNIT_NUM
        int "adc uint number"
        default 1

    config ADC_MAX_CHANNEL
        int "adc max channel"
        default 6
        range 1 6

    config ADC_BUTTON_MAX_BUTTON_PER_CHANNEL
        int "adc button max button per channel"
        default 10
        range 1 10

    config ADC_BUTTON_SAMPLE_TIMES
        int "adc button sample times"
        default 8
endif

endif
```

## arcs-sdk/demos/venusa/face_detect/boards/csk7s_yt_evb/Kconfig
```kconfig
# Board Configuration
#
# Copyright (c) 2025, LISTENAI
# SPDX-License-Identifier: Apache-2.0

config BOARD_NAME
	string
	default "csk7s_yt_evb"
	prompt "Board Name"
	help
		Board Name

config BOARD_CSK7S_YT_EVB
	bool
	default y
	select SOC_CSK7004J8U
	help
		Board is csk7s_yt_evb

config BOARD_CSK7S_YT_EVB_HAS_DVP
	bool
	default y
	help
		csk7s_yt_evb exposes the camera DVP interface.

config BOARD_CSK7S_YT_EVB_HAS_KEY
	bool
	default y
	help
		csk7s_yt_evb exposes board keys.
```

## arcs-sdk/demos/venusa/face_detect/src/button/Kconfig
```kconfig
# Copyright (c) 2025, LISTENAI
# SPDX-License-Identifier: Apache-2.0

config BUTTON
	bool "include gpio button"

if BUTTON
	config BUTTON_THREAD_SCAN_FREQ_HZ
		int "button thread scan freq hz"
		default 50

	config BUTTON_THREAD_PRIORITY
		int "button thread priority"
		default 8

	config BUTTON_THREAD_STACK_SIZE
		int "button thread stack size"
		default 4096

	config GPIO_BUTTON
		bool "gpio button"
endif
```

## arcs-sdk/drivers/Kconfig
```kconfig
# LISA Device Framework Configuration
#
# Copyright (c) 2025, LISTENAI
# SPDX-License-Identifier: Apache-2.0

menuconfig LISA_DEVICE
	bool "Enable LISA Device Framework"
	default n
	select LISA_OS
	select LOG
	help
	  Enable the LISA device framework for unified device management.
	  This provides a base class for all devices with automatic registration,
	  state management, and observability features.

if LISA_DEVICE

config LISA_DEVICE_DEBUG
	bool "Enable device framework debug features"
	default n
	help
	  Enable debug features like device registry printing, verification, etc.
	  This will increase code size and should be disabled in production builds.

config LISA_DEVICE_MANUAL_INIT
	bool "Manual device initialization mode"
	default n
	help
	  Enable manual initialization mode for testing purposes.
	  When enabled, lisa_device_init() will not be called automatically.
	  This allows test code to control the exact timing of device initialization,
	  useful for testing initialization logic, error handling, and edge cases.

rsource "lisa_adc/Kconfig"
rsource "lisa_audio/Kconfig"
rsource "lisa_gpio/Kconfig"
rsource "lisa_i2c/Kconfig"
rsource "lisa_pwm/Kconfig"
rsource "lisa_spi/Kconfig"
rsource "lisa_uart/Kconfig"
rsource "lisa_display/Kconfig"
rsource "lisa_touch/Kconfig"
rsource "lisa_wdt/Kconfig"
rsource "lisa_camera/Kconfig"
rsource "lisa_rtc/Kconfig"
rsource "lisa_flash/Kconfig"
rsource "lisa_hwtimer/Kconfig"
rsource "lisa_sdmmc/Kconfig"
rsource "lisa_qspilcd/Kconfig"
rsource "lisa_dvp/Kconfig"
rsource "lisa_rgb/Kconfig"

endif # LISA_DEVICE
```

## arcs-sdk/drivers/lisa_adc/Kconfig
```kconfig
# LISA ADC Driver Configuration
#
# Copyright (c) 2025, LISTENAI
# SPDX-License-Identifier: Apache-2.0

menuconfig LISA_ADC
	bool "Enable LISA ADC Driver"
	depends on LISA_DEVICE
	help
			Enable the LISA ADC device driver.

if LISA_ADC

endif # LISA_ADC

if LISA_CH32V003

config LISA_CH32V003_ADC
	bool "Enable CH32V003 ADC child device"
	default y
	select LISA_ADC

config LISA_CH32V003_ADC_TIMEOUT_MS
	int "CH32V003 ADC conversion timeout (ms)"
	default 2000

config LISA_CH32V003_ADC_POLL_MS
	int "CH32V003 ADC status poll interval (ms)"
	default 10

endif # LISA_CH32V003
```

## arcs-sdk/drivers/lisa_audio/Kconfig
```kconfig
# SPDX-License-Identifier: Apache-2.0

menuconfig LISA_AUDIO_DEVICE
	bool "Enable LISA Audio Driver"
	depends on LISA_DEVICE
	help
			Enable LISA Audio device driver for ADC/DAC operations.
			Provides unified audio recording (ADC) and playback (DAC) interfaces.

if LISA_AUDIO_DEVICE

choice
	prompt "Audio Implementation"
	default PORT_ARCS
	help
			Select the audio driver implementation.

config PORT_ARCS
	bool "Use ARCS port implementation"
	help
			Enable ARCS platform specific implementation.

endchoice

config LISA_AUDIO_INIT_PRIORITY
	int "Audio device initialization priority"
	default 50
	range 0 99
	help
			Initialization priority for audio device (0-99, lower value = higher priority).

# ===== Dispatcher Configuration =====
menu "Audio Dispatcher Configuration"

config LISA_AUDIO_DISPATCH_TASK_STACK_SIZE
	int "Dispatch task stack size (bytes)"
	default 4096
	help
			Stack size for the unified audio dispatch task.

config LISA_AUDIO_DISPATCH_TASK_PRIORITY
	int "Dispatch task priority"
	default 2
	help
			Priority of the audio dispatch task

endmenu

# ===== Record (ADC) Configuration =====
menu "Record (ADC) Configuration"

config LISA_AUDIO_RECORD_USE_PIPO
	bool "Enable Record PiPo (Ping-Pong) mode"
	default y
	help
			Enable Ping-Pong buffer mode for continuous audio recording.

config LISA_AUDIO_RECORD_USE_DMIC
	bool "Use digital microphone (DMIC)"
	help
			Enable PDM mode for digital microphones.
			Disable for analog microphones (ADC mode).

config  LISA_AUDIO_RECORD_INDIVIDUAL_GAIN
    bool "Enable individual gain control on left/right channels"
    default n

config LISA_AUDIO_RECORD_MIC0_ENABLE
	bool "Enable MIC0 (GPIOA_30/31)"
	default y
	help
			Enable MIC0 differential input on GPIOA_30 (INP) and GPIOA_31 (INN).
			Disable this if MIC0 is not used in your hardware design.

config LISA_AUDIO_RECORD_MIC1_ENABLE
	bool "Enable MIC1 (GPIOA_28/29)"
	default y
	help
			Enable MIC1 differential input on GPIOA_28 (INP) and GPIOA_29 (INN).
			Disable this if MIC1 is not used in your hardware design.

config LISA_AUDIO_RECORD_DMA_CHN_LEFT
	int "ADC left channel DMA channel number"
	default 1
	range 0 5
	help
		GPDMA channel number used for ADC left channel (MIC0) data transfer.
		Default: 1

config LISA_AUDIO_RECORD_DMA_CHN_RIGHT
	int "ADC right channel DMA channel number"
	default 3
	range 0 5
	help
		GPDMA channel number used for ADC right channel (MIC1) data transfer.
		Only used when stereo recording is enabled.
		Default: 3

		NOTE: Must not conflict with LISA_AUDIO_PLAY_ECHO_DMA_CHN when Echo
		capture is enabled.

choice
	prompt "LDOVA Output Voltage Level"
	default LISA_AUDIO_RECORD_LDOVA_1V905
	help
			Select the LDOVA (Low Dropout Voltage for Analog) output voltage level.
			This controls the analog power supply voltage for the ADC module.

config LISA_AUDIO_RECORD_LDOVA_1V68
	bool "1.68V"
	help
			LDOVA output voltage: 1.68V (SEL_VOUT_LDOVA = 0x8)

config LISA_AUDIO_RECORD_LDOVA_1V785
	bool "1.785V"
	help
			LDOVA output voltage: 1.785V (SEL_VOUT_LDOVA = 0xf)

config LISA_AUDIO_RECORD_LDOVA_1V8
	bool "1.8V - Default"
	help
			LDOVA output voltage: 1.8V (SEL_VOUT_LDOVA = 0x0)
			This is the default voltage level.

config LISA_AUDIO_RECORD_LDOVA_1V815
	bool "1.815V"
	help
			LDOVA output voltage: 1.815V (SEL_VOUT_LDOVA = 0x1)

config LISA_AUDIO_RECORD_LDOVA_1V905
	bool "1.905V"
	help
			LDOVA output voltage: 1.905V (SEL_VOUT_LDOVA = 0x7)

endchoice

endmenu

# ===== Play (DAC) Configuration =====
menu "Play (DAC) Configuration"

config LISA_AUDIO_PLAY_DMA_CHN
	int "DAC output DMA channel number"
	default 2
	range 0 5
	help
		GPDMA channel number used for DAC audio output data transfer.
		Default: 2

config LISA_AUDIO_PLAY_PA_ENABLE
	bool "Enable power amplifier (PA) control"
	select LISA_GPIO_DEVICE
	help
			Enable GPIO control for external power amplifier.
			PA will be enabled after playback output stabilizes to prevent pop noise.

if LISA_AUDIO_PLAY_PA_ENABLE

config LISA_AUDIO_PLAY_PA_PAD
	int "PA GPIO pad (0=PAD_A, 1=PAD_B)"
	default 0
	range 0 1
	help
			GPIO pad selection for PA control pin.
			0 = CSK_IOMUX_PAD_A, 1 = CSK_IOMUX_PAD_B

config LISA_AUDIO_PLAY_PA_PIN
	int "PA GPIO pin number"
	default 28
	range 0 31
	help
			GPIO pin number for PA control (0-31).
			Example: Pin 28 on PAD_A = GPIOA28

config LISA_AUDIO_PLAY_PA_PULSE_COUNT
	int "PA enable pulse count"
	default 3
	range 0 10
	help
			Number of high-low pulses to send when enabling PA.
			Some PA chips require pulse sequence for proper startup.
			Set to 0 to simply set pin high without pulses.

config LISA_AUDIO_PLAY_PA_PULSE_US
	int "PA pulse duration (microseconds)"
	default 50
	range 10 1000
	help
			Duration of each high/low level in PA enable pulse sequence.

endif # LISA_AUDIO_PLAY_PA_ENABLE

choice LISA_AUDIO_PLAY_ECHO_MODE
	prompt "Play Echo mode"
	default LISA_AUDIO_PLAY_ECHO_NONE
	help
		Select echo capture mode for AEC (Acoustic Echo Cancellation).

config LISA_AUDIO_PLAY_ECHO_NONE
	bool "Disable Echo"
	help
		No echo capture. AEC will not be available.

config LISA_AUDIO_PLAY_ECHO_ENABLE
	bool "Hardware Echo (DAC echo DMA)"
	help
		Enable hardware Echo capture during playback. Echo data is a copy of the
		DAC output signal captured via DMA.

		IMPORTANT: Uses DMA channel 3 (GPDMA_ECHO_CHN), which conflicts
		with Record stereo mode (GPDMA_ADC1_CHN = 3) and I2S1 full-duplex mode.

config LISA_AUDIO_PLAY_SOFT_ECHO
	bool "Software Echo (playback data copy)"
	help
		Enable software echo capture during playback. Instead of using
		hardware DAC echo (which requires DMA channel 3), the playback
		data is copied as echo reference for AEC.

		Use this when hardware echo conflicts with other DMA resources
		(e.g., I2S1 full-duplex mode).

endchoice

config LISA_AUDIO_PLAY_ECHO_DMA_CHN
	int "Echo capture DMA channel number"
	depends on LISA_AUDIO_PLAY_ECHO_ENABLE
	default 3
	range 0 5
	help
			GPDMA channel number used for Echo capture data transfer.
			Default: 3

			NOTE: Must not conflict with LISA_AUDIO_RECORD_DMA_CHN_RIGHT when
			stereo recording is enabled.

config LISA_AUDIO_RECORD_BUFFER_COUNT
	int "Record buffer count"
	default 32
	help
			Number of Record buffers for ping-pong reception.
			More buffers reduce the risk of data loss but consume more RAM.

			Minimum: 2 (for ping-pong mode)
			Recommended: 4-32

			Memory usage = buffer_count × buffer_samples × 2 bytes

config LISA_AUDIO_RECORD_BUFFER_SAMPLES
	int "Record buffer samples per buffer"
	default 256
	range 64 2048
	help
			Number of audio samples (16-bit) per Record buffer.

			Smaller buffers = lower latency, higher CPU overhead
			Larger buffers = higher latency, lower CPU overhead

			Example: 256 samples @ 16kHz = 16ms latency

			Memory per buffer = samples × 2 bytes

endmenu

endif # LISA_AUDIO_DEVICE
```

## arcs-sdk/drivers/lisa_audio/port/venusa/Kconfig
```kconfig
# LISA Audio Venusa Port Configuration
#
# Copyright (c) 2026, LISTENAI
# SPDX-License-Identifier: Apache-2.0

if PORT_VENUSA

menu "Venusa Audio Port Configuration"

config LISA_AUDIO_RECORD_DMA_CHN_LEFT
	int "ADC left channel DMA channel number"
	default 2
	range 0 5
	help
		GPDMA channel number used for ADC left channel data transfer.
		Default: 2.

config LISA_AUDIO_RECORD_DMA_CHN_RIGHT
	int "ADC right channel DMA channel number"
	default 3
	range 0 5
	help
		GPDMA channel number used for ADC right channel data transfer.
		Default: 3.

choice
	prompt "Venusa LDOVA TUNE_LDOVA voltage"
	default LISA_AUDIO_VENUSA_LDOVA_TUNE_1V800
	help
		Select TUNE_LDOVA field in AON_TUNE0 bit[12:9].

		The voltages below are defined by the Venusa analog register
		specification when SEL_VOUT_LDOVA is 0.

config LISA_AUDIO_VENUSA_LDOVA_TUNE_1V800
	bool "1.800 V - default"

config LISA_AUDIO_VENUSA_LDOVA_TUNE_1V830
	bool "1.830 V"

config LISA_AUDIO_VENUSA_LDOVA_TUNE_2V008
	bool "2.008 V"

config LISA_AUDIO_VENUSA_LDOVA_TUNE_1V561
	bool "1.561 V"

config LISA_AUDIO_VENUSA_LDOVA_TUNE_1V770
	bool "1.770 V"

endchoice

config LISA_AUDIO_VENUSA_LDOVA_TUNE
	int
	default 0 if LISA_AUDIO_VENUSA_LDOVA_TUNE_1V800
	default 1 if LISA_AUDIO_VENUSA_LDOVA_TUNE_1V830
	default 7 if LISA_AUDIO_VENUSA_LDOVA_TUNE_2V008
	default 8 if LISA_AUDIO_VENUSA_LDOVA_TUNE_1V561
	default 15 if LISA_AUDIO_VENUSA_LDOVA_TUNE_1V770

config LISA_AUDIO_PLAY_DMA_CHN
	int "DAC output DMA channel number"
	default 3
	range 0 5
	help
		GPDMA channel number used for DAC audio output data transfer.
		Default: 3.

config LISA_AUDIO_PLAY_PA_ENABLE
	bool "Enable power amplifier (PA) control"
	select LISA_GPIO_DEVICE
	select LISA_GPIOA if LISA_AUDIO_PLAY_PA_PAD = 0
	select LISA_GPIOB if LISA_AUDIO_PLAY_PA_PAD = 1
	help
		Enable GPIO control for external power amplifier.
		PA will be enabled after playback output stabilizes to prevent pop noise.

if LISA_AUDIO_PLAY_PA_ENABLE

config LISA_AUDIO_PLAY_PA_PAD
	int "PA GPIO pad (0=PAD_A, 1=PAD_B)"
	default 0
	range 0 1
	help
		GPIO pad selection for PA control pin.
		0 = GPIOA, 1 = GPIOB.

config LISA_AUDIO_PLAY_PA_PIN
	int "PA GPIO pin number"
	default 0
	range 0 31
	help
		GPIO pin number for PA control (0-31).
		Example: Pin 0 on PAD_A = GPIOA0.

config LISA_AUDIO_PLAY_PA_PULSE_COUNT
	int "PA enable pulse count"
	default 3
	range 0 10
	help
		Number of high-low pulses to send when enabling PA.
		Some PA chips require pulse sequence for proper startup.
		Set to 0 to simply set pin high without pulses.

config LISA_AUDIO_PLAY_PA_PULSE_US
	int "PA pulse duration (microseconds)"
	default 50
	range 10 1000
	help
		Duration of each high/low level in PA enable pulse sequence.

endif # LISA_AUDIO_PLAY_PA_ENABLE

config LISA_AUDIO_PLAY_ECHO_DMA_CHN
	int "Echo capture DMA channel number"
	depends on LISA_AUDIO_PLAY_ECHO_ENABLE
	default 0
	range 0 5
	help
		GPDMA channel number used for Echo capture data transfer.
		Default: 0.

endmenu

endif # PORT_VENUSA
```
