## arcs-sdk/drivers/lisa_camera/Kconfig
```kconfig
# Copyright (c) 2025, LISTENAI
# SPDX-License-Identifier: Apache-2.0

menu "LISA Camera"
	config LISA_CAMERA_DEVICE
		bool "LISA Camera support"
		help
			Enable LISA Camera support

if LISA_CAMERA_DEVICE

choice LISA_CAMERA_BUS_TYPE
	prompt "Select bus type"
	default LISA_CAMERA_BUS_SPI

	config LISA_CAMERA_BUS_SPI
		bool "SPI Bus"
		select LISA_SPI_DEVICE
		help
			Use SPI bus for camera data.

	config LISA_CAMERA_BUS_DVP
		bool "DVP Bus"
		select LISA_DVP_DEVICE
		help
			Use DVP bus for camera data.

endchoice

config LISA_CAMERA_SENSOR_BF3901
	bool "BF3901"

config LISA_CAMERA_SENSOR_GC032A
	bool "GC032A"

config LISA_CAMERA_SENSOR_GC0328
	bool "GC0328"

config LISA_CAMERA_SENSOR_TC6036
	bool "TC6036"
	help
		Enable TC6036 camera sensor support (640x480 YUV422/RGB565)

endif #LISA_CAMERA_DEVICE

endmenu
```

## arcs-sdk/drivers/lisa_display/Kconfig
```kconfig
# LISA Display Driver Configuration
#
# Copyright (c) 2025, LISTENAI
# SPDX-License-Identifier: Apache-2.0

menuconfig LISA_DISPLAY_DEVICE
	bool "Enable LISA Display Device Driver"
	depends on LISA_DEVICE
	help
		Enable LISA Display device driver based on lisa_device framework.
		Provides unified interface for various display controllers.

if LISA_DISPLAY_DEVICE

config LISA_DISPLAY_COMPOSITE
	bool "Enable composite display mode"
	help
		Composite two physical displays into one logical wide display.

config LISA_DISPLAY_TE_SYNC
	bool "Enable TE (Tearing Effect) Sync Support"
	help
		Enable TE (Tearing Effect) synchronization support to prevent
		screen tearing when updating display.

choice LISA_DISPLAY_BACKLIGHT_TYPE
	prompt "Backlight Type"
	default LISA_DISPLAY_BACKLIGHT_PWM

	config LISA_DISPLAY_BACKLIGHT_PWM
		bool "PWM Backlight Control"
		select LISA_PWM
		help
			Enable PWM backlight control support.
	config LISA_DISPLAY_BACKLIGHT_WIRE_DIMMING
		bool "Wire Dimming Backlight Control"
		select LISA_GPIO_DEVICE
		help
			Enable wire dimming backlight control support.
endchoice

config LISA_DISPLAY_CPDMA_ROTATE
	bool "Enable CPDMA-based display rotation"
	help
		Enable this option to use CPDMA for hardware-accelerated display rotation.
		This provides better performance than SRAM-based rotation.

config LISA_DISPLAY_CPDMA_CH
	int "CPDMA channel for display 0"
	default 2
	range 0 3
	depends on LISA_DISPLAY_CPDMA_ROTATE
	help
		Select the CPDMA channel used by display 0 rotation.
		In independent rotate mode, this channel is dedicated to display 0.

config LISA_DISPLAY_CPDMA_CH_1
	int "CPDMA channel for display 1"
	default 3
	range 0 3
	depends on LISA_DISPLAY_CPDMA_ROTATE && LISA_DISPLAY_DUAL_INDEPENDENT_ROTATE
	help
		Select the CPDMA channel used by display 1 rotation.
		This must be different from CONFIG_LISA_DISPLAY_CPDMA_CH to allow
		both displays to perform DMA rotation in parallel.

config LISA_DISPLAY_COLOR_INVERT
	bool "Enable LCD color invert"
	default y
	help
		If enabled, LCD color will be inverted.

config LISA_DUAL_DISPLAY
	bool "Enable Dual Display Support"
	help
		Enable support for dual display (two independent displays).
		Each display can use different panel drivers and configurations.

config LISA_DISPLAY_DUAL_INDEPENDENT_ROTATE
	bool "Enable Independent Rotation Resources Per Display"
	depends on LISA_DUAL_DISPLAY
	help
		When enabled, each display instance has its own rotation buffers
		and mutex, allowing both displays to perform rotation simultaneously
		without contention. This doubles the rotation buffer memory usage.

		When disabled, all display instances share one set of rotation
		buffers and mutex (default behavior).

		Note: In independent mode with CPDMA enabled, each display uses
		a dedicated CPDMA channel (CONFIG_LISA_DISPLAY_CPDMA_CH and
		CONFIG_LISA_DISPLAY_CPDMA_CH_1), so DMA transfers run in parallel.

endif # LISA_DISPLAY_DEVICE

rsource "panels/Kconfig"
rsource "bus/Kconfig"
```

## arcs-sdk/drivers/lisa_display/bus/Kconfig
```kconfig
menu "Display Bus Configuration"

if LISA_DISPLAY_DEVICE
    config LISA_DISPLAY_BUS_SPI_4WIRE
        bool "Enable 4-Wire SPI Bus Support"
        select LISA_SPI_DEVICE
        select LISA_GPIO_DEVICE
        help
            Enable 4-wire SPI bus interface support for display devices.

if LISA_DISPLAY_BUS_SPI_4WIRE

    config LISA_DISPLAY_SPI_4WIRE_DMA_CH
        int "SPI 4-Wire DMA Channel"
        default 3
        range 0 3
        help
            GPDMA channel number used for SPI 4-wire display data transfer.

endif # LISA_DISPLAY_BUS_SPI_4WIRE

    config LISA_DISPLAY_BUS_QSPI
        bool "Enable QSPI Bus Support"
        select LISA_QSPILCD_DEVICE
        help
            Enable QSPI bus interface support for display devices.

    config LISA_DISPLAY_BUS_SPI_3WIRE
        bool "Enable 3-Wire SPI Bus Support"
        help
            Enable 3-wire SPI bus interface support for display devices.

    config LISA_DISPLAY_BUS_RGB
        select LISA_RGB_DEVICE
        bool "Enable RGB Parallel Bus Support"
        help
            Enable RGB parallel bus interface support for display devices.

    config LISA_DISPLAY_CMD_BUS_SW_SPI
        bool "Enable Software SPI Command Bus Support"
        help
            Enable software SPI command bus interface support for display devices.

endif # LISA_DISPLAY_DEVICE
endmenu
```

## arcs-sdk/drivers/lisa_display/panels/Kconfig
```kconfig
# Copyright (c) 2025, LISTENAI
# SPDX-License-Identifier: Apache-2.0

if LISA_DISPLAY_DEVICE

config LISA_DISPLAY_PANEL_ST7789P3
	bool "ST7789P3 Panel Driver"
	help
		Enable driver for ST7789P3 display panel.

config LISA_DISPLAY_PANEL_AXS15231B
	bool "AXS15231B Panel Driver"
	help
		Enable driver for AXS15231B display panel.

config LISA_DISPLAY_PANEL_ST7701S
	bool "ST7701S Panel Driver"
	help
		Enable Driver for ST7701S display panel.

config LISA_DISPLAY_PANEL_GC9A01
	bool "GC9A01 Panel Driver"
	help
		Enable driver for GC9A01 display panel.

config LISA_DISPLAY_PANEL_GC9D01N
	bool "GC9D01N Panel Driver"
	help
		Enable driver for GC9D01N display panel.

config LISA_DISPLAY_PANEL_NV3030B
	bool "NV3030B Panel Driver"
	help
		Enable driver for NV3030B display panel (170x320, SPI 4-wire).

rsource "Kconfig.axs15231b"
rsource "Kconfig.st7789p3"
rsource "Kconfig.st7701s"
rsource "Kconfig.gc9a01"
rsource "Kconfig.gc9d01n"
rsource "Kconfig.nv3030b"

endif
```

## arcs-sdk/drivers/lisa_display/panels/Kconfig.axs15231b
```kconfig
menu "AXS15231B Display Panel"

if LISA_DISPLAY_PANEL_AXS15231B

    config PANEL_AXS15231B_WIDTH
        int "screen width"
        default 176
        help
        The pixel length in the x-axis direction of the display screen, the maximum value is 172.

    config PANEL_AXS15231B_HEIGHT
        int "screen height"
        default 560
        help
        The pixel length in the y-axis direction of the display screen, the maximum value is 640.

    config PANEL_AXS15231B_X_OFFSET
        int "display screen x offset"
        default 0
        help
        The pixel offset in the x-axis direction of the display screen.

    config PANEL_AXS15231B_Y_OFFSET
        int "screen y offset"
        default 0
        help
        The pixel offset in the y-axis direction of the display screen.
    
    config ROTATE_BUF_MAX_HEIGHT
        int "roate buffer buffer max height"
        default PANEL_AXS15231B_WIDTH

endif

endmenu
```

## arcs-sdk/drivers/lisa_display/panels/Kconfig.gc9307
```kconfig
# Copyright (c) 2025, LISTENAI
# SPDX-License-Identifier: Apache-2.0

menu "GC9307 Display Panel"

if LISA_DISPLAY_PANEL_GC9307

config PANEL_GC9307_WIDTH
	int "screen width"
	default 240
	help
	The pixel length in the x-axis direction of the display screen.

config PANEL_GC9307_HEIGHT
	int "screen height"
	default 320
	help
	The pixel length in the y-axis direction of the display screen.

config PANEL_GC9307_X_OFFSET
	int "display screen x offset"
	default 0
	help
	The pixel offset in the x-axis direction of the display screen.

config PANEL_GC9307_Y_OFFSET
	int "screen y offset"
	default 0
	help
	The pixel offset in the y-axis direction of the display screen.

config ROTATE_BUF_MAX_HEIGHT
	int "rotate buffer max height"
	default PANEL_GC9307_WIDTH

endif

endmenu
```

## arcs-sdk/drivers/lisa_display/panels/Kconfig.gc9d01n
```kconfig
menu "GC9D01N Display Panel"

if LISA_DISPLAY_PANEL_GC9D01N

config PANEL_GC9D01N_WIDTH
    int "screen width"
    default 160
    help
    The pixel length in the x-axis direction of the display screen, the maximum value is 172.

config PANEL_GC9D01N_HEIGHT
    int "screen height"
    default 160
    help
    The pixel length in the y-axis direction of the display screen, the maximum value is 640.

config PANEL_GC9D01N_X_OFFSET
    int "screen x offset"
    default 0
    help
    The pixel offset in the x-axis direction of the display screen.

config PANEL_GC9D01N_Y_OFFSET
    int "screen y offset"
    default 0
    help
    The pixel offset in the y-axis direction of the display screen.

config ROTATE_BUF_MAX_HEIGHT
    int "rotate buffer max height"
    default PANEL_GC9D01N_WIDTH

endif

endmenu
```

## arcs-sdk/drivers/lisa_display/panels/Kconfig.nv3030b
```kconfig
# Copyright (c) 2025, LISTENAI
# SPDX-License-Identifier: Apache-2.0

menu "NV3030B Display Panel"

if LISA_DISPLAY_PANEL_NV3030B

config PANEL_NV3030B_WIDTH
	int "screen width"
	default 170
	help
	The pixel length in the x-axis direction of the display screen.

config PANEL_NV3030B_HEIGHT
	int "screen height"
	default 320
	help
	The pixel length in the y-axis direction of the display screen.

config PANEL_NV3030B_X_OFFSET
	int "display screen x offset"
	default 35
	help
	The pixel offset in the x-axis direction of the display screen.

config PANEL_NV3030B_Y_OFFSET
	int "screen y offset"
	default 0
	help
	The pixel offset in the y-axis direction of the display screen.

config ROTATE_BUF_MAX_HEIGHT
	int "rotate buffer max height"
	default PANEL_NV3030B_WIDTH

endif

endmenu
```

## arcs-sdk/drivers/lisa_display/panels/Kconfig.st7701s
```kconfig
menu "ST7701S Display Panel"

if LISA_DISPLAY_PANEL_ST7701S

config PANEL_ST7701S_WIDTH
    int "screen width"
    default 480
    help
    The pixel length in the x-axis direction of the display screen, the maximum value is 480.

config PANEL_ST7701S_HEIGHT
    int "screen height"
    default 480
    help
    The pixel length in the y-axis direction of the display screen, the maximum value is 480.

config PANEL_ST7701S_X_OFFSET
    int "display screen x offset"
    default 0
    help
    The pixel offset in the x-axis direction of the display screen.

config PANEL_ST7701S_Y_OFFSET
    int "screen y offset"
    default 0
    help
    The pixel offset in the y-axis direction of the display screen.

config ROTATE_BUF_MAX_HEIGHT
    int "roate buffer buffer max height"
    default PANEL_ST7701S_WIDTH

endif

endmenu
```

## arcs-sdk/drivers/lisa_display/panels/Kconfig.st7789p3
```kconfig
menu "ST7789P3 Display Panel"

if LISA_DISPLAY_PANEL_ST7789P3

config PANEL_ST7789P3_WIDTH
    int "screen width"
    default 170
    help
    The pixel length in the x-axis direction of the display screen, the maximum value is 240.

config PANEL_ST7789P3_HEIGHT
    int "screen height"
    default 320
    help
    The pixel length in the y-axis direction of the display screen, the maximum value is 240.

config PANEL_ST7789P3_X_OFFSET
    int "display screen x offset"
    default 35
    help
    The pixel offset in the x-axis direction of the display screen.

config PANEL_ST7789P3_Y_OFFSET
    int "screen y offset"
    default 0
    help
    The pixel offset in the y-axis direction of the display screen.

config ROTATE_BUF_MAX_HEIGHT
    int "roate buffer buffer max height"
    default PANEL_ST7789P3_WIDTH

endif

endmenu
```

## arcs-sdk/drivers/lisa_dvp/Kconfig
```kconfig
# Copyright (c) 2025, LISTENAI
# SPDX-License-Identifier: Apache-2.0

menuconfig LISA_DVP_DEVICE
	bool "LISA DVP driver"
	help
		Enable LISA DVP driver.

if LISA_DVP_DEVICE

config LISA_DVP_VENUSA_USE_CMNDMA
	bool "Use Venusa CMNDMA for LISA DVP"
	depends on SOC_VENUSA
	default y
	help
		Use Venusa CMNDMA for DVP capture by default. This backend
		corresponds to the ARCS CPDMA semantics, while the disabled
		state keeps the DMA2D backend corresponding to ARCS GPDMA.
		Ping-Pong mode uses the DMA HAL hardware PiPo/LLP path.
		TODO: 待hal解决DMA2D AMP双核架构下冲突问题, 考虑取消默认, 对齐arcs使用GPDMA(即DMA2D)

endif # LISA_DVP_DEVICE
```

## arcs-sdk/drivers/lisa_flash/Kconfig
```kconfig
# Copyright (c) 2025, LISTENAI
# SPDX-License-Identifier: Apache-2.0

menuconfig LISA_FLASH
	bool "Enable LISA Flash Driver"
	depends on LISA_DEVICE
	select LISA_FLASH_ARCS if SOC_ARCS
	select LISA_FLASH_ARCS if BOARD_ARCS_EVB
	select LISA_FLASH_ARCS if BOARD_ARCS_MINI
	select LISA_FLASH_VENUSA if SOC_VENUSA

	help
		Enable Flash device driver support for read/write/erase operations.

config LISA_FLASH_ARCS_HALT_BY_REMOTE_CORE
	bool "Allow this core to be halted during remote Flash operations"
	select ARCS_HAL_IPC
	select ARCS_HAL_IPC_HALT_BY_PEER_CORE
	help
			Allow this core to be halted by a remote core during LISA Flash
			operations.

if LISA_FLASH

config LISA_FLASH_HALT_REMOTE_CORE
	bool "Enable Flash remote-core halt protection"
	depends on SOC_VENUSA
	imply IPC_CIDU if SOC_VENUSA
	imply IC_MESSAGE_AUTO_INIT if SOC_VENUSA
	help
		Enable platform-specific protection for Flash operations that must
		stop or wait the remote core. On VenusA this weakly enables the CIDU
		ic_message backend and its SYS_INIT auto-init.

config LISA_FLASH_HOOK_WAITER_ONLY
	bool "Register Flash hook waiter without initializing Flash HAL"
	depends on LISA_FLASH_HALT_REMOTE_CORE
	depends on SOC_VENUSA
	help
		Register only the Flash hook ic-message receiver on a peer core that
		waits for remote Flash operations. The core will not initialize the
		Flash HAL, avoiding QSPI/Flash controller changes while the peer core
		owns Flash access.

config LISA_FLASH_INIT_PRIORITY
	int "LISA Flash init priority"
	default 15
	help
		LISA Flash driver device initialization priority. This initialization
		priority is used unless the driver implementation has its own
		initialization priority

rsource "Kconfig.arcs"
rsource "Kconfig.venusa"

endif # LISA_FLASH
```
