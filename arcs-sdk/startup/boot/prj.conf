## Kconfig
```
osource "$LISTENAI_MODULES"
rsource "Kconfig.boot"
```

## Kconfig.boot
```
config BOOT_AP_ENTRY
    hex "AP entry"
    default 0

config BOOT_CP_ENTRY
    hex "CP entry"
    default 0
    depends on !MEM_CONFIG

config BOOT_FLASH_SIZE
    hex "Flash size"
    default 0x4000

choice
    prompt "boot log level"
    default BOOT_LOG_LVL_ERR

    config BOOT_LOG_LVL_NON
        bool "non"
    config BOOT_LOG_LVL_ERR
        bool "err"
    config BOOT_LOG_LVL_WRN
        bool "wrn"
    config BOOT_LOG_LVL_INF
        bool "inf"
    config BOOT_LOG_LVL_DBG
        bool "dbg"

config BOOT_UART_PORT
    int "boot log port"
    default SYSLOG_UART_PORT if BOOT
    default 0

config BOOT_UART_TX_PIN
    int "boot uart tx pin"
    default SYSLOG_UART_TX_PIN if BOOT
    default 3

config BOOT_UART_BAUDRATE
    int "boot log baud rate"
    default SYSLOG_UART_BAUDRATE if BOOT
    default 921600

config BOOT_UART_PIN_FUNC_SEL
    int "boot log pin func sel"
    default SYSLOG_UART_TX_PIN_FUNC_SEL if BOOT
    default 2

endchoice
```

## prj.conf
```kconfig
# 项目可根据需要在此文件中设置对应的配置
CONFIG_LINK_OPTION_LISTENAI_LIBRARY_NONE=y
```

## src/boot.c
```c
#include "chip.h"
#include "memap.h"
#include "PSRAMManager.h"
#include "ClockManager.h"

#include "boot_log.h"

#include <stdint.h>

extern uint32_t __scat_copy_base, __scat_copy_last, __scat_zero_base, __scat_zero_last;
extern uint32_t __psram_scat_copy_base, __psram_scat_copy_last, __psram_scat_zero_base, __psram_scat_zero_last;

typedef struct {
    uint32_t len, *vma, *lma;
} scat_copy_item_t;
typedef struct {
    uint32_t len, *vma;
} scat_zero_item_t;

static __attribute__((section(".init"))) void _scatload(uint32_t *dst, const uint32_t *src, uint32_t cnt)
{
    while (cnt--) {
        *dst++ = *src++;
    }
}

static __attribute__((section(".init"))) void _scatfill(uint32_t *dst, uint32_t fill, int cnt)
{
    while (cnt--) {
        *dst++ = fill;
    }
}

static __attribute__((section(".init"))) void scatload(void)
{
    for (scat_copy_item_t *item = (void *)&__scat_copy_base; (uint32_t *)item < &__scat_copy_last; item++) {
        if (item->vma && item->len >= sizeof(uint32_t) && item->vma != item->lma) {
            _scatload(item->vma, item->lma, item->len >> 2);
        }
    }

    for (scat_zero_item_t *item = (void *)&__scat_zero_base; (uint32_t *)item < &__scat_zero_last; item++) {
        if (item->vma && item->len >= sizeof(uint32_t)) {
            _scatfill(item->vma, 0, item->len >> 2);
        }
    }
}

static void scatload_psram(void)
{
    for (scat_copy_item_t *item = (void *)&__psram_scat_copy_base; (uint32_t *)item < &__psram_scat_copy_last; item++) {
        if (item->vma && item->len >= sizeof(uint32_t) && item->vma != item->lma) {
            _scatload(item->vma, item->lma, item->len >> 2);
        }
    }

    for (scat_zero_item_t *item = (void *)&__psram_scat_zero_base; (uint32_t *)item < &__psram_scat_zero_last; item++) {
        if (item->vma && item->len >= sizeof(uint32_t)) {
            _scatfill(item->vma, 0, item->len >> 2);
        }
    }
}

void irq_default_handler(void)
{

}

#define FALLBACK_DEFAULT_ECLIC_BASE    0x0C000000UL
#define FALLBACK_DEFAULT_SYSTIMER_BASE 0x02000000UL

volatile IRegion_Info_Type SystemIRegionInfo;
static void _get_iregion_info(volatile IRegion_Info_Type *iregion)
{
    unsigned long mcfg_info;
    if (iregion == NULL) {
        return;
    }
    mcfg_info = __RV_CSR_READ(CSR_MCFG_INFO);
    if (mcfg_info & MCFG_INFO_IREGION_EXIST) { // IRegion Info present
        iregion->iregion_base = (__RV_CSR_READ(CSR_MIRGB_INFO) >> 10) << 10;
        iregion->eclic_base = iregion->iregion_base + IREGION_ECLIC_OFS;
        iregion->systimer_base = iregion->iregion_base + IREGION_TIMER_OFS;
        iregion->smp_base = iregion->iregion_base + IREGION_SMP_OFS;
        iregion->idu_base = iregion->iregion_base + IREGION_IDU_OFS;
    } else {
        iregion->eclic_base = FALLBACK_DEFAULT_ECLIC_BASE;
        iregion->systimer_base = FALLBACK_DEFAULT_SYSTIMER_BASE;
    }
}

static const uint32_t psram_size[] = {0, 32, 0, 64, 0, 128, 512, 256};

void boot_run(void)
{
    __disable_irq();

    scatload();

    _get_iregion_info(&SystemIRegionInfo);

    extern void BootClock_Init();
    BootClock_Init();
    __FENCE_I();

    bootlog_init(CONFIG_BOOT_UART_PORT, CONFIG_BOOT_UART_BAUDRATE);

    bootlog_dbg("main  clk: %d Hz\n", CRM_GetSrcFreq(CRM_IpSrcCoreClk));
    bootlog_dbg("psram clk: %d Hz\n", CRM_GetPsramFreq());

    uint32_t rdly = 18, wdly = 22;
    int r;

    r = PSRAM_Initialize(&rdly, &wdly, 1);
    if (r != 0) {
        bootlog_err("psram error, code: %d\n", r);
        while(1);
    }

    uint32_t density = ((IP_PSRAM_CTRL->REG_MR2.all & 0xff) >> 0) & 0x07;
    if (density < sizeof(psram_size)/ sizeof(psram_size[0])) {
        bootlog_dbg("psram inf, size: %d Mbit, w: %d, r: %d\n", psram_size[density], wdly, rdly);
    } else {
        bootlog_dbg("psram inf, size: unknown, w: %d, r: %d\n", wdly, rdly);
    }

    for (int i = 0; i < IRQ_MAX; i++) {
        disable_IRQ(i);
        clear_IRQ(i);
    }

#if defined CONFIG_BOOT_CP_ENTRY
    IP_CMN_SYS->REG_N300_CP_RST_ADDR.all = (uint32_t)CONFIG_BOOT_CP_ENTRY;
    IP_SYSCTRL->REG_SW_RESET_CP0.all = 0xCAFE000A;
    bootlog_dbg("cp: 0x%x\n", CONFIG_BOOT_CP_ENTRY);
#endif

#if defined CONFIG_BOOT_AP_ENTRY
    if (CONFIG_BOOT_AP_ENTRY) {
        void (*ap_core_start)(void) = (void (*)(void))CONFIG_BOOT_AP_ENTRY;
        ap_core_start();
        bootlog_dbg("ap: 0x%x\n", CONFIG_BOOT_AP_ENTRY);
    }
#endif

    bootlog_inf("ap: none\n");

    while (1) {
        __WFI();
    }
}
```

## src/boot_log.c
```c
#include "stdint.h"
#include "log_print.h"

#include <stdio.h>
#include "uart_reg.h"
#include "chip.h"
#include "ClockManager.h"
#include "IOMuxManager.h"

static UART_RegDef *uart = NULL;

static uint32_t compute_gcd(uint32_t a, uint32_t c)
{
    uint32_t t;
    while (c != 0) {
        t = a % c;
        a = c;
        c = t;
    }
    return a;
}

static int32_t __log_compute_div(int dbg, uint32_t baudrate, uint32_t *pm, uint32_t *pn, uint32_t div)
{
    uint32_t gcd, m, n, tmp;
    int32_t ret = 0;

    tmp = div * baudrate;
    uint32_t uart_clk;

    if (dbg == 0) {
        uart_clk = 24000000;
    } else if (dbg == 1) {
        uart_clk = 24000000;
    }

    gcd = compute_gcd(uart_clk, tmp);
    m = uart_clk / gcd;
    n = tmp / gcd;

    if ((m > 1023) || (n > 511)) {
        return -1;
    }

    *pm = m;
    *pn = n;

    return 0;
}

static int32_t log_compute_div(int dbg, uint32_t baudrate, uint32_t *pm, uint32_t *pn, uint32_t *pdiv)
{
    int32_t ret = 0;

    do {
        if (__log_compute_div(dbg, baudrate, pm, pn, 4) == 0) {
            *pdiv = 4;
            break;
        }
        if (__log_compute_div(dbg, baudrate, pm, pn, 16) == 0) {
            *pdiv = 16;
            break;
        }
        ret = -1;
    } while (0);

    return ret;
}
#define CONFIG_SYSLOG_UART_TX_PIN          3
#define CONFIG_SYSLOG_UART_TX_PIN_FUNC_SEL 0x2

static void __log_io_config(int dbg)
{
    IOMuxManager_PinConfigure(CSK_IOMUX_PAD_A, CONFIG_SYSLOG_UART_TX_PIN, CONFIG_SYSLOG_UART_TX_PIN_FUNC_SEL);
}

int syslog_write(const char *data, int len)
{
    if (uart == NULL || data == NULL || len == 0) {
        return 0;
    }

    for (int i = 0; i < len; i++) {
        uart->REG_RXTX_BUFFER.all = data[i];
        while (!uart->REG_STATUS.bit.TX_FIFO_SPACE)
            ;
    }

    return len;
}

int bootlog_init(int dbg, uint32_t baudrate)
{
    uint32_t m, n, div, uart_base, cmn_reg;

    if (log_compute_div(dbg, baudrate, &m, &n, &div) < 0) {
        return -1;
    }

    __log_io_config(dbg);

    switch (dbg) {
    case 0:
        uart = (UART_RegDef *)UART0_BASE;

        __HAL_CRM_UART0_CLK_ENABLE();
        HAL_CRM_SetUart0ClkDiv(n, m);
        break;
    case 1:
    default:
        uart = (UART_RegDef *)UART1_BASE;

        __HAL_CRM_UART1_CLK_ENABLE();
        HAL_CRM_SetUart1ClkDiv(n, m);
        break;
    }

    uart->REG_IRQ_MASK.all = 0;
    uart->REG_CTRL.all = 0;

    if (div == 16) {
        uart->REG_CTRL.bit.DIVISOR_MODE = 1; // 0: sclk/4; 1: sclk/16
    } else {
        uart->REG_CTRL.bit.DIVISOR_MODE = 0;
    }

    uart->REG_CMD_SET.bit.TX_FIFO_RESET = 1; // reset tx fifo
    uart->REG_CMD_SET.bit.RX_FIFO_RESET = 1; // reset rx fifo

    uart->REG_CTRL.bit.DATA_BITS = 1; // 8bits
    uart->REG_CTRL.bit.ENABLE = 1;    // enable uart
    uart->REG_STATUS.all = 1;         // clear line error bits

    return 0;
}

static void int_to_str(int value, char *buf, size_t *written)
{
    if (value < 0) {
        buf[(*written)++] = '-';
        value = -value;
    }
    if (value == 0) {
        buf[(*written)++] = '0';
        return;
    }

    char temp[10];
    size_t index = 0;

    while (value > 0) {
        temp[index++] = (value % 10) + '0';
        value /= 10;
    }

    for (size_t i = 0; i < index; i++) {
        if (*written < 512 - 1) {
            buf[(*written)++] = temp[index - 1 - i];
        }
    }
}

static void uint_to_hex_str(unsigned int value, char *buf, size_t *written)
{
    if (value == 0) {
        buf[(*written)++] = '0';
        return;
    }

    char temp[8];
    size_t index = 0;

    while (value > 0) {
        unsigned int digit = value % 16;
        temp[index++] = (digit < 10) ? (digit + '0') : (digit - 10 + 'a');
        value /= 16;
    }

    for (size_t i = 0; i < index; i++) {
        if (*written < 512 - 1) {
            buf[(*written)++] = temp[index - 1 - i];
        }
    }
}

int bootlog_vsnprintf(char *buf, size_t size, const char *format, va_list args)
{
    size_t written = 0;
    const char *p;

    for (p = format; *p != '\0'; p++) {
        if (*p != '%') {
            if (written < size - 1) {
                buf[written++] = *p;
            }
            continue;
        }

        p++;
        switch (*p) {
        case 'd': {
            int value = va_arg(args, int);
            int_to_str(value, buf, &written);
            break;
        }
        case 'x': {
            unsigned int value = va_arg(args, unsigned int);
            uint_to_hex_str(value, buf, &written);
            break;
        }
        case 's': {
            const char *str = va_arg(args, const char *);
            while (*str && written < size - 1) {
                buf[written++] = *str++;
            }
            break;
        }
        default:
            if (written < size - 1) {
                buf[written++] = '%';
                buf[written++] = *p;
            }
            break;
        }
    }

    if (written < size) {
        buf[written] = '\0';
    } else if (size > 0) {
        buf[size - 1] = '\0';
    }

    return written;
}

void bootlog_output(const char *format, va_list args)
{
    static uint8_t buffer[512] = {0};
    uint32_t len = bootlog_vsnprintf((char *)buffer, 512 - 1, format, args);
    buffer[len] = '\0';
    syslog_write(buffer, len);
}

int vprintk(const char *format, va_list args)
{
    bootlog_output(format, args);

    return 0;
}

int printk(const char *format, ...)
{
    va_list args;
    va_start(args, format);
    vprintk(format, args);
    va_end(args);
    return 0;
}
```

## src/memap.h
```c
#ifndef __ARCS_MEMAP_HEADER__
#define __ARCS_MEMAP_HEADER__

#define MEM_SRAM_BASE 0x20050000
#define MEM_SRAM_SIZE (384 * 1024)

#define MEM_PSRAM_BASE 0x28000000
#define MEM_PSRAM_SIZE (16 * 1024 * 1024)

#ifndef CONFIG_BOOT_FLASH_SIZE
#warning "BOOT_FLASH_SIZE is not defined"
#define CONFIG_BOOT_FLASH_SIZE (8 * 1024)
#endif

#define MEM_FLASH_BASE (CONFIG_MEM_FLASH_BASE)
#define MEM_FLASH_SIZE (CONFIG_BOOT_FLASH_SIZE)

#define MEM_WFRAM_BASE 0x20000000
#define MEM_WFRAM_SIZE (256 * 1024)

#define MEM_ILM_BASE 0x00080000
#define MEM_ILM_SIZE (16 * 1024)

#define MEM_DLM_BASE 0x00100000
#define MEM_DLM_SIZE (8 * 1024)

#define MEM_WIFI_CALIBRATION_SIZE (16 * 1024)
#define MEM_WIFI_TRACE_SIZE       (8 * 1024)

#define MEM_INTERRUPT_STACK_SIZE (4 * 1024)

#endif
```
