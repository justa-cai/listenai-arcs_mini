## CMakeLists.txt
```
cmake_minimum_required(VERSION 3.19)

set(CMAKE_EXPORT_COMPILE_COMMANDS ON)

find_package(listenai-cmake REQUIRED HINTS $ENV{ARCS_BASE})

project(ap)

listenai_include_directories(
    ./
)

add_subdirectory(src)

listenai_add_executable(${PROJECT_NAME})
```

## prj.conf
```kconfig
# AP 核固件：仅做 PM 唤醒分支判断、引导 CP 后进入 WFI 空转
#
# 这是 wifi_pm 的"独立 AP 固件"，不再依赖 SDK 通用 uboot。
# 镜像直接落在 flash 起始 1MB（0x30000000-0x30100000），
# CP 镜像紧随其后从 0x30100000 起。

CONFIG_ARCS_AP_CORE=y
# 关闭 SDK 内置 uboot 合并：本镜像本身就是 AP 启动固件
CONFIG_BOOT=n

# AP 内存布局：使用 SDK Kconfig 默认值（ARCS_AP_CORE 默认 0x20034800 起 78KB）。
# CP 走默认 146KB（0x20010000-0x20034800），AP 紧跟其后，物理不重叠。
CONFIG_MEM_FLASH_BASE=0x30000000
CONFIG_MEM_FLASH_SIZE=0x00100000
# AP 不跑 WiFi
CONFIG_MEM_WFRAM_SIZE=0
CONFIG_MEM_WIFI_CALIBRATION_SIZE=0
CONFIG_MEM_WIFI_TRACE_SIZE=0
# PSRAM 物理上由 CP 全权管理；AP 这里只是把 PSRAM 区域声明出来，
# 让 SDK 的 scatload_psram / dcache 维护代码能链接通过。
# AP 不会把任何 .psram.* 段塞进去，scatload 表实际为空。
CONFIG_MEM_PSRAM_BASE=0x28000000
CONFIG_MEM_PSRAM_SIZE=0x01000000
# 与 CP 一致：不启用 LUNA 共享内存 / IPC 隔离 / APRAM
CONFIG_MEM_LUNA_SHARED_SIZE=0
CONFIG_MEM_IPC_ISOLATED=n
CONFIG_MEM_APRAM_SIZE=0

# SRAM 堆 32KB 给 SDK 启动 + FreeRTOS + UART/log buffer 用
# （默认 8KB 太小，会触发 heap_caps 失败回调直接 __builtin_trap）
CONFIG_HEAP_SIZE=0x8000
# AP 完全不用 PSRAM heap：注册 size=0 的 PSRAM heap 反而会让 MALLOC_CAP_DEFAULT
# 路径走到空 heap 后失败。直接禁用 PSRAM heap 模块，让所有 alloc 走 SRAM heap。

CONFIG_BACK_TRACE=y

# 日志走 UART1（与 CP 共用），方便观察启动顺序
CONFIG_CONSOLE_UART_NAME="uart1"
CONFIG_CONSOLE_UART_BAUDRATE=115200
CONFIG_SYSLOG_UART_DEVICE_UART1=y
CONFIG_SYSLOG_UART_PORT=1
CONFIG_SYSLOG_UART_BAUDRATE=115200
CONFIG_PRINTF_LOG_REDIRECT=y
```

## src/main.c
```c
/*
 * wifi_pm 独立 AP 固件
 *
 * 启动流程：
 *   1. SDK startup.S 早期钩子 arcs_early_startup_hook() 在 sp/gp/MTVT 设置完成
 *      之后、scatload 之前调用 ap_startup_dispatch()。该阶段 .data 未拷贝、
 *      .bss 未清零，dispatch 只能用寄存器和 MMIO，禁止访问任何全局变量。
 *      - REG_AON_DIG_RSVD0 == JUMP_NONE: 清标志后进入 WFI 死循环，不返回
 *      - REG_AON_DIG_RSVD0 == JUMP_RAM : 把 CP 复位到 RAM 入口后进入 WFI 死循环，
 *                                        不返回
 *      - 其它（冷启动）: dispatch 直接 return，SDK 通用启动继续
 *   2. SDK 跑完 scatload + soc_init + freertos 后进入 main()
 *   3. main() 引导 CP 从 flash 起来，然后 __WFI() 空转
 *
 * 不再使用独立的 boot.S / linker.ld；启动流程完全交给 SDK 通用启动。
 */

#include <stdint.h>

#include "chip.h"
#include "memap.h"

#include "IOMuxManager.h"

#define TAG "wifi_pm_ap"
#include "lisa_log.h"

#define WAKEUP_ACT_JUMP_RAM     (0xAA)
#define WAKEUP_ACT_JUMP_NONE    (0xFF)

void lisa_uart1_pinmux(void)
{
    IOMuxManager_PinConfigure(CSK_IOMUX_PAD_A, 4, CSK_IOMUX_FUNC_ALTER3);
    IOMuxManager_PinConfigure(CSK_IOMUX_PAD_A, 5, CSK_IOMUX_FUNC_ALTER3);
}

/*
 * 早期 PM 唤醒分支：在 SDK startup.S 的 arcs_early_startup_hook 里调用。
 * 此函数运行在 .data/.bss 未初始化的极早期，禁止使用任何全局变量。
 * 仅处理 JUMP_NONE / JUMP_RAM；冷启动直接 return，由 main() 走正常 flash 引导。
 */
static void ap_startup_dispatch(void)
{
    uint32_t act = IP_AON_CTRL->REG_AON_DIG_RSVD0.all;

    if (act == WAKEUP_ACT_JUMP_NONE) {
        IP_AON_CTRL->REG_AON_DIG_RSVD0.all = 0;
        goto wfi_loop;
    }

    if (act == WAKEUP_ACT_JUMP_RAM) {
        if ((IP_AON_CTRL->REG_WAKEUP_ISR.all == 0) &&
            (IP_AON_CTRL->REG_AON_DIG_RSVD2.all == WAKEUP_ACT_JUMP_RAM)) {
            IP_CMN_SYS->REG_N300_CP_RST_ADDR.all = IP_AON_CTRL->REG_AON_DIG_RSVD3.all;
            IP_SYSCTRL->REG_SW_RESET_CP0.all = 0xCAFE000A;
        }
        goto wfi_loop;
    }

    return;

wfi_loop:
    do {
        __WFI();
    } while (1);
}

/* SDK startup.S 的 weak 钩子：在 scatload 之前调用，覆盖默认 no-op 实现。 */
void arcs_early_startup_hook(void)
{
    ap_startup_dispatch();
}

static void boot_cp_from_flash(void)
{
    LOGI("boot cp from flash: 0x%x", (unsigned)MEM_CP_FLASH_BASE);
    IP_CMN_SYS->REG_N300_CP_RST_ADDR.all = MEM_CP_FLASH_BASE;
    IP_SYSCTRL->REG_SW_RESET_CP0.all = 0xCAFE000A;
}

int main(int argc, char **argv)
{
    (void)argc;
    (void)argv;

    boot_cp_from_flash();

    LOGI("ap idle");

    while (1) {
        __WFI();
    }
    return 0;
}
```
