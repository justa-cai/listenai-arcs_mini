## arcs-sdk/test/components/simple_box/testcase.yaml
```yaml
tests:
  test.components.simple_box:
    programmer: arcs
    runner: uart
    log_analyzer: Unity
    
```

## arcs-sdk/test/components/uboot_ota_api/testcase.yaml
```yaml
tests:
  test.components.uboot_ota_api:
    programmer: arcs
    runner: uart
    log_analyzer: Unity
```

## arcs-sdk/test/cpputest/testcase.yaml
```yaml
tests:
  test.cpputest:
    programmer: arcs
    runner: uart
    log_analyzer:
      type: "regex"
      pattern: "OK \\("
    
```

## arcs-sdk/test/driver/calendar/testcase.yaml
```yaml
tests:
  test.driver.calendar:
    programmer: arcs
    runner: uart
    log_analyzer: Unity
    
```

## arcs-sdk/test/driver/dma/testcase.yaml
```yaml
tests:
  test.driver.dma:
    programmer: arcs
    runner: uart
    log_analyzer: Unity
    
```

## arcs-sdk/test/driver/dualtimer/testcase.yaml
```yaml
tests:
  test.driver.dualtimer:
    programmer: arcs
    runner: uart
    log_analyzer: Unity
    
```

## arcs-sdk/test/driver/efuse/testcase.yaml
```yaml
tests:
  test.driver.efuse:
    programmer: arcs
    runner: uart
    log_analyzer: Unity
    
```

## arcs-sdk/test/driver/gpadc/testcase.yaml
```yaml
tests:
  test.driver.gpadc:
    programmer: arcs
    runner: uart
    log_analyzer: Unity
    
```

## arcs-sdk/test/driver/lisa_audio/testcase.yaml
```yaml
tests:
  test.driver.lisa_audio:
    programmer: arcs
    runner: uart
    log_analyzer: Unity
```

## arcs-sdk/test/driver/lisa_device/testcase.yaml
```yaml
tests:
  test.driver.lisa_device:
    programmer: arcs
    runner: uart
    log_analyzer: Unity
    
```

## arcs-sdk/test/driver/lisa_i2s/testcase.yaml
```yaml
tests:
  test.driver.lisa_i2s:
    programmer: arcs
    runner: uart
    log_analyzer: Unity
```

## arcs-sdk/test/driver/lisa_sdmmc/testcase.yaml
```yaml
tests:
  test.driver.lisa_sdmmc:
    programmer: arcs
    runner: uart
    log_analyzer: Unity
    
```

## arcs-sdk/test/driver/psram_manager/testcase.yaml
```yaml
tests:
  test.driver.psram_manager:
    programmer: arcs
    runner: uart
    log_analyzer:
      type: "regex"
      pattern: "PSRAM initialize success"
```

## arcs-sdk/test/driver/trng/testcase.yaml
```yaml
tests:
  test.driver.trng:
    programmer: arcs
    runner: uart
    log_analyzer: Unity
    
```

## arcs-sdk/test/driver/uart/testcase.yaml
```yaml
tests:
  test.driver.uart:
    programmer: arcs
    runner: uart
    log_analyzer: Unity
    
```

## arcs-sdk/test/driver/vaddr_remap/boot/Kconfig
```kconfig
# Copyright (c) 2025, LISTENAI
# SPDX-License-Identifier: Apache-2.0

osource "$ARCS_BASE/Kconfig"

config VADDR_REMAP_BOOT_VARIANT_NAME
	string "vaddr remap boot variant name"
	default "A"

config VADDR_REMAP_BOOT_REGION_INDEX
	int "vaddr remap boot region index"
	range 0 3
	default 0

config VADDR_REMAP_FW_FLASH_OFFSET
	hex "vaddr remap firmware flash offset"
	default 0x20000

config VADDR_REMAP_BOOT_FW_IN_CP
	bool "boot remapped firmware on CP core"
```

## arcs-sdk/test/driver/vaddr_remap/boot/testcase.yaml
```yaml
tests:
  test.driver.vaddr_remap.boot_a:
    programmer: arcs
    runner: uart
    build_extra_args: "-c prj_boot_a.conf"
    images:
      - file: "vaddr_remap_test_boot.bin"
        address: "0x0"
      - file: "fw/vaddr_remap_fw.bin"
        address: "0x20000"
    log_analyzer:
      type: "regex"
      pattern: "Firmware A running!"

  test.driver.vaddr_remap.boot_b:
    programmer: arcs
    runner: uart
    build_extra_args: "-c prj_boot_b.conf"
    images:
      - file: "vaddr_remap_test_boot.bin"
        address: "0x0"
      - file: "fw/vaddr_remap_fw.bin"
        address: "0x40000"
    log_analyzer:
      type: "regex"
      pattern: "Firmware B running!"

  test.driver.vaddr_remap.boot_c:
    programmer: arcs
    runner: uart
    build_extra_args: "-c prj_boot_c.conf"
    images:
      - file: "vaddr_remap_test_boot.bin"
        address: "0x0"
      - file: "fw/vaddr_remap_fw.bin"
        address: "0x60000"
    log_analyzer:
      type: "regex"
      pattern: "Firmware C running!"

  test.driver.vaddr_remap.boot_d:
    programmer: arcs
    runner: uart
    build_extra_args: "-c prj_boot_d.conf"
    images:
      - file: "vaddr_remap_test_boot.bin"
        address: "0x0"
      - file: "fw/vaddr_remap_fw.bin"
        address: "0x80000"
    log_analyzer:
      type: "regex"
      pattern: "Firmware D running!"

  test.driver.vaddr_remap.boot_cp_a:
    programmer: arcs
    runner: uart
    build_extra_args: "-c prj_boot_cp_a.conf"
    images:
      - file: "vaddr_remap_test_boot.bin"
        address: "0x0"
      - file: "fw/vaddr_remap_fw.bin"
        address: "0x20000"
    log_analyzer:
      type: "regex"
      pattern: "Firmware A running!"
```

## arcs-sdk/test/framework/ipc_log_ap_crash/testcase.yaml
```yaml
tests:
  test.framework.ipc_log_ap_crash:
    programmer: arcs
    runner: uart
    images:
      - file: "remote/ipc_log_ap_crash_ap.bin"
        address: "0x0"
      - file: "ipc_log_ap_crash_cp.bin"
        address: "0x80000"
    log_analyzer:
      type: "regex"
      pattern: "\\[REMOTE\\].*system exception"
```

## arcs-sdk/test/framework/ipc_log_early_boot/testcase.yaml
```yaml
tests:
  test.framework.ipc_log_early_boot:
    programmer: arcs
    runner: uart
    images:
      - file: "remote/ipc_log_early_boot_ap.bin"
        address: "0x0"
      - file: "ipc_log_early_boot_cp.bin"
        address: "0x80000"
    log_analyzer:
      type: "regex"
      pattern: "AP early boot IPC log passed"
```

## arcs-sdk/test/framework/ipc_log_role_swap/testcase.yaml
```yaml
tests:
  test.framework.ipc_log_role_swap:
    programmer: arcs
    runner: uart
    images:
      - file: "remote/ipc_log_role_swap_ap.bin"
        address: "0x0"
      - file: "ipc_log_role_swap_cp.bin"
        address: "0x80000"
    log_analyzer:
      type: "regex"
      pattern: "\\[REMOTE\\].*AP role swap IPC log passed"
```
