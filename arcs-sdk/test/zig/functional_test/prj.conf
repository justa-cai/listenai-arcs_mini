## CMakeLists.txt
```
cmake_minimum_required(VERSION 3.19)
set(CMAKE_EXPORT_COMPILE_COMMANDS ON)
find_package(listenai-cmake REQUIRED HINTS $ENV{ARCS_BASE})
project(zig_func_test)
set(LISTENAI_ZIG_APP ${CMAKE_CURRENT_SOURCE_DIR}/src/zig_app.zig)
listenai_add_executable(${PROJECT_NAME})
listenai_maybe_enable_zig_target(${PROJECT_NAME})
target_sources(${PROJECT_NAME} PRIVATE src/main.c)
```

## prj.conf
```kconfig
CONFIG_LOG=y
CONFIG_PRINTF_LOG_REDIRECT=y
CONFIG_LISA_DEVICE=y
CONFIG_LISA_GPIO_DEVICE=y
CONFIG_LISA_GPIOB=y
CONFIG_LISA_UART_DEVICE=y
```

## src/main.c
```c
#define LOG_TAG "func_test"
#include <lisa_log.h>

extern int zig_functional_test(void);

int main(int argc, char **argv)
{
    LOGI("=== Zig Functional Test Suite ===");

    int fails = zig_functional_test();

    if (fails == 0) {
        LOGI("=== ALL FUNCTIONAL TESTS PASSED ===");
    } else {
        LOGE("=== %d FUNCTIONAL TESTS FAILED ===", fails);
    }

    return fails;
}
```
