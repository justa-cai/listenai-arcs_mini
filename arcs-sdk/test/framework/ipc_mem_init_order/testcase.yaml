## arcs-sdk/test/framework/ipc_mem_init_order/testcase.yaml
```yaml
tests:
  test.framework.ipc_mem_init_order:
    programmer: arcs
    runner: uart
    log_analyzer: Unity
```

## arcs-sdk/test/framework/ipc_print_policy/testcase.yaml
```yaml
tests:
  test.framework.ipc_print_policy:
    programmer: arcs
    runner: uart
    log_analyzer: Unity
```

## arcs-sdk/test/framework/sys_chip_id/testcase.yaml
```yaml
tests:
  test.framework.sys_chip_id:
    programmer: arcs
    runner: uart
    log_analyzer: Unity
```

## arcs-sdk/test/framework/sys_reset_reason/testcase.yaml
```yaml
tests:
  test.framework.sys_reset_reason:
    programmer: arcs
    runner: uart
    log_analyzer: Unity
```

## arcs-sdk/test/host/sys_chip_id/testcase.yaml
```yaml
tests:
  test.host.sys_chip_id:
    runner: linux
    builder: cmake
    log_analyzer: "unity"
```

## arcs-sdk/test/host/sys_reset_reason/testcase.yaml
```yaml
tests:
  test.host.sys_reset_reason:
    runner: linux
    builder: cmake
    log_analyzer: "unity"
```

## arcs-sdk/test/posix/dirent_func/testcase.yaml
```yaml
tests:
  test.posix.dirent_func:
    programmer: arcs
    runner: uart
    log_analyzer: Unity
    
```

## arcs-sdk/test/posix/stat_func/testcase.yaml
```yaml
tests:
  test.posix.stat_func:
    programmer: arcs
    runner: uart
    log_analyzer: Unity
    
```

## arcs-sdk/test/posix/stdio_func/testcase.yaml
```yaml
tests:
  test.posix.stdio_func:
    programmer: arcs
    runner: uart
    log_analyzer: Unity
    
```

## arcs-sdk/test/rust/binding_test/testcase.yaml
```yaml
tests:
  test.rust.binding_test:
    programmer: arcs
    runner: uart
    platform_allow:
      - arcs_evb
    log_analyzer:
      type: "regex"
      pattern: "=== Rust Binding Test PASSED \\([0-9]+/[0-9]+\\) ==="
```

## arcs-sdk/test/zig/binding_test/testcase.yaml
```yaml
tests:
  test.zig.binding_test:
    programmer: arcs
    runner: uart
    platform_allow:
      - arcs_evb
    log_analyzer:
      type: "regex"
      pattern: "=== ALL [0-9]+ BINDING TESTS PASSED ==="

  test.zig.binding_test.fpu:
    build_only: true
    build_extra_args: "-DCONFIG_FILES=prj_fpu.conf"
    platform_allow:
      - arcs_evb
```

## arcs-sdk/test/zig/display_test/testcase.yaml
```yaml
tests:
  test.zig.display_test:
    programmer: arcs
    runner: uart
    platform_allow:
      - arcs_evb
    log_analyzer:
      type: "regex"
      pattern: "=== Zig Display Test PASSED ==="
```

## arcs-sdk/test/zig/functional_test/testcase.yaml
```yaml
tests:
  test.zig.functional_test:
    programmer: arcs
    runner: uart
    platform_allow:
      - arcs_evb
    log_analyzer:
      type: "regex"
      pattern: 'ARCS SDK Zig Functional Test Suite|\[PASS\]'
```

## boards/arcs_mini_doll_v2/Kconfig
```kconfig
# Board Configuration
#
# Copyright (c) 2025, LISTENAI
# SPDX-License-Identifier: Apache-2.0


config BOARD_NAME
    string
    default "arcs_mini"
    prompt "Board Name"
    help
        Board Name

config BOARD_ARCS_MINI
    bool
    default y
    help
        Board is arcs_mini

config BOARD_ARCS_MINI_DOLL_V2
    bool
    default y if BOARD_ARCS_MINI
```

## defconfig
```kconfig
CONFIG_LINK_OPTION_NOSYS_SPECS=y
CONFIG_FREERTOS_STATIC_ALLOCATION_ENABLE=y
CONFIG_ARCS_FREE_RTOS=y
# CONFIG_BOOT_HART is not set
CONFIG_ARCS_HAL_LSF=y
CONFIG_ARCS_HAL_IPC_MASTER=y
CONFIG_ARCS_HAL_EVENT=y
CONFIG_ARCS_HAL_WLIF=y
CONFIG_ARCS_HAL_CLI_CMD=y
CONFIG_ARCS_HAL_MODULE_SHELL=y
CONFIG_WIFI=y
CONFIG_LWIP=y
CONFIG_LWIP_OPTION_LWIP_DNS=y
CONFIG_LWIP_OPTION_SO_REUSE=y
# CONFIG_MEM_CONFIG is not set
CONFIG_MEM_CONFIG_USE_CUSTOM_FILE=y
CONFIG_SYSLOG_UART_TX_PIN_FUNC_SEL=2
CONFIG_SYSLOG_PRINTK_REDIRECT=y
CONFIG_HEAP_SIZE=0x3C00
CONFIG_PSRAM_HEAP_SIZE=0x3b0000
CONFIG_BACK_TRACE=y
CONFIG_CJSON=y
CONFIG_SDK_MODULE_COLLECTIONS_C=y
CONFIG_MODULE_CORESNTP=y
CONFIG_FILE_SYSTEM=y
CONFIG_FATFS_FILESYSTEM=y
CONFIG_LSFS=y
CONFIG_LSFS_FAT=y
CONFIG_LSFS_REGISTER_VFS=y
CONFIG_LVFS=y
CONFIG_LVFS_POSIX_API=y
CONFIG_LVFS_POSIX_API_ALIAS=y
CONFIG_FS_ENV_MEMORY_MANAGEMENT_USE_PSRAM=y
CONFIG_DISK_DRIVER=y
CONFIG_DISK_DRIVER_SDMMC=y
CONFIG_MODULE_ZE_TLS=y
CONFIG_MODULE_HTTPCLIENT=y
CONFIG_SDK_MODULE_LETTER_SHELL=y
CONFIG_SDK_MODULE_LETTER_SHELL_CONFIG_FILE="shell_cfg_user.h"
CONFIG_MBEDTLS_HARDWARE_ENTROPY=y
CONFIG_MBEDTLS_TLS_VERSION_1_0=y
CONFIG_MBEDTLS_TLS_VERSION_1_1=y
CONFIG_MBEDTLS_DTLS=y
CONFIG_MBEDTLS_SSL_ALPN=y
CONFIG_MBEDTLS_KEY_EXCHANGE_ECDHE_RSA_ENABLED=y
CONFIG_MBEDTLS_ECDH_C=y
CONFIG_MBEDTLS_ECP_DP_SECP256R1_ENABLED=y
CONFIG_MBEDTLS_HASH_MD5_ENABLED=y
CONFIG_MBEDTLS_CIPHER_GCM_ENABLED=y
CONFIG_MBEDTLS_MAC_SHA512_ENABLED=y
CONFIG_MBEDTLS_PEM_CERTIFICATE_FORMAT=y
CONFIG_MBEDTLS_HAVE_ASM=y
CONFIG_MBEDTLS_SERVER_NAME_INDICATION=y
CONFIG_MBEDTLS_SSL_MAX_CONTENT_LEN=16384
CONFIG_MBEDTLS_EXTERNAL_MEM_ALLOC=y
CONFIG_MODULE_NOPOLL=y
CONFIG_TINY_USB=y
CONFIG_WX_SQLITE3=y
CONFIG_WX_SQLITE3_HARD_CODEC=y
CONFIG_ZLIB=y
```

## modules/ebus/Kconfig
```kconfig
menuconfig EBUS
    bool "ebus translation"
    default n
    help
        Enable ebus support

if EBUS

choice
    prompt "Select Operating System"
    default EBUS_ENV_OS_FREERTOS

config  EBUS_ENV_OS_POSIX
    bool "POSIX"

config EBUS_ENV_OS_FREERTOS
    bool "FreeRTOS"

endchoice

config EBUS_PERF_MONITOR
    bool "Enable ebus performance monitor"
    default y
    help
        Enable ebus performance monitor

config EBUS_PERF_MONITOR_TIME_MS_MAX
    int "ebus performance monitor time ms max"
    default 5000
    depends on EBUS_PERF_MONITOR
    help
        Ebus performance monitor time ms max

config EBUS_PERF_MONITOR_WARN_THRESHOLD_MS
    int "ebus performance monitor warn threshold ms"
    default 20
    depends on EBUS_PERF_MONITOR
    help
        Ebus performance monitor warn threshold ms

config EBUS_PERF_MONITOR_PANIC_ON_TIMEOUT
    bool "ebus performance monitor panic on timeout"
    default n
    depends on EBUS_PERF_MONITOR
    help
        Ebus performance monitor panic on timeout

endif
```

## modules/lisaui/Kconfig
```kconfig
menuconfig LISAUI
    bool "LISAUI menuconfig"
    default n
    depends on SDK_MODULE_LVGL8
    depends on EBUS
    help
        Enable LISAUI functionality base on LVGL

if LISAUI
   
    choice 
        prompt "LISAUI environment"
        default LISAUI_ENV_ARCS_SDK
        config LISAUI_ENV_ARCS_SDK
            bool "ARCS SDK"
        config LISAUI_ENV_SIMULATOR
            bool "Simulator"
    endchoice

    config LISAUI_WIDGETS_ASSETS
        bool "ASSETS"
        default n          

    config LISAUI_WIDGETS_LLM
        bool "LLM"
        default n          

    config LISAUI_WIDGETS_VOICE
        bool "VOICE"
        default n
endif
```

## modules/lisaui/user/groups/Kconfig
```kconfig
choice 
    prompt "LISAUI group selection"
    default LISAUI_GROUPS_LLM
    config LISAUI_GROUPS_VOICEASSISTANT
        bool "Groups for Voice Assistant"
    config LISAUI_GROUPS_SCANPEN
        bool "Groups for SCANPEN"
    config LISAUI_GROUPS_LLM
        bool "Groups for Large language model"
endchoice
```

## modules/lschat/Kconfig
```kconfig
menu "lschat"

config LS_CHAT
    bool "lschat"
    select LISA_SNTP
    select LISA_EVT_PUBLISHER
    default n

config LS_CHAT_MCP
    bool "lschat mcp"
    default y
    depends on LS_CHAT

config LS_CHAT_MCP_V2
    bool "lschat mcp v2"
    default n
    depends on LS_CHAT_MCP

endmenu
```
