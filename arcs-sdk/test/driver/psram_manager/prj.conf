## CMakeLists.txt
```
cmake_minimum_required(VERSION 3.13)

set(LISTENAI_MODULES_DIR_LIST
    $ENV{ARCS_BASE}
    $ENV{ARCS_BASE}/../components/lisa_porting
    $ENV{ARCS_BASE}/../modules/easylogger
)

set(CMAKE_EXPORT_COMPILE_COMMANDS ON)

find_package(listenai-cmake REQUIRED HINTS $ENV{ARCS_BASE})

project(arcs)

listenai_add_executable(${PROJECT_NAME})

target_sources(${PROJECT_NAME} PRIVATE src/main.c)
```

## prj.conf
```kconfig
# 项目可根据需要在此文件中设置对应的配置
CONFIG_MEM_CONFIG=y
CONFIG_ARCS_HAL_LOG_LEVEL_DEBUG=y
CONFIG_ARCS_AP_CORE=y
CONFIG_PSRAM_INIT=y
CONFIG_CLOCK_INIT=y
```

## src/main.c
```c
#include <stdint.h>
#include <stdbool.h>
#include <stdio.h>

#include "FreeRTOS.h"
#include "task.h"


int main(int argc, char **argv)
{
    // Do nothing, Cause psram manager init before main
    return 0;
}
```
