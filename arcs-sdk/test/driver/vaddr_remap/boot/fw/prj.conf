## CMakeLists.txt
```
cmake_minimum_required(VERSION 3.13)

set(CMAKE_EXPORT_COMPILE_COMMANDS ON)

find_package(listenai-cmake REQUIRED HINTS $ENV{ARCS_BASE})

if(NOT DEFINED CONFIG_DEFAULT)
    set(CONFIG_DEFAULT "${CMAKE_CURRENT_SOURCE_DIR}/prj.conf")
endif()

project(vaddr_remap_fw)

listenai_add_executable(${PROJECT_NAME})

target_sources(${PROJECT_NAME} PRIVATE src/main.c)

listenai_set_linker_script(${ARCS_SDK_BASE}/soc/common/system.ld)
```

## Kconfig
```
# Copyright (c) 2025, LISTENAI
# SPDX-License-Identifier: Apache-2.0

osource "$ARCS_BASE/Kconfig"

config VADDR_REMAP_FW_VARIANT_NAME
	string "vaddr remap firmware variant name"
	default "A"

config VADDR_REMAP_FW_FLASH_OFFSET
	hex "vaddr remap firmware flash offset"
	default 0x20000
```

## prj.conf
```kconfig
CONFIG_LOG=y
CONFIG_PRINTF_LOG_REDIRECT=y
CONFIG_ARCS_AP_CORE=y
CONFIG_ARCS_STARTUP_CUSTOM_LINKER_FILE=y
CONFIG_MEM_FLASH_BASE=0x08000000
CONFIG_MEM_FLASH_SIZE=0x00800000
CONFIG_MEM_PSRAM_BASE=0x28800000
CONFIG_MEM_PSRAM_SIZE=0x00100000
CONFIG_PSRAM_INIT=n

CONFIG_VADDR_REMAP_FW_VARIANT_NAME="A"
CONFIG_VADDR_REMAP_FW_FLASH_OFFSET=0x20000
```

## prj_fw_b.conf
```kconfig
CONFIG_LOG=y
CONFIG_PRINTF_LOG_REDIRECT=y
CONFIG_ARCS_AP_CORE=y
CONFIG_ARCS_STARTUP_CUSTOM_LINKER_FILE=y
CONFIG_MEM_FLASH_BASE=0x10000000
CONFIG_MEM_FLASH_SIZE=0x00800000
CONFIG_MEM_PSRAM_BASE=0x28800000
CONFIG_MEM_PSRAM_SIZE=0x00100000
CONFIG_PSRAM_INIT=n

CONFIG_VADDR_REMAP_FW_VARIANT_NAME="B"
CONFIG_VADDR_REMAP_FW_FLASH_OFFSET=0x40000
```

## prj_fw_c.conf
```kconfig
CONFIG_LOG=y
CONFIG_PRINTF_LOG_REDIRECT=y
CONFIG_ARCS_AP_CORE=y
CONFIG_ARCS_STARTUP_CUSTOM_LINKER_FILE=y
CONFIG_MEM_FLASH_BASE=0x18000000
CONFIG_MEM_FLASH_SIZE=0x00800000
CONFIG_MEM_PSRAM_BASE=0x28800000
CONFIG_MEM_PSRAM_SIZE=0x00100000
CONFIG_PSRAM_INIT=n

CONFIG_VADDR_REMAP_FW_VARIANT_NAME="C"
CONFIG_VADDR_REMAP_FW_FLASH_OFFSET=0x60000
```

## prj_fw_cp_a.conf
```kconfig
CONFIG_LOG=y
CONFIG_PRINTF_LOG_REDIRECT=y
CONFIG_BOOT=n
CONFIG_BOOT_HART=n
CONFIG_ARCS_CP_CORE=y
CONFIG_ARCS_STARTUP_CUSTOM_LINKER_FILE=y
CONFIG_MEM_FLASH_BASE=0x08000000
CONFIG_MEM_FLASH_SIZE=0x00800000
CONFIG_MEM_PSRAM_BASE=0x28800000
CONFIG_MEM_PSRAM_SIZE=0x00100000
CONFIG_PSRAM_INIT=n

CONFIG_VADDR_REMAP_FW_VARIANT_NAME="A"
CONFIG_VADDR_REMAP_FW_FLASH_OFFSET=0x20000
```

## prj_fw_d.conf
```kconfig
CONFIG_LOG=y
CONFIG_PRINTF_LOG_REDIRECT=y
CONFIG_ARCS_AP_CORE=y
CONFIG_ARCS_STARTUP_CUSTOM_LINKER_FILE=y
CONFIG_MEM_FLASH_BASE=0x1C000000
CONFIG_MEM_FLASH_SIZE=0x00800000
CONFIG_MEM_PSRAM_BASE=0x28800000
CONFIG_MEM_PSRAM_SIZE=0x00100000
CONFIG_PSRAM_INIT=n

CONFIG_VADDR_REMAP_FW_VARIANT_NAME="D"
CONFIG_VADDR_REMAP_FW_FLASH_OFFSET=0x80000
```

## src/main.c
```c
/**
 * vaddr_remap firmware — single entry driven by prj_fw_*.conf
 */

#define LOG_TAG "vaddr_fw"

#include <lisa_log.h>
#include "arcs_ap.h"

int main(void)
{
    LOGI("========================================");
    LOGI("  >>> Firmware %s running! <<<", CONFIG_VADDR_REMAP_FW_VARIANT_NAME);
    LOGI("  Region base: 0x%08lX", (unsigned long)CONFIG_MEM_FLASH_BASE);
    LOGI("  Flash offset: 0x%05lX", (unsigned long)CONFIG_VADDR_REMAP_FW_FLASH_OFFSET);
    LOGI("========================================");

    while (1) {
        __asm__ volatile("wfi");
    }
}
```
