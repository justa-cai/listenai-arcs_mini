## CMakeLists.txt
```
cmake_minimum_required(VERSION 3.19)
set(CMAKE_EXPORT_COMPILE_COMMANDS ON)

find_package(listenai-cmake REQUIRED HINTS $ENV{ARCS_BASE})
project(rust_binding_test)

set(LISTENAI_RUST_APP ${CMAKE_CURRENT_SOURCE_DIR})

listenai_add_executable(${PROJECT_NAME})
include($ENV{ARCS_BASE}/modules/rust/rust_sample.cmake)
listenai_maybe_enable_rust_target(${PROJECT_NAME})
target_sources(${PROJECT_NAME} PRIVATE src/main.c)
```

## prj.conf
```kconfig
# Minimal config — enable easylogger frontend for Rust log output to be visible.
CONFIG_LOG_FRONTEND_EASYLOGGER=y

# Enable GPIO + UART devices used by the test subtests.
# gpioa: test_gpio_open. gpiob: test_eh_gpio_traits drives gpiob:9 (on-board LED)
# via embedded-hal OutputPin/StatefulOutputPin. uart1: test_uart_open.
CONFIG_LISA_GPIO_DEVICE=y
CONFIG_LISA_GPIOA=y
CONFIG_LISA_GPIOB=y
CONFIG_LISA_UART_DEVICE=y
CONFIG_LISA_UART1=y

# R3 peripherals exercised by test_pwm/rtc/adc/flash subtests.
CONFIG_LISA_PWM=y
CONFIG_LISA_RTC=y
CONFIG_LISA_ADC=y
CONFIG_LISA_FLASH=y
```

## src/main.c
```c
/*
 * Copyright (c) 2026, LISTENAI
 * SPDX-License-Identifier: Apache-2.0
 */
#define LOG_TAG "rust_bind"
#include <lisa_log.h>

extern int rust_binding_test_main(void);

int main(int argc, char **argv)
{
    (void)argc; (void)argv;
    LOGI("=== Rust Binding Test STARTING ===");
    int ret = rust_binding_test_main();
    if (ret == 0) {
        LOGI("=== Rust Binding Test PASS-GATE OK ===");
    } else {
        LOGE("=== Rust Binding Test FAILED (ret=%d) ===", ret);
    }
    return 0;
}
```
