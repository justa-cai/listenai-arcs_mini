## CMakeLists.txt
```
cmake_minimum_required(VERSION 3.13)

set(CMAKE_EXPORT_COMPILE_COMMANDS ON)

find_package(listenai-cmake REQUIRED HINTS $ENV{ARCS_BASE})

project(arcs)

listenai_include_directories(${CMAKE_CURRENT_SOURCE_DIR})

add_subdirectory(src)

listenai_add_executable(${PROJECT_NAME})
```

## Kconfig
```
# Copyright (c) 2025, LISTENAI
# SPDX-License-Identifier: Apache-2.0

osource "$ARCS_BASE/Kconfig"

config IMAGE_WIDTH
	int "iamge width"
	default 320

config IMAGE_HEIGHT
	int "image height"
	default 240

config IMAGE_FORMAT
	int "image format, 2:yuyv422 0:rgb565"
	default 2

config FACE_LIVE_DETECT_ENABLE
	bool "face live detect enable"
	default y

config FACE_LIVE_DETECT_THRESHOLD
	int "face live detect threshold"
	depends on FACE_LIVE_DETECT_ENABLE
	range 0 100
	default 50

config FACE_COMPARE_SCORE_THRESHOLD
	int "face compare score threshold"
	range 0 100
	default 90

config ONLY_FACE_REGISTER
	bool "only face register"
	default y

osource "src/button/Kconfig"
```

## sample.yaml
```
tests:
  demos.face_detect:
    build_only: true
```

## prj.conf
```kconfig
# 双核内存分区（CP 核）
CONFIG_MEM_FLASH_BASE=0x30800000
CONFIG_MEM_FLASH_SIZE=0x00800000
CONFIG_MEM_PSRAM_BASE=0x28800000
CONFIG_MEM_SRAM_BASE=0x20010000
CONFIG_MEM_SRAM_SIZE=0x00020000
CONFIG_MEM_IPC_BASE=0x20040000

# CP core
CONFIG_ARCS_CP_CORE=y

# not boot loader
# CP这里一定不能使能，否则会初始化时钟和PSRAM，和AP冲突
CONFIG_BOOT_HART=n
CONFIG_BOOT=n

# C LIB
CONFIG_LINK_OPTION_NONE_SPECS=y

# HEAP
CONFIG_HEAP_SIZE=0x10000
CONFIG_PSRAM_HEAP_SIZE=0x680000

# CPP
CONFIG_LINK_CPP_RUNTIME_SECTIONS=n
CONFIG_CPP_EXCEPTIONS=n

# Debug
CONFIG_BACK_TRACE=y

# freertos
CONFIG_FREERTOS_STATIC_ALLOCATION_ENABLE=y

# main task
CONFIG_MAIN_TASK_STACK_SIZE=8192
CONFIG_MAIN_TASK_PRIORITY=5

# IPC
CONFIG_ARCS_HAL_LSF=y
CONFIG_IPC_LSF=y
CONFIG_DISK_MEM=n
# CONFIG_ARCS_HAL_IC_MUTEX=n

# GPDMA
CONFIG_ARCS_GPDMA_FULL_INIT=y

# acomp fd
CONFIG_ACOMP=y
CONFIG_ACOMP_FD=y

CONFIG_ACOMP_FD_RES_FACE_DETECT_ADDRESS=0x30100000
CONFIG_ACOMP_FD_RES_FACE_DETECT_LENGTH=450936
CONFIG_ACOMP_FD_RES_FACE_ALIGN_ADDRESS=0x30170000
CONFIG_ACOMP_FD_RES_FACE_ALIGN_LENGTH=1588664
CONFIG_ACOMP_FD_RES_FACE_LIVE_ADDRESS=0x30300000
CONFIG_ACOMP_FD_RES_FACE_LIVE_LENGTH=1095288
CONFIG_ACOMP_FD_FACE_VERIFY_ADDRESS=0x30410000
CONFIG_ACOMP_FD_FACE_VERIFY_LENGTH=2953752

# watchdog
CONFIG_BOOT_WITH_WATCHDOG=y
CONFIG_WATCHDOG_ENABLE=n
CONFIG_WORK_QUEUE=y

# camera
CONFIG_LISA_DEVICE=y

CONFIG_LISA_GPIO_DEVICE=y
CONFIG_LISA_GPIOA=y
CONFIG_LISA_GPIOB=y

CONFIG_LISA_I2C=y
CONFIG_LISA_I2C0=y

CONFIG_LISA_SPI_DEVICE=y
CONFIG_LISA_SPI0=y

CONFIG_LISA_CAMERA_DEVICE=y
CONFIG_LISA_CAMERA_BUS_DVP=y
CONFIG_LISA_CAMERA_SENSOR_GC0328=y

# log
CONFIG_LOG=y
CONFIG_LOG_MODE_ASYNC=n

# display
CONFIG_LISA_DEVICE=y
CONFIG_LISA_GPIO_DEVICE=y
CONFIG_LISA_GPIOA=y
CONFIG_LISA_GPIOB=y
CONFIG_LISA_PWM=y
CONFIG_LISA_SPI1=y

CONFIG_LISA_DISPLAY_DEVICE=y
CONFIG_LISA_DISPLAY_PANEL_ST7789P3=y
CONFIG_LISA_DISPLAY_CPDMA_ROTATE=n
CONFIG_LISA_DISPLAY_BUS_SPI_4WIRE=y
CONFIG_LISA_DISPLAY_COLOR_INVERT=y
CONFIG_PANEL_ST7789P3_WIDTH=240
CONFIG_PANEL_ST7789P3_HEIGHT=320
CONFIG_PANEL_ST7789P3_X_OFFSET=0

# touch
CONFIG_LISA_TOUCH_DEVICE=y
CONFIG_LISA_I2C=y
CONFIG_LISA_I2C0=y
CONFIG_LISA_TOUCH_ARCS_CST328=y

# lvgl
CONFIG_SDK_MODULE_LVGL8=y
CONFIG_LV_DEMO_SYS_HEAP=y
CONFIG_LV_DRIVER_PIXEL_ALIGN_SIZE=16
CONFIG_LV_USE_DEMO_WIDGETS=y
CONFIG_LV_USE_GPU_CSK_DMA2D=y
CONFIG_LV_DOUBLE_VDB=y
CONFIG_LV_USE_PERF_MONITOR=y
CONFIG_LV_DRIVER_FULL_REFRESH=y
CONFIG_LV_CUSTOM_MONITOR=n
CONFIG_LV_REFR_UNCONDITIONAL_AREA_JOIN=y
CONFIG_LV_DRIVER_ROTATE_270=y
CONFIG_LV_ATTRIBUTE_FAST_MEM_USE_IRAM=y

# button
CONFIG_LISA_ADC=y
CONFIG_BUTTON=y
CONFIG_GPIO_BUTTON=n
CONFIG_ADC_BUTTON=y
CONFIG_ADC_BUTTON_MAX_BUTTON_PER_CHANNEL=3
CONFIG_ADC_BUTTON_SAMPLE_TIMES=1
```

## src/main.c
```c
#include "stdio.h"
#include <string.h>
#include <stdbool.h>

// module: ic
#include "ic_message.h"
#include "workqueue.h"

#include "acomp.h"
#include "acomp_fd.h"
#include "fd_image_stream.h"

#include "video_camera.h"
#include "display.h"
#include "screen.h"

#include "button.h"
#include "button_adc.h"
#include "adc_key.h"

#define TAG "main"

#include "lisa_log.h"

#define FACE_FEATURE_COMPARE_SCORE_THRESHOLD    (1.0f * CONFIG_FACE_COMPARE_SCORE_THRESHOLD / 100)
#define SKIP_FRAME_CNT (((CONFIG_IMAGE_WIDTH == 640) && (CONFIG_IMAGE_HEIGHT == 480)) ? 3 : 2)

typedef struct {
    uint32_t index;
    button_event_t event;
}key_wq_msg_t;

static workqueue_t *key_wq = NULL;
static void key_wq_handler(void *para);

static uint8_t *image_buf = NULL;   /* 实时图片 */
static uint8_t *fd_result1 = NULL;  /* 实时人脸识别结果 */

static uint8_t *fd_features = NULL; /* 已注册的人脸特征 */
static int fd_feature_cnt = 0;      /* 已注册的人脸特征数量 */

/* 摄像头图片回调 */
static void video_camera_cb(camera_frame_t *frame, void *user_data)
{
    (void)user_data;
    static uint32_t frame_index = 0;

    /* 图片用于屏幕显示 */
    memcpy(image_buf, frame->buffer, frame->length);
    screen_update_fd_info(NULL, image_buf, CONFIG_IMAGE_WIDTH, CONFIG_IMAGE_HEIGHT, CONFIG_IMAGE_WIDTH * CONFIG_IMAGE_HEIGHT * 2);

    if ((++frame_index) % SKIP_FRAME_CNT != 0) {
        frame->func(frame->func_param);
        return;
    }

    LISA_LOGD(TAG, "idx:%u, camera buf:%p, len: %d, w:%d, h:%d, f:%d", 
                    (frame_index / SKIP_FRAME_CNT),
                    frame->buffer, 
                    frame->length,
                    frame->width,
                    frame->height,
                    frame->format);

    /* 图片用于人脸识别算法 */
    fd_image_stream_send((video_frame_t *)frame);
}

/* 人脸识别结果回调 */
static void fd_event_handler(uint32_t event, void *event_data, uint32_t event_data_len, void *priv)
{

    if (event & FD_CB_EVENT_ENGINE_RLT) {
        LISA_LOGI(TAG, "fd result:%d,%p", event_data_len, (char *)event_data);

        uint8_t *fd_result = psram_malloc_align(32, event_data_len);
        if (fd_result == NULL) {
            LISA_LOGE(TAG, "%s, %d, malloc len failed", __FUNCTION__, __LINE__);
            return;
        }

        /* 人脸识别结果用于用户来使用（比如用户判断此特征是否符合注册条件，或者是否符合比对条件） */
        memcpy(fd_result1, (uint8_t *)event_data, event_data_len);
        
        /* 人脸识别结果显示到屏幕上面  */
        memcpy(fd_result, (uint8_t *)event_data, event_data_len);
        screen_update_fd_info((acomp_fd_result_info_t *)fd_result, NULL, CONFIG_IMAGE_WIDTH, CONFIG_IMAGE_HEIGHT, CONFIG_IMAGE_WIDTH * CONFIG_IMAGE_HEIGHT * 2);
        
    } else {
        LISA_LOGW(TAG, "unknown fd event:0X%X", event);
    }
}

/* 按键事件回调 */
static void adc_button_callback(button_event_t evt, button_adc_config_t *user_data)
{
    LISA_LOGI(TAG, "adc_button_index: %d, event: %d", user_data->button_index, evt);

    if ((evt != LISA_BTN_PRESS_CLICK) 
#if CONFIG_ONLY_FACE_REGISTER
    /* 如果是人脸注册+自动比对的场景，则只有按键key1有效，按键key2和key3不处理。key1注册完成后，业务会自动进行人脸比对 */
    || (user_data->button_index > 0)  
#else
    /* 如果是人脸注册+手动比对场景，则按键key1用来注册，按键key2用来比对，按键key3用来切换原图/灰度图显示。key1注册完后，需要手动按key2进行人脸比对 */
    || (user_data->button_index > 2) 
#endif
    ) {
        return;
    }

    key_wq_msg_t *msg = psram_malloc(sizeof(key_wq_msg_t));
    if (msg == NULL){
        LISA_LOGE(TAG, "%s, %d, malloc failed", __FUNCTION__, __LINE__);
        return;
    }

    msg->index = user_data->button_index;
    msg->event = evt;

    int ret = workqueue_submit(key_wq, key_wq_handler, msg);
    if (ret == 0) {
        LISA_LOGE(TAG, "key_wq submit failed:%d", ret);
        psram_free(msg);
    }
}
static bool is_gray = true;
/* 按键事件处理 */
static void key_wq_handler(void *para)
{
    key_wq_msg_t *msg = (key_wq_msg_t *)para;
    acomp_fd_result_info_t *info = (acomp_fd_result_info_t *)fd_result1;
    
    
    if (msg->index == 0) {  /* 按键key1用来注册人脸信息 */
        uint32_t result_cnt = info->results_cnt;
        if (result_cnt > 0) {
            uint32_t max_area_index = info->max_area_results_index;
            acomp_fd_result_t *result = (acomp_fd_result_t *)&info->results[max_area_index];
            float max_register_score = 0;
            int index = 0;


            LISA_LOGI(TAG, "score: %3f, align_n:%d, head_pose:[%3f, %3f, %3f], live:%d, s[0]:%f, s[1]:%f, feature_cnt:%d, compare_cnt:%d", 
                            result->face_score,
                            result->n_align_point,
                            result->pose.yaw,
                            result->pose.pitch,
                            result->pose.roll,
                            result->live_result.status,
                            result->live_result.scores[0],
                            result->live_result.scores[1],
                            result->feature_cnt,
                            result->compare_cnt
                            );

            /* 判断人脸特征是否满足注册要求（这里仅比较人脸得分、人脸对齐点数、人脸姿态角度，实际应用中可能需要考虑是否是活体、人脸特征点数等） */
            if ((result->face_score > 0.8) 
                    && (result->n_align_point > 0) 
                    && ((result->pose.yaw < 30.0f) && (result->pose.yaw > -30.0f)) 
                    && ((result->pose.pitch < 30.0f) && (result->pose.pitch > -30.0f)) 
                    && ((result->pose.roll < 30.0f) && (result->pose.roll > -30.0f)) 
                    && (result->live_result.status == 1) 
                    && (result->feature_cnt > 0)
                )
            {

                /* 如果已经有注册过人脸，需要看是不是同一个人，如果是就不再注册 */
                if (result->compare_cnt > 0) {
                    for (int i = 0; i < result->compare_cnt; i++) {
                        LISA_LOGI(TAG, "com score[%d]: %f", i, result->compare_scores[i]);
                        if (result->compare_scores[i] > max_register_score) {
                            max_register_score = result->compare_scores[i];
                            index = i;
                        }
                    }

                    LISA_LOGI(TAG, "max score is %f", max_register_score);

                    /* 判断人脸比较得分是否大于阈值，如果大于阈值，说明是同一个人，不再注册 */
                    if (max_register_score > FACE_FEATURE_COMPARE_SCORE_THRESHOLD) {
                        LISA_LOGE(TAG, "this face is already registered, score:%f!", max_register_score);
                        goto KEY_WQ_ERR;
                    }
                }


                if (fd_feature_cnt >= ACOMP_FD_MAX_RESULT_CNT) {
                    LISA_LOGE(TAG, "register count can't > %d, skip this feature!", ACOMP_FD_MAX_RESULT_CNT);
                    goto KEY_WQ_ERR;
                }

                /* 保存人脸特征点 */
                acomp_fd_feature_result_t *feature = (acomp_fd_feature_result_t *)(fd_features + sizeof(acomp_fd_feature_result_t) * fd_feature_cnt);
                memcpy(&feature->features[0], &result->features[0], sizeof(float) * result->feature_cnt);
                feature->feature_cnt = result->feature_cnt;

                /* 显示人脸注册数量 */
                fd_feature_cnt++;                
                screen_update_registered(fd_feature_cnt);
                LISA_LOGI(TAG, "register ok!");

                /* 重新加载已经注册的人脸特征到人脸识别算法 */
                if (fd_feature_cnt > 0) {
                    acomp_fd_features_load((acomp_fd_feature_result_t *)fd_features, fd_feature_cnt);
                }

            } else {
                LISA_LOGE(TAG, "register not ok!");
            }
        }
    } else if (msg->index == 1) {   /* 按键key2用来比对人脸信息 */
        uint32_t result_cnt = info->results_cnt;
        float max_score = 0.0f;
        int index = 0;

        if (result_cnt > 0) {
            uint32_t max_area_index = info->max_area_results_index;
            acomp_fd_result_t *result = (acomp_fd_result_t *)&info->results[max_area_index];

            LISA_LOGI(TAG, "score: %3f, align_n:%d, head_pose:[%3f, %3f, %3f], live:%d, s[0]:%f, s[1]:%f, feature_cnt:%d, compare_cnt:%d", 
                            result->face_score,
                            result->n_align_point,
                            result->pose.yaw,
                            result->pose.pitch,
                            result->pose.roll,
                            result->live_result.status,
                            result->live_result.scores[0],
                            result->live_result.scores[1],
                            result->feature_cnt,
                            result->compare_cnt
                            );

            /* 先找出最大人脸比对得分(和已有注册人脸的比对得分) */
            if (result->compare_cnt > 0) {
                for (int i = 0; i < result->compare_cnt; i++) {
                    LISA_LOGI(TAG, "com score[%d]: %f", i, result->compare_scores[i]);
                    if (result->compare_scores[i] > max_score) {
                        max_score = result->compare_scores[i];
                        index = i;
                    }
                }
            }

            LISA_LOGI(TAG, "max score is %f", max_score);


            /* 然后要判断人脸特征是否满足要求（这里仅比较人脸得分、人脸对齐点数、人脸姿态角度、人脸特征点数、人脸比对个数，实际应用中可能需要考虑是否是活体等） */
            if ((result->face_score > 0.8f) 
                    && (result->n_align_point > 0) 
                    && ((result->pose.yaw < 30.0f) && (result->pose.yaw > -30.0f)) 
                    && ((result->pose.pitch < 30.0f) && (result->pose.pitch > -30.0f)) 
                    && ((result->pose.roll < 30.0f) && (result->pose.roll > -30.0f))
                    && (result->live_result.status == 1) 
                    && (result->feature_cnt > 0)
                    && (result->compare_cnt > 0)
            )
            {
                /* 最大人脸得分是否大于阈值 */
                bool flag = (max_score > FACE_FEATURE_COMPARE_SCORE_THRESHOLD) ? true : false;

                /* 识别的得分用于屏幕显示 */
                screen_update_compare(index, flag, max_score);

            } else {
                screen_update_compare(index, false, max_score);
                LISA_LOGE(TAG, "compare not ok!");
            }
            
        }
    } else if (msg->index == 2) {   /* 按键key3用来切换原图模式和灰度模式 */
        LISA_LOGI(TAG, "gray mode: %d", is_gray);
        video_camera_set_gray(!is_gray);
        is_gray = !is_gray;
    }

KEY_WQ_ERR:
    psram_free(msg);
}

int main(int argc, char **argv)
{
    printf("CP=======! Hard ID: %d\n", CONFIG_HARTID);

    ic_message_init();
    LISA_LOGI(TAG, "ic_message_init done!");

    vTaskDelay(pdMS_TO_TICKS(2000));

    /* 存储实时的输入图像 */
    image_buf = psram_malloc_align(32, CONFIG_IMAGE_WIDTH * CONFIG_IMAGE_HEIGHT * 2);
    if (image_buf == NULL) {
        LISA_LOGE(TAG, "%s, %d, malloc len failed", __FUNCTION__, __LINE__);
        return -1;
    }

    /* 存储实时的人脸检测结果 */
    fd_result1 = psram_malloc_align(32, sizeof(acomp_fd_result_info_t) + sizeof(acomp_fd_result_t) * ACOMP_FD_MAX_RESULT_CNT);
    if (fd_result1 == NULL) {
        LISA_LOGE(TAG, "%s, %d, malloc len failed", __FUNCTION__, __LINE__);
        return -1;
    }

    /* 存储注册的人脸特征 */
    fd_features = psram_malloc_align(32, sizeof(acomp_fd_feature_result_t) * ACOMP_FD_MAX_RESULT_CNT);
    if (fd_features == NULL) {
        LISA_LOGE(TAG, "%s, %d, malloc len failed", __FUNCTION__, __LINE__);
        return -1;
    }

    /* 算法组件初始化 */
    acomp_init();
    
    /* 人脸识别算法模块 */
    acomp_fd_init();
    acomp_fd_prepare();
    acomp_fd_start();
    acomp_fd_add_callback(FD_CB_EVENT_ENGINE_RLT, fd_event_handler, NULL);
    const acomp_fd_param_t param = {
        .key = PARAM_DETECT_OUT_THRES,
        .value = 0.7f,
    };
    acomp_fd_params_set(&param, 1);
#if CONFIG_FACE_LIVE_DETECT_ENABLE
    const acomp_fd_live_detect_mode_t mode = {
        .enable = true,         // 启用活体检测
        .score_threshold = {
            0.5f,        // 非活体得分阈值（实际没用到这个参数）
            1.0f * CONFIG_FACE_LIVE_DETECT_THRESHOLD / 100, // 活体得分阈值（如果活体得分大于等于这个阈值， 就继续进行人脸特征提取和人脸识别）
        },
    };
    acomp_fd_live_detect_mode_set(&mode);
#endif
    /* 人脸图片输入流初始化 */
    fd_image_stream_init();

    /* 屏幕显示模块 */
    display_init();

    /* 按键模块 */
    key_wq = workqueue_create("key_wq", 9, 10, 8192);
    if (key_wq == NULL) {
        LISA_LOGE(TAG, "Failed to create key_wq");
    }

    test_adc_button(adc_button_callback);

    /* 摄像头模块 */
    camera_config_t config = {
        .width = CONFIG_IMAGE_WIDTH,
        .height = CONFIG_IMAGE_HEIGHT,
        .format = CONFIG_IMAGE_FORMAT,
    };
    video_camera_init(&config);
    video_camera_register_callback(video_camera_cb, NULL);
    video_camera_start_capture();

    while(1){
        vTaskDelay(pdMS_TO_TICKS(1000));
    }

    return 0;
}
```
