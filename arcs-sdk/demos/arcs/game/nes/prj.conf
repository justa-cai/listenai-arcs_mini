## CMakeLists.txt
```
cmake_minimum_required(VERSION 3.13)

set(CMAKE_EXPORT_COMPILE_COMMANDS ON)

find_package(listenai-cmake REQUIRED HINTS $ENV{ARCS_BASE})

project(game_nes)

listenai_add_executable(${PROJECT_NAME})

# 让 NES_LOG 中的 __FILE__ 输出更友好：默认裁剪掉工程根路径，变成相对路径。
# 注：NES_LOG_PATH_PREFIX 必须是字符串字面量（带结尾 '/').
set(_nes_log_prefix "${CMAKE_SOURCE_DIR}/")
if(DEFINED ENV{ARCS_BASE} AND NOT "$ENV{ARCS_BASE}" STREQUAL "")
	set(_nes_log_prefix "$ENV{ARCS_BASE}/")
endif()
target_compile_definitions(${PROJECT_NAME} PRIVATE NES_LOG_PATH_PREFIX=\"${_nes_log_prefix}\")

file(GLOB NES_CORE_SOURCES
	src/nes/core/*.c
	src/nes/core/nes_mapper/*.c
	src/nes/core/nes_mapper/infones/*.c
)

target_sources(${PROJECT_NAME} PRIVATE
	src/main.c
	src/game_nes_usb_keyboard.c
	src/nes/port/nes_port.c
	${NES_CORE_SOURCES}
)

target_include_directories(${PROJECT_NAME} PRIVATE
	src
	src/nes/inc
	src/nes/port
)

listenai_include_directories(
	src
)

set_source_files_properties(${NES_CORE_SOURCES} src/nes/port/nes_port.c src/main.c
	PROPERTIES COMPILE_FLAGS "-O3 -fno-strict-aliasing"
)

if(CONFIG_GAME_NES_USB_HOST_KEYBOARD)
	listenai_code_relocate(LIBRARY chryusb LOCATION PSRAM)
endif()
```

## Kconfig
```
#
# Copyright (c) 2026, LISTENAI
# SPDX-License-Identifier: Apache-2.0
#

osource "$ARCS_BASE/Kconfig"

menu "Game NES Options"

config GAME_NES_ROM_PATH
		string "NES ROM file path"
	default "/SD:/roms/mario.nes"
		help
			回退 ROM 路径：当 /SD:/roms/ 未扫描到 .nes 文件或选择失败时使用。

config GAME_NES_AUDIO_ENABLE
	bool "Enable NES audio"
	default y

config GAME_NES_AUDIO_FAST_S16_COPY
	bool "Use fast s16 audio copy path"
	default y
	depends on GAME_NES_AUDIO_ENABLE
	help
		APU 输出采样率与音频设备一致时，直接复制 s16 PCM 到播放 ring，跳过额外插值和滤波。

config GAME_NES_FRAME_SKIP
	int "NES render frame skip"
	default 1
	range 0 10
	help
		0 表示每个逻辑帧都渲染；1 表示约 30 FPS 绘制；2 表示约 20 FPS 绘制。

config GAME_NES_DRAW_FPS_TARGET
	int "NES draw FPS target"
	default 0
	range 0 60
	help
		0 使用 GAME_NES_FRAME_SKIP；非 0 时按目标绘制帧率进行节拍控制。

config GAME_NES_PERF_LOG_ENABLE
	bool "Enable NES port performance log"
	default y
	help
		每 120 个逻辑帧输出一次 logic FPS、draw FPS、draw/lvgl/audio 平均耗时和音频队列状态。

config GAME_NES_USB_HOST_KEYBOARD
	bool "Enable USB Host keyboard input"
	select CHERRYUSB
	select CHERRYUSB_HOST
	select CHERRYUSB_HOST_HID
	help
		启用 CherryUSB Host，支持外接 USB Hub 与 USB HID Boot Keyboard。
		键盘会映射为 NES 1P 手柄：方向键/WASD 为方向，X/K 为 A，
		Z/J 为 B，Enter 为 Start，Space/Tab 为 Select。

config GAME_NES_CORE_PROFILE_ENABLE
	bool "Enable NES core performance profile"
	help
		周期性输出 NES core 内部 CPU、BG、sprite、mapper、APU 等模块耗时占比。

config GAME_NES_CPU_OPCODE_PROFILE_ENABLE
	bool "Enable NES CPU opcode profile"
	depends on GAME_NES_CORE_PROFILE_ENABLE
	help
		输出热点 opcode 和热点 PC 统计。该选项会增加明显运行开销，仅用于深度分析。

config GAME_NES_PROFILE_LOG_MS
	int "NES core profile log interval"
	default 2000
	range 500 10000
	help
		NES core 和 opcode profile 的日志输出周期，单位 ms。

config GAME_NES_FAST_VISIBLE_RENDER
	bool "Render only the visible 240-pixel NES window"
	default y

config GAME_NES_FAST_PPU_PACKED_PATTERN
	bool "Use packed CHR pattern rows for faster PPU rendering"
	default y

config GAME_NES_CHR_PACKED_DYNAMIC_MAX_BYTES
	int "Max dynamic packed CHR cache bytes"
	default 262144
	range 0 524288
	depends on GAME_NES_FAST_PPU_PACKED_PATTERN
	help
		大 CHR ROM 使用 PSRAM 建立 packed pattern row 缓存，避免 mapper bank 切换时重复打包。
		262144 bytes 可覆盖 256KB CHR ROM；0 表示仅使用静态 8KB mapper bank cache。

config GAME_NES_FAST_CPU_BRANCH
	bool "Use fast CPU branch and fetch helpers"
	default y

config GAME_NES_FAST_CPU_JMP_IDLE
	bool "Fast-forward simple CPU idle loops"
	default y

config GAME_NES_FAST_SKIP_SPRITES
	bool "Skip full sprite rendering on dropped draw frames"
	default y

config GAME_NES_MAPPER_INFONES_ENABLE
	bool "Enable InfoNES mapper compatibility layer"
	default y

config GAME_NES_MAPPER_INFONES_DEFAULT_SET
	bool "Enable the default InfoNES mapper set"
	default y

endmenu
```

## sample.yaml
```
tests:
  demos.arcs.game.nes:
    platform:
      arcs_evb
    programmer: arcs
    runner: uart
    log_analyzer:
      type: "regex"
      pattern: "Game NES sample start"
```

## prj.conf
```kconfig
CONFIG_LISA_DEVICE=y
CONFIG_LISA_AUDIO_DEVICE=y
CONFIG_LISA_GPIO_DEVICE=y
CONFIG_LISA_GPIOA=y
CONFIG_LISA_GPIOB=y
CONFIG_LISA_PWM=y
CONFIG_LISA_SPI1=y
CONFIG_LISA_I2C=y
CONFIG_LISA_I2C0=y

CONFIG_LISA_DISPLAY_DEVICE=y
CONFIG_LISA_DISPLAY_PANEL_ST7789P3=y
CONFIG_LISA_DISPLAY_CPDMA_ROTATE=n
CONFIG_PANEL_ST7789P3_WIDTH=240
CONFIG_PANEL_ST7789P3_HEIGHT=320
CONFIG_PANEL_ST7789P3_X_OFFSET=0
CONFIG_LISA_DISPLAY_COLOR_INVERT=y

CONFIG_LISA_DISPLAY_BUS_SPI_4WIRE=y
CONFIG_LISA_TOUCH_DEVICE=y
CONFIG_LISA_TOUCH_ARCS_CST328=y

# LVGL8 配置
CONFIG_SDK_MODULE_LVGL8=y
CONFIG_LV_DEMO_SYS_HEAP=y
CONFIG_LV_DRIVER_PIXEL_ALIGN_SIZE=16
CONFIG_LV_USE_DEMO_WIDGETS=y
CONFIG_LV_USE_GPU_CSK_DMA2D=y
CONFIG_LV_DOUBLE_VDB=y
CONFIG_LV_USE_PERF_MONITOR=y
CONFIG_LV_DRIVER_FULL_REFRESH=y
CONFIG_LV_CUSTOM_MONITOR=n
CONFIG_LV_REFR_UNCONDITIONAL_AREA_JOIN=y
CONFIG_LV_DRIVER_ROTATE_270=y
CONFIG_LV_ATTRIBUTE_FAST_MEM_USE_IRAM=y

CONFIG_PSRAM_HEAP_SIZE=0x100000
CONFIG_HEAP_SIZE=0x10000

CONFIG_FILE_SYSTEM=y
CONFIG_FATFS_FILESYSTEM=y
CONFIG_DISK_DRIVER=y
CONFIG_DISK_DRIVER_SDMMC=y
CONFIG_LSFS=y
CONFIG_LSFS_FAT=y
CONFIG_LSFS_REGISTER_VFS=y
CONFIG_LVFS=y
CONFIG_LVFS_POSIX_API=y
CONFIG_LVFS_POSIX_API_ALIAS=y
CONFIG_LISA_SDMMC_DEVICE=y

CONFIG_DIRENT=y

# NES performance observation defaults: keep low-overhead FPS logs on, but
# leave heavy core/opcode profiling opt-in for targeted analysis.
CONFIG_GAME_NES_AUDIO_FAST_S16_COPY=y
CONFIG_GAME_NES_PERF_LOG_ENABLE=y
# Optional USB Host keyboard input. Enable to use a USB Hub + USB keyboard
# as NES player-1 controls.
# CONFIG_GAME_NES_USB_HOST_KEYBOARD is not set
# Preselect the ARCS EVB MUSB host controller; it is inert while
# CONFIG_GAME_NES_USB_HOST_KEYBOARD keeps CherryUSB Host disabled.
CONFIG_CHERRYUSB_HOST_MUSB_LISA=y
CONFIG_GAME_NES_CORE_PROFILE_ENABLE=n
CONFIG_GAME_NES_CPU_OPCODE_PROFILE_ENABLE=n
CONFIG_GAME_NES_CHR_PACKED_DYNAMIC_MAX_BYTES=262144
```

## src/main.c
```c
/*
 * Copyright (c) 2026, LISTENAI
 *
 * SPDX-License-Identifier: Apache-2.0
 */

#include <stdbool.h>
#include <stdint.h>
#include <stdio.h>
#include <stdlib.h>
#include <string.h>
#include <dirent.h>
#include "game_nes_input.h"
#include "game_nes_usb_keyboard.h"
#include "nes.h"
#include "lsfs.h"
#include "lvfs.h"
#include "lvgl.h"
#include "disk/disk_access.h"
#include "lisa_sdmmc.h"
#include "lisa_thread.h"

#ifdef LOG_TAG
#undef LOG_TAG
#endif

#define LOG_TAG "game_nes"
#include <lisa_log.h>

#define SDMMC_DEVICE      "SD:"
#define SDMMC_MOUNT_POINT "/"SDMMC_DEVICE
#define GAME_NES_ROMS_DIR SDMMC_MOUNT_POINT"/roms"
#define GAME_NES_MAX_ROMS 128
#define GAME_NES_MAX_ROM_PATH_LEN 256

typedef struct {
    char **paths;
    size_t count;
} game_nes_rom_list_t;

typedef struct {
    volatile bool selected;
    char selected_path[GAME_NES_MAX_ROM_PATH_LEN];
} game_nes_rom_pick_ctx_t;

typedef struct {
    game_nes_rom_pick_ctx_t *pick_ctx;
    const char *path;
} game_nes_rom_btn_ctx_t;

typedef struct {
    volatile bool retry;
} game_nes_prompt_ctx_t;

static struct lsfs_mount_t sdmmc_mnt = {
    .type = LSFS_FATFS,
    .mnt_point = SDMMC_MOUNT_POINT,
    .fs_data = NULL,
};
static bool g_sdmmc_mounted = false;
static bool g_fs_stack_inited = false;

static bool game_nes_has_suffix_ci(const char *name, const char *suffix)
{
    if (!name || !suffix) {
        return false;
    }

    size_t name_len = strlen(name);
    size_t suffix_len = strlen(suffix);
    if (name_len < suffix_len) {
        return false;
    }

    const char *start = name + (name_len - suffix_len);
    for (size_t i = 0; i < suffix_len; i++) {
        char c1 = start[i];
        char c2 = suffix[i];
        if (c1 >= 'A' && c1 <= 'Z') {
            c1 = (char)(c1 - 'A' + 'a');
        }
        if (c2 >= 'A' && c2 <= 'Z') {
            c2 = (char)(c2 - 'A' + 'a');
        }
        if (c1 != c2) {
            return false;
        }
    }

    return true;
}

static int game_nes_ci_strcmp(const char *a, const char *b)
{
    if (!a && !b) {
        return 0;
    }
    if (!a) {
        return -1;
    }
    if (!b) {
        return 1;
    }

    while (*a != '\0' && *b != '\0') {
        char c1 = *a;
        char c2 = *b;
        if (c1 >= 'A' && c1 <= 'Z') {
            c1 = (char)(c1 - 'A' + 'a');
        }
        if (c2 >= 'A' && c2 <= 'Z') {
            c2 = (char)(c2 - 'A' + 'a');
        }
        if (c1 != c2) {
            return (int)((unsigned char)c1 - (unsigned char)c2);
        }
        a++;
        b++;
    }

    return (int)((unsigned char)(*a) - (unsigned char)(*b));
}

static int game_nes_rom_path_cmp(const void *a, const void *b)
{
    const char *const *pa = (const char *const *)a;
    const char *const *pb = (const char *const *)b;
    return game_nes_ci_strcmp(*pa, *pb);
}

static void game_nes_free_rom_list(game_nes_rom_list_t *rom_list)
{
    if (!rom_list || !rom_list->paths) {
        return;
    }

    for (size_t i = 0; i < rom_list->count; i++) {
        free(rom_list->paths[i]);
        rom_list->paths[i] = NULL;
    }
    free(rom_list->paths);
    rom_list->paths = NULL;
    rom_list->count = 0;
}

static int game_nes_scan_roms(game_nes_rom_list_t *rom_list)
{
    if (!rom_list) {
        return -1;
    }

    memset(rom_list, 0, sizeof(*rom_list));
    rom_list->paths = (char **)calloc(GAME_NES_MAX_ROMS, sizeof(char *));
    if (!rom_list->paths) {
        LISA_LOGE(LOG_TAG, "No memory for ROM list");
        return -1;
    }

    DIR *dir = opendir(GAME_NES_ROMS_DIR);
    if (!dir) {
        LISA_LOGE(LOG_TAG, "Cannot open ROM dir: %s", GAME_NES_ROMS_DIR);
        game_nes_free_rom_list(rom_list);
        return -1;
    }

    struct dirent *entry = NULL;
    while ((entry = readdir(dir)) != NULL) {
        if (!entry->d_name || entry->d_name[0] == '\0') {
            continue;
        }
        if (strcmp(entry->d_name, ".") == 0 || strcmp(entry->d_name, "..") == 0) {
            continue;
        }
        if (!game_nes_has_suffix_ci(entry->d_name, ".nes")) {
            continue;
        }
        if (rom_list->count >= GAME_NES_MAX_ROMS) {
            LISA_LOGW(LOG_TAG, "ROM count exceeds limit(%d), truncating", GAME_NES_MAX_ROMS);
            break;
        }

        char full_path[GAME_NES_MAX_ROM_PATH_LEN] = {0};
        int len = snprintf(full_path, sizeof(full_path), "%s/%s", GAME_NES_ROMS_DIR, entry->d_name);
        if (len <= 0 || (size_t)len >= sizeof(full_path)) {
            LISA_LOGW(LOG_TAG, "Skip too-long path: %s", entry->d_name);
            continue;
        }

        size_t alloc_size = (size_t)len + 1U;
        char *path = (char *)malloc(alloc_size);
        if (!path) {
            LISA_LOGE(LOG_TAG, "No memory for ROM path");
            closedir(dir);
            game_nes_free_rom_list(rom_list);
            return -1;
        }
        memcpy(path, full_path, alloc_size);
        rom_list->paths[rom_list->count++] = path;
    }

    closedir(dir);

    if (rom_list->count == 0U) {
        LISA_LOGW(LOG_TAG, "No .nes file under %s", GAME_NES_ROMS_DIR);
        game_nes_free_rom_list(rom_list);
        return -1;
    }

    qsort(rom_list->paths, rom_list->count, sizeof(char *), game_nes_rom_path_cmp);
    return 0;
}

static void game_nes_rom_select_event_cb(lv_event_t *e)
{
    game_nes_rom_btn_ctx_t *btn_ctx = (game_nes_rom_btn_ctx_t *)lv_event_get_user_data(e);
    if (!btn_ctx || !btn_ctx->pick_ctx || !btn_ctx->path) {
        return;
    }

    if (lv_event_get_code(e) != LV_EVENT_CLICKED) {
        return;
    }

    game_nes_rom_pick_ctx_t *pick_ctx = btn_ctx->pick_ctx;
    strncpy(pick_ctx->selected_path, btn_ctx->path, sizeof(pick_ctx->selected_path) - 1U);
    pick_ctx->selected_path[sizeof(pick_ctx->selected_path) - 1U] = '\0';
    pick_ctx->selected = true;
}

static void game_nes_prompt_retry_event_cb(lv_event_t *e)
{
    game_nes_prompt_ctx_t *ctx = (game_nes_prompt_ctx_t *)lv_event_get_user_data(e);
    if (!ctx || lv_event_get_code(e) != LV_EVENT_CLICKED) {
        return;
    }

    ctx->retry = true;
}

static void game_nes_wait_retry_prompt(const char *title, const char *line1, const char *line2)
{
    lv_obj_t *screen = lv_scr_act();
    if (!screen) {
        return;
    }

    lv_coord_t screen_w = lv_obj_get_width(screen);
    lv_coord_t screen_h = lv_obj_get_height(screen);
    if (screen_w <= 0) {
        screen_w = 320;
    }
    if (screen_h <= 0) {
        screen_h = 240;
    }

    game_nes_prompt_ctx_t prompt_ctx = {0};

    lv_obj_t *overlay = lv_obj_create(screen);
    lv_obj_set_size(overlay, screen_w, screen_h);
    lv_obj_set_pos(overlay, 0, 0);
    lv_obj_set_style_radius(overlay, 0, 0);
    lv_obj_set_style_border_width(overlay, 0, 0);
    lv_obj_set_style_pad_all(overlay, 8, 0);
    lv_obj_set_style_bg_color(overlay, lv_color_black(), 0);
    lv_obj_set_style_bg_opa(overlay, LV_OPA_COVER, 0);

    lv_obj_t *title_label = lv_label_create(overlay);
    lv_label_set_text(title_label, title ? title : "");
    lv_obj_set_style_text_color(title_label, lv_color_white(), 0);
    lv_obj_align(title_label, LV_ALIGN_CENTER, 0, -58);

    lv_obj_t *line1_label = lv_label_create(overlay);
    lv_obj_set_width(line1_label, screen_w - 24);
    lv_label_set_long_mode(line1_label, LV_LABEL_LONG_WRAP);
    lv_label_set_text(line1_label, line1 ? line1 : "");
    lv_obj_set_style_text_color(line1_label, lv_color_white(), 0);
    lv_obj_set_style_text_align(line1_label, LV_TEXT_ALIGN_CENTER, 0);
    lv_obj_align(line1_label, LV_ALIGN_CENTER, 0, -20);

    lv_obj_t *line2_label = lv_label_create(overlay);
    lv_obj_set_width(line2_label, screen_w - 24);
    lv_label_set_long_mode(line2_label, LV_LABEL_LONG_WRAP);
    lv_label_set_text(line2_label, line2 ? line2 : "");
    lv_obj_set_style_text_color(line2_label, lv_color_make(0xc0, 0xc0, 0xc0), 0);
    lv_obj_set_style_text_align(line2_label, LV_TEXT_ALIGN_CENTER, 0);
    lv_obj_align(line2_label, LV_ALIGN_CENTER, 0, 12);

    lv_obj_t *retry_btn = lv_btn_create(overlay);
    lv_obj_set_size(retry_btn, 104, 38);
    lv_obj_align(retry_btn, LV_ALIGN_CENTER, 0, 64);
    lv_obj_add_event_cb(retry_btn, game_nes_prompt_retry_event_cb, LV_EVENT_CLICKED, &prompt_ctx);

    lv_obj_t *retry_label = lv_label_create(retry_btn);
    lv_label_set_text(retry_label, "Retry");
    lv_obj_center(retry_label);

    while (!prompt_ctx.retry) {
        (void)lv_task_handler();
        lisa_thread_mdelay(20);
    }

    lv_obj_del(overlay);
}

static int game_nes_pick_rom_by_lvgl(const game_nes_rom_list_t *rom_list,
                                     char *selected_path,
                                     size_t selected_path_len)
{
    if (!rom_list || !rom_list->paths || rom_list->count == 0U || !selected_path || selected_path_len == 0U) {
        return -1;
    }

    lv_obj_t *screen = lv_scr_act();
    if (!screen) {
        return -1;
    }

    game_nes_rom_pick_ctx_t pick_ctx = {0};
    game_nes_rom_btn_ctx_t *btn_ctx_list =
        (game_nes_rom_btn_ctx_t *)calloc(rom_list->count, sizeof(game_nes_rom_btn_ctx_t));
    if (!btn_ctx_list) {
        LISA_LOGE(LOG_TAG, "No memory for LVGL ROM buttons");
        return -1;
    }

    lv_coord_t screen_w = lv_obj_get_width(screen);
    lv_coord_t screen_h = lv_obj_get_height(screen);

    lv_obj_t *overlay = lv_obj_create(screen);
    lv_obj_set_size(overlay, screen_w, screen_h);
    lv_obj_set_pos(overlay, 0, 0);
    lv_obj_set_style_radius(overlay, 0, 0);
    lv_obj_set_style_pad_all(overlay, 6, 0);

    lv_obj_t *title = lv_label_create(overlay);
    lv_label_set_text(title, "Select NES ROM");
    lv_obj_align(title, LV_ALIGN_TOP_LEFT, 2, 0);

    lv_obj_t *tip = lv_label_create(overlay);
    lv_label_set_text(tip, "Tap a file under /SD:/roms/");
    lv_obj_align(tip, LV_ALIGN_BOTTOM_LEFT, 2, 0);

    lv_obj_t *rom_list_view = lv_list_create(overlay);
    lv_obj_set_size(rom_list_view, screen_w - 4, screen_h - 34);
    lv_obj_align(rom_list_view, LV_ALIGN_TOP_MID, 0, 16);

    for (size_t i = 0; i < rom_list->count; i++) {
        const char *path = rom_list->paths[i];
        const char *name = strrchr(path, '/');
        name = (name && *(name + 1) != '\0') ? (name + 1) : path;

        lv_obj_t *item = lv_list_add_btn(rom_list_view, NULL, name);
        btn_ctx_list[i].pick_ctx = &pick_ctx;
        btn_ctx_list[i].path = path;
        lv_obj_add_event_cb(item, game_nes_rom_select_event_cb, LV_EVENT_CLICKED, &btn_ctx_list[i]);
    }

    while (!pick_ctx.selected) {
        (void)lv_task_handler();
        lisa_thread_mdelay(10);
    }

    strncpy(selected_path, pick_ctx.selected_path, selected_path_len - 1U);
    selected_path[selected_path_len - 1U] = '\0';

    lv_obj_del(overlay);
    free(btn_ctx_list);
    return 0;
}

static int game_nes_select_rom_path(char *selected_path, size_t selected_path_len)
{
    game_nes_rom_list_t rom_list = {0};
    int ret = game_nes_scan_roms(&rom_list);
    if (ret != 0) {
        return ret;
    }

#if NES_DIRECT_LCD
    /* Direct LCD spike: prefer Castlevania.nes for measurement consistency
     * with previous baselines; fall back to paths[0] if unavailable. */
    const char *picked = NULL;
    for (size_t i = 0; i < rom_list.count; i++) {
        const char *name = strrchr(rom_list.paths[i], '/');
        name = (name && *(name + 1) != '\0') ? (name + 1) : rom_list.paths[i];
        if (game_nes_ci_strcmp(name, "Castlevania.nes") == 0) {
            picked = rom_list.paths[i];
            break;
        }
    }
    if (!picked) {
        picked = rom_list.paths[0];
    }
    strncpy(selected_path, picked, selected_path_len - 1U);
    selected_path[selected_path_len - 1U] = '\0';
    LISA_LOGI(LOG_TAG, "DIRECT_LCD: auto-selected ROM: %s", selected_path);
    ret = 0;
#else
    ret = game_nes_pick_rom_by_lvgl(&rom_list, selected_path, selected_path_len);
#endif
    game_nes_free_rom_list(&rom_list);
    return ret;
}

void game_nes_poll_joypad(nes_t *nes)
{
    if (!nes) {
        return;
    }
    if (game_nes_consume_rom_list_request()) {
        nes->nes_quit = 1;
        return;
    }
    nes->nes_cpu.joypad.joypad = game_nes_get_joypad_state();
}

static int game_nes_fs_init(void)
{
    int ret;

    if (g_sdmmc_mounted) {
        return 0;
    }

    ret = lisa_sdmmc_probe(lisa_device_get("sdmmc0"));
    if (ret != 0) {
        LISA_LOGW(LOG_TAG, "SD/MMC card not ready: %d", ret);
        return ret;
    }

    disk_init(NULL);

    if (!g_fs_stack_inited) {
        lvfs_init();
        lsfs_init();
        g_fs_stack_inited = true;
    }

    ret = lsfs_mount(&sdmmc_mnt);
    if (ret != 0) {
        LISA_LOGI(LOG_TAG, "Mount failed, formatting SD card...");
        ret = lsfs_mkfs(LSFS_FATFS, SDMMC_DEVICE, NULL, 0);
        if (ret == 0) {
            ret = lsfs_mount(&sdmmc_mnt);
        }
    }

    if (ret != 0) {
        LISA_LOGE(LOG_TAG, "Failed to mount filesystem: %d", ret);
        return ret;
    }

    LISA_LOGI(LOG_TAG, "Mounted %s", SDMMC_MOUNT_POINT);
    g_sdmmc_mounted = true;
    return 0;
}

static void game_nes_fs_deinit(void)
{
    if (!g_sdmmc_mounted) {
        return;
    }

    if (lsfs_unmount(&sdmmc_mnt) == 0) {
        g_sdmmc_mounted = false;
    }
}

static void game_nes_wait_for_sd_card(void)
{
    while (game_nes_fs_init() != 0) {
        game_nes_wait_retry_prompt("Insert SD Card",
                                   "Insert a FAT SD card with .nes files in /roms/.",
                                   "Then tap Retry.");
    }
}

static void game_nes_wait_for_rom_retry(const char *rom_path)
{
    char detail[GAME_NES_MAX_ROM_PATH_LEN + 32];
    snprintf(detail, sizeof(detail), "Path: %s", rom_path ? rom_path : "(null)");
    game_nes_wait_retry_prompt("Load ROM Failed", detail, "Tap Retry to open ROM list.");
}

int main(int argc, char **argv)
{
    (void)argc;
    (void)argv;

    LISA_LOGI(LOG_TAG, "Game NES sample start");

    game_nes_usb_keyboard_init();

    nes_t *nes = nes_init();
    if (!nes) {
        LISA_LOGE(LOG_TAG, "nes_init failed");
        return -1;
    }

#if (NES_USE_FS == 1)
    while (true) {
        char selected_rom_path[GAME_NES_MAX_ROM_PATH_LEN] = {0};
        const char *rom_path = NULL;

        game_nes_wait_for_sd_card();

        if (game_nes_select_rom_path(selected_rom_path, sizeof(selected_rom_path)) == 0) {
            rom_path = selected_rom_path;
            LISA_LOGI(LOG_TAG, "Selected ROM: %s", rom_path);
        } else {
            rom_path = CONFIG_GAME_NES_ROM_PATH;
            LISA_LOGW(LOG_TAG, "Use fallback ROM path from Kconfig: %s", rom_path ? rom_path : "(null)");
        }

        if (!rom_path || strlen(rom_path) == 0) {
            LISA_LOGE(LOG_TAG, "ROM path is empty");
            game_nes_wait_for_rom_retry(rom_path);
            continue;
        }

        int ret = nes_load_file(nes, rom_path);
        if (ret != NES_OK) {
            LISA_LOGE(LOG_TAG, "nes_load_file failed: %s", rom_path);
            game_nes_wait_for_rom_retry(rom_path);
            continue;
        }

        LISA_LOGI(LOG_TAG, "ROM loaded: %s", rom_path);
        game_nes_clear_rom_list_request();
        nes->nes_quit = 0;
#if (NES_FRAME_SKIP != 0) || (CONFIG_NES_DRAW_FPS_TARGET > 0)
        nes->nes_frame_skip_count = 0;
#endif
        nes_run(nes);
        nes_unload_file(nes);
        LISA_LOGI(LOG_TAG, "Returned to ROM list");
    }
#else
    LISA_LOGE(LOG_TAG, "NES_USE_FS is disabled, cannot load ROM from file");
#endif

    nes_deinit(nes);
    game_nes_fs_deinit();
    return 0;
}
```

## src/game_nes_input.h
```c
/*
 * Copyright (c) 2026, LISTENAI
 *
 * SPDX-License-Identifier: Apache-2.0
 */
#pragma once

#include <stdbool.h>
#include <stdint.h>

#ifdef __cplusplus
extern "C" {
#endif

#define GAME_NES_BTN_A1  (1U << 15)
#define GAME_NES_BTN_B1  (1U << 14)
#define GAME_NES_BTN_SE1 (1U << 13)
#define GAME_NES_BTN_ST1 (1U << 12)
#define GAME_NES_BTN_U1  (1U << 11)
#define GAME_NES_BTN_D1  (1U << 10)
#define GAME_NES_BTN_L1  (1U << 9)
#define GAME_NES_BTN_R1  (1U << 8)

uint16_t game_nes_get_joypad_state(void);
bool game_nes_consume_rom_list_request(void);
void game_nes_clear_rom_list_request(void);

#ifdef __cplusplus
}
#endif
```

## src/game_nes_usb_keyboard.c
```c
/*
 * Copyright (c) 2026, LISTENAI
 *
 * SPDX-License-Identifier: Apache-2.0
 */

#include "game_nes_usb_keyboard.h"

#ifdef CONFIG_GAME_NES_USB_HOST_KEYBOARD

#include <stdbool.h>
#include <stdint.h>

#include "ClockManager.h"
#include "FreeRTOS.h"
#include "arcs_ap.h"
#include "game_nes_input.h"
#include "lisa_log.h"
#include "sys_init.h"
#include "task.h"
#include "usb_hid.h"
#include "usbh_core.h"
#include "usbh_hid.h"

#ifdef LOG_TAG
#undef LOG_TAG
#endif
#define LOG_TAG "game_nes_usb"

#define GAME_NES_USB_BUSID     0
#define GAME_NES_USB_REG_BASE  0x41000000UL
#define GAME_NES_HID_KEY(ch)   ((uint8_t)(HID_KBD_USAGE_A + ((ch) - 'A')))

static volatile uint16_t g_usb_joypad_state;
static volatile bool g_usb_keyboard_connected;
static struct usbh_hid *g_usb_keyboard_hid;
static USB_NOCACHE_RAM_SECTION USB_MEM_ALIGNX uint8_t g_usb_keyboard_report[64];

static void game_nes_usb_keyboard_callback(void *arg, int nbytes);

static bool game_nes_usb_hid_is_keyboard(const struct usbh_hid *hid_class)
{
    if (!hid_class || !hid_class->hport) {
        return false;
    }

    const struct usb_interface_descriptor *desc =
        &hid_class->hport->config.intf[hid_class->intf].altsetting[0].intf_desc;
    return desc->bInterfaceProtocol == HID_PROTOCOL_KEYBOARD;
}

static uint16_t game_nes_usb_key_to_btn(uint8_t key)
{
    switch (key) {
    case HID_KBD_USAGE_UP:
    case HID_KBD_USAGE_KPDUP:
    case GAME_NES_HID_KEY('W'):
        return GAME_NES_BTN_U1;
    case HID_KBD_USAGE_DOWN:
    case HID_KBD_USAGE_KPDDOWN:
    case GAME_NES_HID_KEY('S'):
        return GAME_NES_BTN_D1;
    case HID_KBD_USAGE_LEFT:
    case HID_KBD_USAGE_KPDLEFT:
    case GAME_NES_HID_KEY('A'):
        return GAME_NES_BTN_L1;
    case HID_KBD_USAGE_RIGHT:
    case HID_KBD_USAGE_KPDRIGHT:
    case GAME_NES_HID_KEY('D'):
        return GAME_NES_BTN_R1;
    case GAME_NES_HID_KEY('X'):
    case GAME_NES_HID_KEY('K'):
        return GAME_NES_BTN_A1;
    case GAME_NES_HID_KEY('Z'):
    case GAME_NES_HID_KEY('J'):
        return GAME_NES_BTN_B1;
    case HID_KBD_USAGE_ENTER:
    case HID_KBD_USAGE_KPDEMTER:
        return GAME_NES_BTN_ST1;
    case HID_KBD_USAGE_SPACE:
    case HID_KBD_USAGE_TAB:
        return GAME_NES_BTN_SE1;
    default:
        return 0;
    }
}

static uint16_t game_nes_usb_report_to_joypad(const struct usb_hid_kbd_report *report)
{
    uint16_t state = 0;

    if (!report) {
        return 0;
    }

    if (report->modifier & (HID_MODIFIER_LCTRL | HID_MODIFIER_RCTRL)) {
        state |= GAME_NES_BTN_B1;
    }
    if (report->modifier & (HID_MODIFIER_LALT | HID_MODIFIER_RALT)) {
        state |= GAME_NES_BTN_A1;
    }

    for (uint8_t i = 0; i < 6U; i++) {
        state |= game_nes_usb_key_to_btn(report->key[i]);
    }

    return state;
}

static void game_nes_usb_submit_keyboard_urb(struct usbh_hid *hid_class)
{
    if (!hid_class || !hid_class->intin || hid_class != g_usb_keyboard_hid) {
        return;
    }

    uint32_t packet_size = hid_class->intin->wMaxPacketSize;
    if (packet_size > sizeof(g_usb_keyboard_report)) {
        packet_size = sizeof(g_usb_keyboard_report);
    }

    usbh_int_urb_fill(&hid_class->intin_urb,
                      hid_class->hport,
                      hid_class->intin,
                      g_usb_keyboard_report,
                      packet_size,
                      0,
                      game_nes_usb_keyboard_callback,
                      hid_class);
    (void)usbh_submit_urb(&hid_class->intin_urb);
}

static void game_nes_usb_keyboard_callback(void *arg, int nbytes)
{
    struct usbh_hid *hid_class = (struct usbh_hid *)arg;

    if (hid_class != g_usb_keyboard_hid) {
        return;
    }

    if (nbytes >= (int)sizeof(struct usb_hid_kbd_report)) {
        const struct usb_hid_kbd_report *report =
            (const struct usb_hid_kbd_report *)g_usb_keyboard_report;
        g_usb_joypad_state = game_nes_usb_report_to_joypad(report);
        game_nes_usb_submit_keyboard_urb(hid_class);
    } else if (nbytes > 0) {
        g_usb_joypad_state = 0;
        game_nes_usb_submit_keyboard_urb(hid_class);
    } else if (nbytes == -USB_ERR_NAK) {
        game_nes_usb_submit_keyboard_urb(hid_class);
    } else {
        g_usb_joypad_state = 0;
        LISA_LOGW(LOG_TAG, "USB keyboard interrupt stopped: %d", nbytes);
    }
}

uint16_t game_nes_usb_keyboard_get_state(void)
{
    return g_usb_keyboard_connected ? g_usb_joypad_state : 0;
}

void usbh_hid_run(struct usbh_hid *hid_class)
{
    if (!hid_class || !hid_class->hport) {
        return;
    }

    if (!game_nes_usb_hid_is_keyboard(hid_class)) {
        const struct usb_interface_descriptor *desc =
            &hid_class->hport->config.intf[hid_class->intf].altsetting[0].intf_desc;
        LISA_LOGI(LOG_TAG, "Ignore HID interface protocol=%u", desc->bInterfaceProtocol);
        return;
    }

    if (g_usb_keyboard_hid && g_usb_keyboard_hid != hid_class) {
        LISA_LOGI(LOG_TAG, "Ignore additional USB keyboard intf=%u", hid_class->intf);
        return;
    }

    (void)usbh_hid_set_protocol(hid_class, 0);
    (void)usbh_hid_set_idle(hid_class, 0, 0);
    g_usb_keyboard_hid = hid_class;
    g_usb_joypad_state = 0;
    g_usb_keyboard_connected = true;

    LISA_LOGI(LOG_TAG, "USB keyboard connected: bus=%u hub=%u port=%u intf=%u",
              hid_class->hport->bus->busid,
              hid_class->hport->parent ? hid_class->hport->parent->index : 0,
              hid_class->hport->port,
              hid_class->intf);
    game_nes_usb_submit_keyboard_urb(hid_class);
}

void usbh_hid_stop(struct usbh_hid *hid_class)
{
    if (!game_nes_usb_hid_is_keyboard(hid_class) || hid_class != g_usb_keyboard_hid) {
        return;
    }

    g_usb_keyboard_hid = NULL;
    g_usb_joypad_state = 0;
    g_usb_keyboard_connected = false;
    LISA_LOGI(LOG_TAG, "USB keyboard disconnected");
}

static void game_nes_usb_event_handler(uint8_t busid,
                                       uint8_t hub_index,
                                       uint8_t hub_port,
                                       uint8_t intf,
                                       uint8_t event)
{
    const char *name = "UNKNOWN";

    switch (event) {
    case USBH_EVENT_ERROR:
        name = "ERROR";
        break;
    case USBH_EVENT_SOF:
        name = "SOF";
        break;
    case USBH_EVENT_DEVICE_RESET:
        name = "DEVICE_RESET";
        break;
    case USBH_EVENT_DEVICE_CONNECTED:
        name = "DEVICE_CONNECTED";
        break;
    case USBH_EVENT_DEVICE_DISCONNECTED:
        name = "DEVICE_DISCONNECTED";
        break;
    case USBH_EVENT_DEVICE_CONFIGURED:
        name = "DEVICE_CONFIGURED";
        break;
    case USBH_EVENT_INTERFACE_START:
        name = "INTERFACE_START";
        break;
    case USBH_EVENT_INTERFACE_STOP:
        name = "INTERFACE_STOP";
        break;
    case USBH_EVENT_INIT:
        name = "INIT";
        break;
    case USBH_EVENT_DEINIT:
        name = "DEINIT";
        break;
    default:
        break;
    }

    LISA_LOGI(LOG_TAG, "USB event: bus=%u hub=%u port=%u intf=%u event=%u(%s)",
              busid, hub_index, hub_port, intf, event, name);
}

void game_nes_usb_keyboard_init(void)
{
    static bool initialized;

    if (initialized) {
        return;
    }
    initialized = true;

    g_usb_joypad_state = 0;
    g_usb_keyboard_connected = false;
    g_usb_keyboard_hid = NULL;
    LISA_LOGI(LOG_TAG, "Initializing USB Host keyboard input");
    usbh_initialize(GAME_NES_USB_BUSID, GAME_NES_USB_REG_BASE, game_nes_usb_event_handler);
}

static int game_nes_usb_host_phy_init(void)
{
    IP_CMN_SYS->REG_USB_CTRL1.bit.USBPHY_OUTCLKSEL = 0x1;
    IP_SYSCTRL->REG_PERI_CLK_CFG6.bit.ENA_USB_CLK = 0x1;
    IP_CMN_SYS->REG_USB_CTRL1.bit.USBC_CFG_IDDIG = 0x0;
    IP_CMN_SYS->REG_USB_CTRL1.bit.UTMI_DATABUS16_8 = 0x1;
    return 0;
}

SYS_INIT(game_nes_usb_host_phy_init, SYS_INIT_LEVEL_PRE_DEVICES_INIT, 0);

#endif
```

## src/game_nes_usb_keyboard.h
```c
/*
 * Copyright (c) 2026, LISTENAI
 *
 * SPDX-License-Identifier: Apache-2.0
 */
#pragma once

#include <stdint.h>

#include "autoconf.h"

#ifdef __cplusplus
extern "C" {
#endif

#ifdef CONFIG_GAME_NES_USB_HOST_KEYBOARD
void game_nes_usb_keyboard_init(void);
uint16_t game_nes_usb_keyboard_get_state(void);
#else
static inline void game_nes_usb_keyboard_init(void)
{
}

static inline uint16_t game_nes_usb_keyboard_get_state(void)
{
    return 0;
}
#endif

#ifdef __cplusplus
}
#endif
```

## src/usb_config.h
```c
/*
 * Copyright (c) 2026, LISTENAI
 *
 * SPDX-License-Identifier: Apache-2.0
 */
#ifndef GAME_NES_USB_CONFIG_H
#define GAME_NES_USB_CONFIG_H

#include <stdio.h>

#define CONFIG_USB_PRINTF(...) printf(__VA_ARGS__)

#ifndef CONFIG_USB_DBG_LEVEL
#define CONFIG_USB_DBG_LEVEL USB_DBG_INFO
#endif

#define CONFIG_USB_DCACHE_ENABLE

#ifdef CONFIG_USB_DCACHE_ENABLE
#define CONFIG_USB_ALIGN_SIZE 32
#else
#define CONFIG_USB_ALIGN_SIZE 4
#endif

#define USB_NOCACHE_RAM_SECTION

#define CONFIG_USBHOST_MAX_RHPORTS          1
#define CONFIG_USBHOST_MAX_EXTHUBS          1
#define CONFIG_USBHOST_MAX_EHPORTS          4
#define CONFIG_USBHOST_MAX_INTERFACES       8
#define CONFIG_USBHOST_MAX_INTF_ALTSETTINGS 2
#define CONFIG_USBHOST_MAX_ENDPOINTS        6

#define CONFIG_USBHOST_MAX_SERIAL_CLASS 0
#define CONFIG_USBHOST_MAX_HID_CLASS    2
#define CONFIG_USBHOST_MAX_MSC_CLASS    0
#define CONFIG_USBHOST_MAX_AUDIO_CLASS  0
#define CONFIG_USBHOST_MAX_VIDEO_CLASS  0

#define CONFIG_USBHOST_DEV_NAMELEN 16

#ifndef CONFIG_USBHOST_PSC_PRIO
#define CONFIG_USBHOST_PSC_PRIO 0
#endif
#ifndef CONFIG_USBHOST_PSC_STACKSIZE
#define CONFIG_USBHOST_PSC_STACKSIZE 2048
#endif

#define CONFIG_USBHOST_GET_STRING_DESC

#ifndef CONFIG_USBHOST_REQUEST_BUFFER_LEN
#define CONFIG_USBHOST_REQUEST_BUFFER_LEN 512
#endif

#ifndef CONFIG_USBHOST_CONTROL_TRANSFER_TIMEOUT
#define CONFIG_USBHOST_CONTROL_TRANSFER_TIMEOUT 500
#endif

#ifndef CONFIG_USBHOST_MAX_BUS
#define CONFIG_USBHOST_MAX_BUS 1
#endif

#define CONFIG_USB_MUSB_PIPE_NUM 8

#endif
```
