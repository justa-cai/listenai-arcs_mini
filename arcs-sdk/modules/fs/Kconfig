## arcs-sdk/modules/fs/Kconfig
```kconfig
# SPDX-License-Identifier: Apache-2.0

menu "File Systems"

config FILE_SYSTEM
	bool "File system support"
	help
	  Enables support for file system.

if FILE_SYSTEM

config FS_LARGE64_FILES
    bool "Support __LARGE64_FILES"
    default n


orsource "subfs/Kconfig"
orsource "lsfs/Kconfig"
orsource "lvfs/Kconfig"
orsource "lvfs/posix/Kconfig"

endif # FILE_SYSTEM

orsource "port/Kconfig"
orsource "disk/Kconfig"

endmenu
```

## arcs-sdk/modules/fs/disk/Kconfig
```kconfig
# SPDX-License-Identifier: Apache-2.0

menu "disk driver"

config DISK_DRIVER
	bool "Disk driver support"
	help
	  Enables support for disk driver.

if DISK_DRIVER

config DISK_IOCACHE_ENABLE
	bool "Enable IO cache"
	default n

rsource "Kconfig.flash"
rsource "Kconfig.ram"
rsource "Kconfig.sdmmc"

endif # FILE_SYSTEM

endmenu
```

## arcs-sdk/modules/fs/disk/Kconfig.flash
```kconfig
# SPDX-License-Identifier: Apache-2.0

config DISK_DRIVER_FLASH
	bool "Flash"
	select LISA_DEVICE
	select LISA_FLASH
	help
	  Flash device is used for the file system.

if DISK_DRIVER_FLASH

config DISK_FLASH_VOLUME_NAME
	string "Flash mount point or drive name"
	default "NAND"
	help
	  Disk name as per file system naming guidelines.

config DISK_FLASH_CHIP_BASE_ADDR
	hex "Flash device chip base address in hex"
	default 0x30000000
	help
	  This is base logic address of the flash.

config DISK_FLASH_CHIP_SIZE
	hex "Flash device chip size in hex"
	default 0x2000000
	help
	  This is chip size of the flash.

config DISK_FLASH_START_ADDR
	hex "Flash device start address in hex"
	help
	  This is start address of the flash to be used as storage backend.

config DISK_FLASH_MAX_RW_SIZE
	int "Flash device max read-write size in decimal"
	help
	  This is the maximum number of bytes that the
	  flash_write API can accept per invocation.
	  API.

config DISK_FLASH_ERASE_ALIGNMENT
	int "Flash device erase alignment in decimal"
	help
	  This is the start address alignment required by
	  the flash component.

config DISK_FLASH_ERASE_BLOCK_SIZE
	int "Flash device erasable block size in decimal"
	help
	  This is typically the minimum block size that
	  is erased at one time in flash storage.
	  Typically it is equal to the flash memory page size.

config DISK_FLASH_SECTOR_SIZE
	int "Flash device sector size in decimal"
	default 512
	help
	  This is the file system sector size in bytes.

config DISK_FLASH_VOLUME_SIZE
	int "Flash device volume size in decimal"
	help
	  This is the file system volume size in bytes.

endif # DISK_DRIVER_FLASH
```

## arcs-sdk/modules/fs/disk/Kconfig.ram
```kconfig
# SPDX-License-Identifier: Apache-2.0

config DISK_DRIVER_RAM
	bool "RAM Disk"
	default n
	help
	  RAM buffer used to emulate storage disk.
	  This option can be used to test the file
	  system.

if DISK_DRIVER_RAM

config DISK_RAM_VOLUME_NAME
	string "RAM mount point or drive name"
	default "RAM"
	help
	  Disk name as per file system naming guidelines.

config DISK_RAM_SECTOR_SIZE
	int "RAM device sector size in decimal"
	default 512
	help
	  This is the file system sector size in bytes.

config DISK_RAM_SECTOR_COUNT
	int "RAM device sector size in decimal"
	default 128
	help
	  This is the file system sector count.

config DISK_RAM_MEMORY_SECTION_NAME
	string "RAM device used memory segment name"
	default ".bss"
	help
	  This is the name memory segment used.

endif # DISK_DRIVER_RAM
```

## arcs-sdk/modules/fs/disk/Kconfig.sdmmc
```kconfig
# SPDX-License-Identifier: Apache-2.0

config DISK_DRIVER_SDMMC
	bool "SDMMC disk driver"
	default n
	help
		Support using sdmmc devices as storage media for file systems

if DISK_DRIVER_SDMMC

config DISK_SDMMC_VOLUME_NAME
	string "SDMMC mount point or drive name"
	default "SD"
	help
	  Disk name as per file system naming guidelines.

config DISK_SDMMC_START_SECTOR_NUMBER
	int "SDMMC disk start sector number"
	default 0x0
	help
	  The starting sector number of the file system in the SD/MMC device.
config DISK_SDMMC_ACCESS_BUFFER_ALIGN_ENABLE
	bool "Enable SDMMC access buffer alignment"
	default y

if DISK_SDMMC_ACCESS_BUFFER_ALIGN_ENABLE

config DISK_SDMMC_ACCESS_BUFFER_ALIGN_SIZE
	int "SDMMC access buffer alignment size"
	default 32

config DISK_SDMMC_ACCESS_WRAP_BUFFER_SIZE
	int "SDMMC access wrap buffer size"
	default 4096

endif

config DISK_SDMMC_IOCACHE_ENABLE
	bool "Enable SDMMC IO cache"
	default n
	depends on DISK_IOCACHE_ENABLE

if DISK_SDMMC_IOCACHE_ENABLE
	config DISK_SDMMC_IOCACHE_ENTRY_COUNT
		int "SDMMC IO cache entry count"
		default 1024
	config DISK_SDMMC_IOCACHE_MAX_BLOCK_SIZE
		int "SDMMC IO cache max block size"
		default 512
	config DISK_SDMMC_IOCACHE_SECTOR_SIZE
		int "SDMMC IO cache sector size"
		default 512

endif

endif # DISK_DRIVER_SDMMC
```

## arcs-sdk/modules/fs/lsfs/Kconfig
```kconfig
# SPDX-License-Identifier: Apache-2.0

config LSFS
  bool "LSFS file system support"
  help
    Use the LSFS File system implementation.

if LSFS

config LSFS_MAX_NUMBER
    int "Maximum number of subfs instances"
    default 1
    help
      Maximum number of subfs instances that can be created.

config LSFS_FAT
    bool "Support fatfs under lsfs"
    depends on FATFS_FILESYSTEM
    default n

config LSFS_REGISTER_VFS
    bool "Register lsfs to lvfs"
    depends on LVFS
    default n
    help
        Register lsfs to lvfs.

config LSFS_SUPPORT_FREEZE
    bool "Support freeze file system"
    default n
    help
        Support freeze file system.

config LSFS_TRUNCATE_ALLOC_UNIT_SIZE
    int "Truncate allc unit size"
    default 32768
    help
        Truncate allc unit size.

endif # LSFS
```

## arcs-sdk/modules/fs/lvfs/Kconfig
```kconfig
# SPDX-License-Identifier: Apache-2.0

config LVFS
  bool "LVFS file system support"
  help
    Lightweight Virtual File System (LVFS) provides a unified file system
    abstraction layer that supports standard file operations and multiple
    file system types. It is designed to be lightweight and suitable for
    embedded systems. Enable this if you need to support different file 
    systems in your system with a common interface.


if LVFS

config LVFS_NFILE_DESC_PER_BLOCK
    int "Number of file descriptors per block"
    default 32
    help
      Number of file descriptors per block. Each block can contain up to
      LVFS_NFILE_DESC_PER_BLOCK file descriptors. The larger this number, the
      more memory is used. The smaller this number, the more blocks are
      needed to store the file descriptors and the more overhead is
      incurred when traversing the file descriptor list.

config LVFS_PREFIX_PATH_LENGTH_MAX
    int "Maximum length of a path for LVFS"
    default 64
    help
      The maximum length of a path for LVFS.

config LVFS_POSIX_API
      bool "POSIX-like file system API support"
      default n
      help
          Enable POSIX-like file system API support in LVFS. This includes
          standard functions like open(), close(), read(), write(), etc.
          This allows applications to use familiar POSIX file operations
          through the LVFS layer.

config LVFS_POSIX_API_ALIAS
      bool "POSIX-like file system API support alias"
      default n
      depends on LVFS_POSIX_API
      help

config LVFS_POSIX_RESERVE_FD
      int "POSIX-like file system API reserve fd"
      default 3
      help
          Reserve file descriptors for stdin/stdout/stderr use.

config LVFS_LSFS_AUTO_REGISTER
      bool "Auto register LSFS file system"
      default n
      help
          Auto register LSFS file system.

endif
```

## arcs-sdk/modules/fs/lvfs/posix/Kconfig
```kconfig
config LVFS_POSIX_API_DEFAULT_MOUNT_PATH
    string "Default mount path"
    default "/SD:/"
    depends on LVFS_POSIX_API
```

## arcs-sdk/modules/fs/port/Kconfig
```kconfig
# SPDX-License-Identifier: Apache-2.0
choice
    prompt "Select Operating System"
    default FS_ENV_OS_FREERTOS

config  FS_ENV_OS_BARE_METAL
    bool "Bare Metal (No OS)"

config FS_ENV_OS_FREERTOS
    bool "FreeRTOS"

endchoice

choice FS_ENV_MEMORY_SELECTION
    prompt "Memory Management Selection"
    default FS_ENV_MEMORY_MANAGEMENT_OS if FS_ENV_OS_FREERTOS
    default FS_ENV_MEMORY_MANAGEMENT_CLIB
    help
        Select the memory management strategy for the file system.

config FS_ENV_MEMORY_MANAGEMENT_CLIB
    bool "Standard C Library (malloc/free)"
    help
        Use standard C library memory management functions.
        This is suitable for simple systems or when no special memory requirements exist.
        Functions used: malloc(), free(), realloc()

config FS_ENV_MEMORY_MANAGEMENT_OS
    bool "OS Heap Management"
    depends on FS_ENV_OS_FREERTOS
    help
        Use OS memory management system.

endchoice

config FS_ENV_MEMORY_MANAGEMENT_USE_PSRAM
    bool "Use PSRAM for memory management"
    default y
    depends on FS_ENV_MEMORY_MANAGEMENT_OS

if FS_ENV_OS_FREERTOS
    config FS_ENV_OS_LIBRARY_NAME
        string "Library name"
        default "freertos"
endif
```

## arcs-sdk/modules/fs/subfs/fatfs/Kconfig
```kconfig
# SPDX-License-Identifier: Apache-2.0

config FATFS_FILESYSTEM
	bool "FATFS file system support"
	depends on FILE_SYSTEM
	help
	  Use the FATFS File system implementation.

if FATFS_FILESYSTEM

config FATFS_FFCONF_OVERRIDE
	bool "FATFS file system config file override"
	default n
	help
		FATFS file system config file override.	
if FATFS_FFCONF_OVERRIDE

config FATFS_FFCONF_NAME
	string "FATFS file system config file name"
	default ""
	help 
		FATFS file system config file name

endif

endif # FAT_FILESYSTEM_ELM
```

## arcs-sdk/modules/giflib/Kconfig
```kconfig
menu "giflib configuration"

    config SDK_MODULE_GIFLIB
        bool "giflib support"
        default n

endmenu
```

## arcs-sdk/modules/googletest/Kconfig
```kconfig
menu "googletest configuration"

    config MODULE_GTEST
        bool "google's c++ test framework support"
        default n

endmenu
```

## arcs-sdk/modules/http_ssl/Kconfig
```kconfig
menu "SSL/TLS transport layer configuration"

    config MODULE_ZE_TLS
        bool "ze_tls support"
        default n

endmenu
```

## arcs-sdk/modules/httpclient/Kconfig
```kconfig
menu "httpclient configuration"

    config MODULE_HTTPCLIENT
        bool "httpclient support"
        default n

endmenu
```

## arcs-sdk/modules/ijg/Kconfig
```kconfig
# SPDX-License-Identifier: Apache-2.0

menu "ijg"

config SDK_MODULE_IJG
    bool "ijg support"
    default n
    help
        Reference repository for The Independent JPEG Group's JPEG software, 
        with the TurboJPEG API bolted on (for benchmarking purposes)
        https://github.com/libjpeg-turbo/ijg/tree/main

endmenu
```

## arcs-sdk/modules/letter-shell/Kconfig
```kconfig
menu "letter-shell configuration"

    menuconfig SDK_MODULE_LETTER_SHELL
        bool "letter-shell support"
        default n

        config SDK_MODULE_LETTER_SHELL_CONFIG_FILE
            string "letter-shell config file"

        config SDK_MODULE_LETTER_SHELL_CPP_SUPPORT
            bool "letter-shell cpp support"
            default n

        config SDK_MODULE_LETTER_SHELL_FS_SUPPORT
            bool "letter-shell fs support"
            default n

        config SDK_MODULE_LETTER_SHELL_ENHANCE
            bool "letter-shell enhance support"
            default n

endmenu
```

## arcs-sdk/modules/libcurl/Kconfig
```kconfig
config SDK_MODULE_CURL
    bool "curl support"
    default n
    select LWIP

menuconfig CURL
    bool "curl support"
    depends on SDK_MODULE_CURL
    default y
```

## arcs-sdk/modules/libico/Kconfig
```kconfig
config SDK_MODULE_ICO
    bool "ico support"
    default n

menuconfig ICO
    bool "ico support"
    depends on SDK_MODULE_ICO
    default n
```

## arcs-sdk/modules/libid3tag/Kconfig
```kconfig
menu "libid3tag configuration"

    config SDK_MODULE_LIBID3TAG
        bool "enable libid3tag"
        default n

endmenu 
```

## arcs-sdk/modules/libjpeg-turbo/Kconfig
```kconfig
menu "libjpeg-turbo configuration"

    config SDK_MODULE_LIBJPEG_TURBO
        bool "libjpeg-turbo support"
        default n
        # select LIBJPEG_TURBO

endmenu
```

## arcs-sdk/modules/libmad/Kconfig
```kconfig
menu "libmad configuration"

    config SDK_MODULE_LIBMAD
        bool "enable libmad"
        default n

endmenu 
```

## arcs-sdk/modules/libpng/Kconfig
```kconfig
menu "libpng configuration"

    config SDK_MODULE_LIBPNG
        bool "libpng support"
        default n
        select ZLIB

endmenu
```

## arcs-sdk/modules/libxml2/Kconfig
```kconfig
menu "libxml2 configuration"

    config SDK_MODULE_LIBXML
        bool "libxml2 support"
        default n
        select LIBXML2

endmenu
```

## arcs-sdk/modules/lisa_player/Kconfig
```kconfig
menu "lisa player"

config SDK_MODULE_LISA_PLAYER
    bool "Enable lisa player"
    select LISA_NET
    default n

config SDK_MODULE_LISA_PLAYER_DECODE_LOG_AUDIO_CACHE
    bool "Enable lisa player decode audio cache log"
    depends on SDK_MODULE_LISA_PLAYER
    default n

endmenu
```

## arcs-sdk/modules/lshell/Kconfig
```kconfig
menuconfig MODULE_SHELL
    bool "Shell Module"
    default n
    help
        Shell Module
    if MODULE_SHELL
        config SHELL_NAME
            string "Module Name"
            default "shell"
        config TPF_ENABLE
            bool "Use TinyPrintf"
            default y
        config SHELL_PARAM_MAX
            int "Max Argument Counts"
            default 4
            range 1 8
        config SHELL_HISTORY_MAX
            int "Max History Counts"
            default 5
            range 0 10
        config SHELL_LINE_LIMIT
            int "Shell Line Limit(Bytes)"
            default 500
            range 64 512
        config SHELL_TXBUF_SIZE
            int "Shell TX Buffer Size(Bytes)"
            default 512
            range 128 1024
        config SHELL_RXBUF_SIZE
            int "Shell RX Buffer Size(Bytes)"
            default 32
            range 16 128
        config SHELL_COLOR_ENABLE
            bool "Enable Color in Shell"
            default y
        choice
            prompt "New Line Format"
            default SHELL_NEWLINE_LF
            config SHELL_NEWLINE_CRLF
                bool "\\r\\n"
            config SHELL_NEWLINE_CR
                bool "\\r"
            config SHELL_NEWLINE_LF
                bool "\\n"
        endchoice

        choice
            prompt "Shell Debug Level"
            default SHELL_DEBUG_LEVEL_DEBUG
            config SHELL_DEBUG_LEVEL_NONE
                bool "0:None"
            config SHELL_DEBUG_LEVEL_ERROR
                bool "1:Error"
            config SHELL_DEBUG_LEVEL_WARN
                bool "2:Warnning"
            config SHELL_DEBUG_LEVEL_INFO
                bool "3:Information"
            config SHELL_DEBUG_LEVEL_DEBUG
                bool "4:Debug"
            config SHELL_DEBUG_LEVEL_VERB
                bool "5:Verbose"
        endchoice
        config SHELL_DEBUG_LEVEL
            int
            default 0 if SHELL_DEBUG_LEVEL_NONE
            default 1 if SHELL_DEBUG_LEVEL_ERROR
            default 2 if SHELL_DEBUG_LEVEL_WARN
            default 3 if SHELL_DEBUG_LEVEL_INFO
            default 4 if SHELL_DEBUG_LEVEL_DEBUG
            default 5 if SHELL_DEBUG_LEVEL_VERB
            range 0 5
    endif
```
