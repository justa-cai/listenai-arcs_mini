## arcs-sdk/modules/ltlsf/Kconfig
```kconfig
menu "ltlsf configuration"

    config SDK_MODULE_LTLSF
        bool "ltlsf support"
        default n

endmenu
```

## arcs-sdk/modules/lvgl/Kconfig
```kconfig
menu "LVGL configuration"

    config SDK_MODULE_LVGL
        bool "lvgl support"
        default n

if SDK_MODULE_LVGL
    config LV_HOR_RES_MAX
        int "Horizontal Screen Resolution"
        default 320
        help
        Horizontal screen resolution in pixels

    config LV_VER_RES_MAX
        int "Vertical Screen Resolution"
        default 480
        help
        Vertical screen resolution in pixels

    config LV_CUSTOM_MONITOR
        bool "custom monitor"
        default n

    config LV_CUSTOM_TASK_CPU_PER
        bool "Use task runtime ticks to calculate CPU usage"
        default n

    config LV_DISP_DEF_REFR_PERIOD
        int "Default display refresh period (ms)."
        default 30
        help
            Can be changed in the display driver (`lv_disp_drv_t`).

    config LV_DOUBLE_VDB
        bool "Use two rendering buffers"
        default n
        help
        Use two buffers to render and flush data in parallel

    config LV_USE_RPC
        bool "Using Remote Procedure Call"
        depends on IRQ_PROXY
        default n

    config LV_USE_RPC_THRESHOLD
        int "Threshold for RPC" if LV_USE_RPC=y
        depends on LV_USE_RPC
        default 50000
        help
            If the area size is larger than this value, RPC will be executed

    config LV_RPC_SERVER
        bool "Remote proxy server"
        default n
            
    config LV_REFR_UNCONDITIONAL_AREA_JOIN
        bool "Unconditionally join invalidated areas"
        default n
        help
        When enabled, all invalidated areas will be joined unconditionally
        during screen refresh, regardless of whether they overlap or not.

    menu "Demos"
        config LV_USE_DEMO_WIDGETS
        bool "Show some widget"
        default n

        config LV_USE_DEMO_KEYPAD_AND_ENCODER
            bool "Demonstrate the usage of encoder and keyboard"
            default n

        config LV_USE_DEMO_BENCHMARK
            bool "Benchmark your system"
            default n

        config LV_USE_DEMO_MUSIC
            bool "Music player demo"
            default n   
    endmenu


    config LV_DRIVER_PIXEL_ALIGN_SIZE
        int "lvgl display driver pixel alignment size"
        default 1

    choice LV_DRIVER_ROTATION
        prompt "Display Rotation"
        default LV_DRIVER_ROTATE_NORMAL
        help
            Select the rotation angle for the display

        config LV_DRIVER_ROTATE_NORMAL
            bool "No rotation (0 degrees)"
            
        config LV_DRIVER_ROTATE_90
            bool "Rotate 90 degrees clockwise"
            
            
        config LV_DRIVER_ROTATE_270
            bool "Rotate 270 degrees clockwise"
    endchoice

    config LV_DRIVER_FULL_REFRESH
        bool "full refresh"
        default n
        help
        Always make the whole screen redrawn

    config LV_USE_PERF_MONITOR
        bool "Show CPU usage and FPS count."
        default n

    menu "CSK GPU"
        config LV_USE_GPU_CSK_DMA2D
            bool "use csk dma2d"
            default n

        config LV_CSK_DMA2D_CH
            int "csk dma2d channel"
            default 0

        config LV_CSK_SW_LETTER
            bool "csk dma2d software letter"
            depends on LV_USE_GPU_CSK_DMA2D
            default n

        config LVGL_GPU_CSK_COPY
            bool "csk dma2d copy"
            depends on LV_USE_GPU_CSK_DMA2D
            default y

        config LVGL_GPU_CSK_FILL
            bool "csk dma2d fill"
            depends on LV_USE_GPU_CSK_DMA2D
            default y
        
        config LVGL_GPU_CSK_FILL_MASK
            bool "csk dma2d fill mask"
            depends on LV_USE_GPU_CSK_DMA2D
            default n
        
        config LVGL_GPU_CSK_BLEND
            bool "csk dma2d blend"
            depends on LV_USE_GPU_CSK_DMA2D
            default n

        config LVGL_GPU_CSK_COPY_MIN_SIZE
            int "csk dma2d copy size"
            depends on LVGL_GPU_CSK_COPY
            default 5000

        config LVGL_GPU_CSK_FILL_MIN_SIZE
            int "csk dma2d fill size"
            depends on LVGL_GPU_CSK_FILL
            default 5000
        
        config LVGL_GPU_CSK_FILL_MASK_MIN_SIZE
            int "csk dma2d fill mask size"
            depends on LVGL_GPU_CSK_FILL_MASK
            default 240
        
        config LVGL_GPU_CSK_BLEND_MIN_SIZE
            int "csk dma2d blend size"
            depends on LVGL_GPU_CSK_BLEND
            default 240

        config LVGL_GPU_CSK_GPDMA_DMA2D_MUTEX
            bool "csk dma2d mutex"
            default n

        config LVGL_GPU_CSK_CPDMA_DMA2D
            bool "csk cpdma do blend and fill"
            default y

        config LVGL_GPU_CSK_CPDMA_DMA2D_CH
            depends on LVGL_GPU_CSK_CPDMA_DMA2D
            int "csk cpdma channel for blend and fill "
            default 1
    endmenu

    config LV_POINTER_SWAP_XY
        bool "Swap keyboard scan X,Y axes"
        help
        Swap keyboard scan X,Y axes. This option can be used to align keyboard
        scan coordinates with the display.

    config LV_POINTER_INVERT_X
        bool "Invert keyboard scan X axis"
        help
        Invert keyboard scan X axis. This option can be used to align keyboard
        scan coordinates with the display.

    config LV_POINTER_INVERT_Y
        bool "Invert keyboard scan Y axis"
        help
        Invert keyboard scan Y axis. This option can be used to align keyboard
        scan coordinates with the display.
    
    config LV_COORD_TYPE_INT32
        bool "Use 32-bit coordinates"
        default n
        help
        Use 32-bit coordinates instead of the default 16-bit coordinates.
        This is useful for high-resolution displays or when working with large
        coordinate values.

endif

endmenu 
```

## arcs-sdk/modules/lvgl8/Kconfig.indev
```kconfig
config LS_LV_INDEV_TASK_QUEUE_SIZE
      int "indev task queue size"
      default 100
      help
          Set the queue size of the LVGL input task.

config LV_POINTER_SWAP_XY
	bool "Swap keyboard scan X,Y axes"
	help
	  Swap keyboard scan X,Y axes. This option can be used to align keyboard
	  scan coordinates with the display.

config LV_POINTER_INVERT_X
	bool "Invert keyboard scan X axis"
	help
	  Invert keyboard scan X axis. This option can be used to align keyboard
	  scan coordinates with the display.

config LV_POINTER_INVERT_Y
	bool "Invert keyboard scan Y axis"
	help
	  Invert keyboard scan Y axis. This option can be used to align keyboard
	  scan coordinates with the display.

config LV_INDEV_DEF_SCROLL_THROW
	int "indev scroll throw"
	default 10
	help
	  Set the scroll throw of the indev.
```

## arcs-sdk/modules/lvgl8/Kconfig.port
```kconfig
config LVGL_HEAP_SIZE
    hex "LVGL independent heap size"
    depends on LV_DEMO_SYS_HEAP
    default 0x100000
    help
        Size of LVGL independent heap in bytes (default 1MB = 0x100000).
        The heap will be allocated in PSRAM (.psram.bss section).
        Adjust this value based on your UI complexity and memory usage.

config LV_CUSTOM_MONITOR
    bool "Custom monitor"
    default n

config LV_USE_RPC
    bool "Using Remote Procedure Call"
    default n

config LV_USE_RPC_THRESHOLD
    int "Threshold for RPC" if LV_USE_RPC=y
    default 50000
    help
        If the area size is larger than this value, RPC will be executed

config LV_DOUBLE_VDB
    bool "Use two rendering buffers"
    default n
    help
    Use two buffers to render and flush data in parallel

config LV_DRIVER_PIXEL_ALIGN_SIZE
    int "lvgl display driver pixel alignment size"
    default 1

config LV_CUSTOM_TASK_CPU_PER
    bool "Use task runtime ticks to calculate CPU usage"
    default n

config LV_DRIVER_FULL_REFRESH
    bool "full refresh"
    default n
    help
    Always make the whole screen redrawn

choice LV_DRIVER_ROTATION
    prompt "Display Rotation"
    default LV_DRIVER_ROTATE_NORMAL
    help
        Select the rotation angle for the display

    config LV_DRIVER_ROTATE_NORMAL
        bool "No rotation (0 degrees)"
        
    config LV_DRIVER_ROTATE_90
        bool "Rotate 90 degrees clockwise"
        
        
    config LV_DRIVER_ROTATE_270
        bool "Rotate 270 degrees clockwise"
endchoice

menu "CSK GPU"
    config LV_USE_GPU_CSK_DMA2D
        bool "use csk dma2d"
        default n

    config LV_CSK_DMA2D_CH
        int "csk dma2d channel"
        default 0

    config LV_CSK_SW_LETTER
        bool "csk dma2d software letter"
        depends on LV_USE_GPU_CSK_DMA2D
        default n

    config LVGL_GPU_CSK_COPY
        bool "csk dma2d copy"
        depends on LV_USE_GPU_CSK_DMA2D
        default n

    config LVGL_GPU_CSK_FILL
        bool "csk dma2d fill"
        depends on LV_USE_GPU_CSK_DMA2D
        default n
    
    config LVGL_GPU_CSK_FILL_MASK
        bool "csk dma2d fill mask"
        depends on LV_USE_GPU_CSK_DMA2D
        default n
    
    config LVGL_GPU_CSK_BLEND
        bool "csk dma2d blend"
        depends on LV_USE_GPU_CSK_DMA2D
        default n

    config LVGL_GPU_CSK_COPY_MIN_SIZE
        int "csk dma2d copy size"
        depends on LVGL_GPU_CSK_COPY
        default 1024

    config LVGL_GPU_CSK_FILL_MIN_SIZE
        int "csk dma2d fill size"
        depends on LVGL_GPU_CSK_FILL
        default 1024
    
    config LVGL_GPU_CSK_FILL_MASK_MIN_SIZE
        int "csk dma2d fill mask size"
        depends on LVGL_GPU_CSK_FILL_MASK
        default 240
    
    config LVGL_GPU_CSK_BLEND_MIN_SIZE
        int "csk dma2d blend size"
        depends on LVGL_GPU_CSK_BLEND
        default 240

    config LVGL_GPU_CSK_GPDMA_DMA2D_MUTEX
        bool "csk dma2d mutex"
        default n

    config LVGL_GPU_CSK_CPDMA_DMA2D
        bool "csk cpdma do blend and fill"
        default y

    config LVGL_GPU_CSK_CPDMA_DMA2D_CH
        depends on LVGL_GPU_CSK_CPDMA_DMA2D
        int "csk cpdma channel for blend and fill "
        default 1
endmenu
```

## arcs-sdk/modules/mac_manager/Kconfig
```kconfig
menu "mac manager configuration"

config MAC_MANAGER
        bool "enable mac manager"
        default n
        select LOG
        select LISA_KV

if MAC_MANAGER
    choice
        prompt "MAC manager selection"
        default MAC_MANAGER_MAC_IN_LISA_KV

    config MAC_MANAGER_MAC_IN_LISA_KV
        bool "mac from lisa kv"

    config MAC_MANAGER_MAC_IN_FLASH
        bool "mac in flash"

    config MAC_MANAGER_MAC_BY_CHIP_ID
        bool "mac by chip id"

    endchoice

    config MAC_MANAGER_MAC_IN_FLASH_ADDR
        hex "mac in flash address"
        default 0xFF0000
        depends on MAC_MANAGER_MAC_IN_FLASH

endif #MAC_MANAGER

endmenu
```

## arcs-sdk/modules/mac_manager/test/mac_manager/testcase.yaml
```yaml
tests:
  test.mac_manager:
    runner: linux
    builder: cmake
    log_analyzer: "unity"
```

## arcs-sdk/modules/mac_manager/test/mac_manager_build_only_chip_id/testcase.yaml
```yaml
tests:
  test.mac_manager_build_only_chip_id:
    runner: linux
    builder: cmake
    build_only: true
    log_analyzer: "unity"
```

## arcs-sdk/modules/mac_manager/test/mac_manager_build_only_lisa_kv/testcase.yaml
```yaml
tests:
  test.mac_manager_build_only_lisa_kv:
    runner: linux
    builder: cmake
    build_only: true
    log_analyzer: "unity"
```

## arcs-sdk/modules/mac_manager/test/port_content_chip_id/testcase.yaml
```yaml
tests:
  test.port_content_chip_id:
    runner: linux
    builder: cmake
    log_analyzer: "unity"
```

## arcs-sdk/modules/mac_manager/test/port_content_lisa_kv/testcase.yaml
```yaml
tests:
  test.port_content_lisa_kv:
    runner: linux
    builder: cmake
    log_analyzer: "unity"
```

## arcs-sdk/modules/mbedtls/Kconfig.csk-porting
```kconfig
menu "Mbedtls hardware acceleration"
     depends on SDK_MODULE_MBEDTLS && MBEDTLS_CFG_FILE = "config-tls-generic.h"

menu "hardware acceleration ic_mutex"
    config MBEDTLS_HARDWARE_IC_MUTEX
        bool "Enable hardware acceleration for multi-core by use ic_mutex"
        depends on ARCS_HAL_IC_MUTEX
        default y
endmenu

menu "General hardware acceleration"

    config MBEDTLS_PLATFORM_PRINTF_ALT
        bool "Enable platform custom printf"
        default n

endmenu

menu " Cipher hardware acceleration"

    config MBEDTLS_HARDWARE_AES
        bool "Enable hardware AES acceleration"
        default n

    config MBEDTLS_HARDWARE_AES_CCM
        bool "Enable hardware aes ccm acceleration"
        default n

    config MBEDTLS_HARDWARE_AES_GCM
        bool "Enable hardware aes gcm acceleration"
        default n

    config MBEDTLS_HARDWARE_AES_CMAC
        bool "Enable hardware aes cmac acceleration"
        default n

endmenu

menu "Message digest hardware acceleration"

    config MBEDTLS_HARDWARE_SHA1
        bool "Currently not available, do not use it now. Enable hardware SHA1 acceleration"
        depends on n

    config MBEDTLS_HARDWARE_SHA256
        bool "Currently not available, do not use it now. Enable hardware SHA256 acceleration"
        depends on n

    config MBEDTLS_HARDWARE_SHA512
        bool "Currently not available, do not use it now. Enable hardware SHA512 acceleration"
        depends on n

    config MBEDTLS_HARDWARE_SHA_HMAC
        bool "Enable hardware sha hmac acceleration"
        default n

endmenu

menu "Entropy source hardware acceleration"

    config MBEDTLS_HARDWARE_ENTROPY
        bool "mbed TLS entropy source based on hardware entropy"
        help
            This option enables the entropy source based on hardware entropy
            for mbed TLS.

endmenu

menu "Rsa hardware acceleration"

    config MBEDTLS_HARDWARE_MPI_MODULAR_EXPONENTIATION
        bool "Enable hardware MPI modular exponent acceleration"
        default n
        help
            Enable hardware acceleration for MPI modular exponentiation(X = A^E mod N).
            This option can accelerate RSA and other algorithms that use modular exponentiation.

endmenu

menu "Ecp hardware acceleration"

    config MBEDTLS_HARDWARE_ECC
        bool "Enable hardware ECC acceleration"
        default n

endmenu

endmenu
```

## arcs-sdk/modules/mempool/Kconfig
```kconfig
menu "mempool"

config SDK_MODULE_MEMPOOL
    bool "enable sdk module mempool"
    default n

endmenu
```

## arcs-sdk/modules/micro-rtsp-c/Kconfig
```kconfig
menu "micro-rtsp-c"

config SDK_MODULE_MICRO_RTSP_C
    bool "enable sdk module micro-rtsp-c"
    default n
    help
      Enable the micro-rtsp-c RTSP server module.
      This is a C implementation of RTSP server for video streaming.

endmenu
```

## arcs-sdk/modules/mp3dec/Kconfig
```kconfig
menu "mp3dec"

config SDK_MODULE_MP3_DECODER
    bool "Enable mp3dec"
    default n

endmenu
```

## arcs-sdk/modules/nopoll/Kconfig
```kconfig
menu "nopoll configuration"

    config MODULE_NOPOLL
        bool "nopoll support"
        default n

    config NOPOLL_DELIVER_PONG_FRAME_ENABLED
        bool "nopoll deliver pong frame enable"
        default n
endmenu
```

## arcs-sdk/modules/opusdec/Kconfig
```kconfig
# OPUS decoder configuration

config SDK_MODULE_OPUS_DECODER
    bool "Enable OPUS decoder module"
    default y
    help
        Enable OPUS audio decoder support for decoding OPUS encoded audio streams.
```

## arcs-sdk/modules/quirc/Kconfig
```kconfig
menu "quirc configuration"

    config SDK_MODULE_QUIRC
        bool "quirc QR-code recognition library support"
        default n
        help
          quirc is a library for extracting and decoding QR codes from images.
          It has fast recognition algorithm with small memory footprint.

endmenu
```

## arcs-sdk/modules/resample/Kconfig
```kconfig
menu "resample"

config SDK_MODULE_RESAMPLE
    bool "Enable resample"
    default n
    select LISA_OS

endmenu
```
