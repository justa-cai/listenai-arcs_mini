## arcs-sdk/modules/wifi_manager/test/wifi_manager/testcase.yaml
```yaml
tests:
  test.wifi_manager:
    runner: linux
    builder: cmake
    log_analyzer: "unity"
```

## arcs-sdk/modules/wifi_manager/test/wifi_manager_arcs/testcase.yaml
```yaml
tests:
  test.wifi_manager_arcs:
    runner: linux
    builder: cmake
    log_analyzer: "unity"
```

## arcs-sdk/modules/wifi_manager/test/wifi_manager_storage/testcase.yaml
```yaml
tests:
  test.wifi_manager_storage:
    runner: linux
    builder: cmake
    log_analyzer: "unity"
```

## arcs-sdk/modules/wifi_manager/test/wifi_manager_storage_cache/testcase.yaml
```yaml
tests:
  test.wifi_manager_storage_cache:
    runner: linux
    builder: cmake
    log_analyzer: "unity"
```

## arcs-sdk/modules/wifi_manager/test/wifi_manager_storage_migrate/testcase.yaml
```yaml
tests:
  test.wifi_manager_storage_migrate:
    runner: linux
    builder: cmake
    log_analyzer: "unity"
```

## arcs-sdk/modules/zlib/Kconfig
```kconfig
# SPDX-License-Identifier: Apache-2.0

menu "zlib"

config ZLIB
    bool "zlib support"
    default n
    help
        A massively spiffy yet delicately unobtrusive compression library.
        zlib.net/
        https://github.com/madler/zlib/tree/master


config ZLIB_SOLO
    bool "zlib solo without gzip"
    depends on ZLIB
    default n
    help
        compiler without gzip
        compiler without standard c file i/o stream.
        application must provide custom memory allocation functions.

endmenu
```

## arcs-sdk/samples/algorithms/wake_up/wakeup_double/sample.yaml
```yaml
tests:
  samples.algorithms.wakeup:
    programmer: arcs
    runner: uart
    build_only: true
    log_analyzer:
      type: "regex"
      pattern: "相位补偿已设置"
```

## arcs-sdk/samples/bluetooth/audio_framework/msbc_loopback/sample.yaml
```yaml
tests:
  samples.bt_audio_framework.msbc_loopback:
    programmer: arcs
    runner: uart
    log_analyzer:
      type: "regex"
      pattern: "Sample running"
```

## arcs-sdk/samples/cpp/regex/sample.yaml
```yaml
tests:
  samples.cpp.regex:
    programmer: arcs
    runner: uart
    log_analyzer:
      type: "regex"
      pattern: "Regex Sample Completed"
```

## arcs-sdk/samples/cpp/simple_use/sample.yaml
```yaml
tests:
  samples.cpp.simple_use:
    programmer: arcs
    runner: uart
    log_analyzer:
      type: "regex"
      pattern: "Simple Use Completed"
```

## arcs-sdk/samples/drivers/aon_wdt/sample.yaml
```yaml
tests:
  samples.aon_timer:
    programmer: arcs
    runner: uart
    log_analyzer:
      type: "regex"
      pattern: "Aon_Wdt end"
```

## arcs-sdk/samples/drivers/devices/lisa_adc/read_basic/sample.yaml
```yaml
tests:
  samples.lisa_adc.read_basic:
    programmer: arcs
    runner: uart
    log_analyzer:
      type: "regex"
      pattern: "Channel 2: raw=0x[0-9a-fA-F]{4} \\(\\s*\\d+\\), voltage=\\s*\\d+ mV"
```

## arcs-sdk/samples/drivers/devices/lisa_i2s/master_rx/sample.yaml
```yaml
tests:
  samples.drivers.lisa_i2s.master_rx:
    programmer: arcs
    runner: uart
    log_analyzer:
      type: "regex"
      pattern: "LISA I2S Master RX Example"
```

## arcs-sdk/samples/drivers/devices/lisa_i2s/slave_rx/sample.yaml
```yaml
tests:
  samples.drivers.lisa_i2s.slave_rx:
    programmer: arcs
    runner: uart
    log_analyzer:
      type: "regex"
      pattern: "LISA I2S SLAVE RX Example"
```

## arcs-sdk/samples/drivers/devices/lisa_i2s/slave_tx/sample.yaml
```yaml
tests:
  samples.drivers.lisa_i2s.slave_tx:
    programmer: arcs
    runner: uart
    log_analyzer:
      type: "regex"
      pattern: "LISA I2S SLAVE TX Example"
```

## arcs-sdk/samples/drivers/devices/lisa_pwm/output_basic/sample.yaml
```yaml
tests:
  samples.lisa_pwm_output:
    programmer: arcs
    runner: uart
    log_analyzer:
      type: "regex"
      pattern: "PWM enabled: 5kHz, 50% duty cycle"
```

## arcs-sdk/samples/drivers/devices/lisa_rtc/alarm/sample.yaml
```yaml
tests:
  samples.lisa_rtc_alarm:
    programmer: arcs
    runner: uart
    log_analyzer:
      type: "regex"
      pattern: "Alarm triggered!"
```

## arcs-sdk/samples/drivers/devices/lisa_uart/poll_in/sample.yaml
```yaml
tests:
  samples.lisa_uart.poll_in:
    programmer: arcs
    runner: uart
    log_analyzer:
      type: "regex"
      pattern: "Please send data via serial tool."
```

## arcs-sdk/samples/drivers/devices/lisa_uart/poll_out/sample.yaml
```yaml
tests:
  samples.lisa_uart.poll_out:
    programmer: arcs
    runner: uart
    log_analyzer:
      type: "regex"
      pattern: "Sending message"
```

## arcs-sdk/samples/drivers/devices/lisa_uart/recv_sync_dma/sample.yaml
```yaml
tests:
  samples.lisa_uart_recv_sync_dma:
    programmer: arcs
    runner: uart
    log_analyzer:
      type: "regex"
      pattern: "Please send data via serial port"
```

## arcs-sdk/samples/drivers/devices/lisa_uart/send_async_int/sample.yaml
```yaml
tests:
  samples.lisa_uart.send_async_int:
    programmer: arcs
    runner: uart
    log_analyzer:
      type: "regex"
      pattern: "UART ready, start sending..."
```

## arcs-sdk/samples/drivers/devices/lisa_wdt/basic/sample.yaml
```yaml
tests:
  samples.lisa_wdt_basic:
    programmer: arcs
    runner: uart
    log_analyzer:
      type: "regex"
      pattern: "WDT started"
```

## arcs-sdk/samples/drivers/dma/sample.yaml
```yaml
tests:
  samples.dma:
    programmer: arcs
    runner: uart
    log_analyzer:
      type: "regex"
      pattern: "Memory compare success"
```
