## arcs-sdk/drivers/lisa_touch/Kconfig.arcs.st77921
```kconfig
# LISA Touch Driver Configuration - ST77921
#
# Copyright (c) 2025, LISTENAI
# SPDX-License-Identifier: Apache-2.0

config LISA_TOUCH_ARCS_ST77921
    bool "Enable LISA Touch ARCS ST77921 support"
    default n
    help
        Enable LISA Touch ARCS ST77921 touch chip support.
        
        ST77921 Features:
        - I2C Address: 0x55 (7-bit)
        - Register: 0x0010/0x0014 (16-bit, big-endian)
        - Resolution: 480x480
        - Single touch point
        - Interrupt trigger: Falling edge
        - Reset sequence: High->Low->High (10ms-10ms-300ms)

if LISA_TOUCH_ARCS_ST77921

    config LISA_TOUCH_ARCS_ST77921_READ_TASK_PRIORITY
        int "ST77921 interrupt mode read task priority"
        default 2
        range 1 10
        help
            Set the priority of the ST77921 touch driver's internal read task.
            
            This task is created when interrupt mode is enabled and is responsible
            for reading I2C data from the touch chip after receiving a GPIO interrupt.
            
            Priority range: 1-10 (higher number = higher priority)
            Default: 2 (tskIDLE_PRIORITY + 2)
            
            Note:
            - Higher priority ensures faster response to touch events
            - Should be higher than idle task (1) but lower than critical system tasks
            - Recommended range: 2-5 for most applications

endif # LISA_TOUCH_ARCS_ST77921
```

## arcs-sdk/drivers/lisa_uart/Kconfig
```kconfig
# LISA UART Driver Configuration
#
# Copyright (c) 2025, LISTENAI
# SPDX-License-Identifier: Apache-2.0

menuconfig LISA_UART_DEVICE
	bool "Enable LISA UART Driver"
	depends on LISA_DEVICE
	help
			Enable LISA UART device driver based on lisa_device framework.
			Provides asynchronous and synchronous UART communication interfaces.

			This driver wraps the HAL UART functions and provides a unified
			device interface for UART operations including read, write, and
			event-driven callbacks.

if LISA_UART_DEVICE

	config LISA_UART_ASYNC_API
		bool "Enable LISA UART Asynchronous API"

	config LISA_UART0
		bool "Enable LISA UART0"

	config LISA_UART1
		bool "Enable LISA UART1"

	config LISA_UART2
		bool "Enable LISA UART2"

endif
```

## arcs-sdk/drivers/lisa_wdt/Kconfig
```kconfig
# LISA WDT Driver Configuration
#
# Copyright (c) 2025, LISTENAI
# SPDX-License-Identifier: Apache-2.0

menuconfig LISA_WDT
	bool "Enable LISA WDT Driver"
	default n
	depends on LISA_DEVICE
	help
	  Enable LISA Watchdog Timer device driver based on lisa_device framework.
	  Provides unified interface for various watchdog timer controllers.

if LISA_WDT

endif # LISA_WDT
```

## arcs-sdk/labs/lnn/common/arcs/dma_cpy/Kconfig
```kconfig
# SPDX-License-Identifier: Apache-2.0

config ALGO_DMA_COPY_USE_DMA
	bool "Use DMA for algorithm copy"
	default y
	help
	  Enable the ARCS DMA copy backend for algorithm data movement.
	  Disable this option to use the memcpy fallback without DMA.

config ALGO_DMA_CHANNEL_PERSISTENT
	bool "Use persistent DMA channel for algorithm"
	depends on ALGO_DMA_COPY_USE_DMA
	default y
	help
	  Select DMA channel allocation strategy for algorithm:
	  - Enabled: Allocate and hold DMA channel persistently (dma_cpy_arcs_ch_persistent.c)
	  - Disabled: Allocate and release DMA channel dynamically (dma_cpy_arcs.c)

	  Persistent mode offers better performance but occupies resources continuously.
	  Dynamic mode is more flexible but has allocation overhead.
```

## arcs-sdk/labs/lnn/common/arcs/libraries/thinker/Kconfig
```kconfig
# SPDX-License-Identifier: Apache-2.0

config THINKER_LIB
	bool "Enable thinker lib"
	help
	  Enable thinker lib
```

## arcs-sdk/modules/4g_module/Kconfig
```kconfig
config 4G_MODULE
	bool "Enable 4G Module Support"
	default n
	help
	  Enable support for ML307 4G module.
	  This includes AT commands, TCP/UDP communication,
	  and modem control functionality.
```

## arcs-sdk/modules/EasyFlash/Kconfig
```kconfig
menuconfig MODULE_EASYFLASH
    prompt "EasyFlash"
    bool "EasyFlash"
    default n

if MODULE_EASYFLASH

config LS_EF_USING_ENV
    bool "EasyFlash using ENV"
    default y
    help
        EasyFlash using ENV

config LS_EF_ENV_VER_NUM
    int "EasyFlash env version number"
    default 0
    depends on LS_EF_USING_ENV
    help
        EasyFlash env version number

config LS_EF_ENV_NAME_MAX
    int "EasyFlash env name max"
    default 32
    depends on LS_EF_USING_ENV
    help
        EasyFlash env name max

config LS_EF_ERASE_MIN_SIZE
    int "EasyFlash erase min size"
    default 4096
    help
        EasyFlash erase min size

config LS_EF_WRITE_GRAN
    int "EasyFlash write granularity"
    default 1
    help
        EasyFlash write granularity

config LS_EF_READ_BUF_SIZE
    int "EasyFlash read buffer size"
    default 32
    help
        EasyFlash read buffer size

config LS_EF_START_ADDR
    hex "EasyFlash start address"
    default 0x30F00000
    help
        EasyFlash start address

config LS_EF_ENV_AREA_SIZE
    int "EasyFlash env area size"
    default 8192
    help
        EasyFlash env area size
    depends on LS_EF_USING_ENV

endif
```

## arcs-sdk/modules/FreeRTOS-CPP11/Kconfig
```kconfig
menu "FreeRTOS-CPP11"

config FREERTOS_CPP11
    bool "Enable FreeRTOS-CPP11"
    default n

config FREERTOS_CPP11_FORCE_USE_EXRAM
    bool "Force use exram for memory management (C++ new/delete)"
    default y
    depends on FREERTOS_CPP11

endmenu
```

## arcs-sdk/modules/Kconfig
```kconfig
# ARCS SDK Third-party Modules Configuration

menu "Third-party Modules"

# Operating System
rsource "freertos/Kconfig"
rsource "FreeRTOS-CPP11/Kconfig"
rsource "rtos_al/Kconfig"

# Audio/Media Processing
rsource "aacdec/Kconfig"
rsource "libmad/Kconfig"
rsource "mp3dec/Kconfig"
rsource "opusdec/Kconfig"
rsource "speexdsp/Kconfig"
rsource "resample/Kconfig"
rsource "lisa_player/Kconfig"
rsource "libid3tag/Kconfig"

# Graphics and UI
rsource "lvgl/Kconfig"
rsource "lvgl8/Kconfig"
rsource "freetype/Kconfig"
rsource "libpng/Kconfig"
rsource "giflib/Kconfig"
rsource "ijg/Kconfig"
rsource "libico/Kconfig"
rsource "flexlayout/Kconfig"

# File System and Storage
rsource "fs/Kconfig"
rsource "EasyFlash/Kconfig"
rsource "csk_sqlite3/Kconfig"

# Network and Communication
rsource "libcurl/Kconfig"
rsource "httpclient/Kconfig"
rsource "http_ssl/Kconfig"
rsource "coreHTTP/Kconfig"
rsource "coresntp/Kconfig"
rsource "nopoll/Kconfig"
rsource "cpr/Kconfig"

# Security and Encryption
rsource "mbedtls/Kconfig"

# Data Processing
rsource "cjson/Kconfig"
rsource "libxml2/Kconfig"
rsource "zlib/Kconfig"
rsource "crc32/Kconfig"
rsource "uchardet/Kconfig"
rsource "collections-c/Kconfig"

# Memory Management
rsource "heap/Kconfig"
rsource "mempool/Kconfig"

# USB Support
rsource "tinyusb/Kconfig"

# WiFi and Network Management
rsource "wifi_manager/Kconfig"
rsource "mac_manager/Kconfig"

# Logging and Shell
rsource "easylogger/Kconfig"
rsource "letter-shell/Kconfig"
rsource "lshell/Kconfig"

# Testing Frameworks
rsource "unity/Kconfig"
rsource "cpputest/Kconfig"
rsource "googletest/Kconfig"
rsource "fff/Kconfig"

# Custom Modules
rsource "ltlsf/Kconfig"

endmenu
```

## arcs-sdk/modules/aacdec/Kconfig
```kconfig
menu "aac decoder"

config SDK_MODULE_AAC_DECODER
    bool "Enable aac decoder"
    default n

endmenu
```

## arcs-sdk/modules/cAT/Kconfig
```kconfig
# cAT - AT Command Parser Library Configuration

menu "cAT AT Command Parser"

    menuconfig SDK_MODULE_CAT
        bool "cAT AT command parser support"
        default n
        help
          Enable cAT - a lightweight, portable AT command parser library.
          cAT provides a flexible framework for implementing AT command
          interfaces commonly used in modems and embedded devices.

          Features:
          - Standard AT command format support (AT+CMD, AT+CMD?, AT+CMD=?, AT+CMD=<args>)
          - Variable binding with automatic parsing
          - Unsolicited event support
          - Thread-safe with optional mutex interface
          - Minimal memory footprint

    if SDK_MODULE_CAT

        config SDK_MODULE_CAT_UNSOLICITED_BUFFER_SIZE
            int "Unsolicited command buffer size"
            default 4
            help
              Size of the buffer for unsolicited AT command events.
              Increase this value if you need to queue multiple unsolicited events.

        config SDK_MODULE_CAT_TASK_STACK_SIZE
            int "AT parser task stack size"
            default 2048
            help
                Stack size for the AT command parser task.

        config SDK_MODULE_CAT_TASK_PRIORITY
            int "AT parser task priority"
            default 10
            help
                Priority for the AT command parser task.

        config SDK_MODULE_CAT_UART_RX_TASK_STACK_SIZE
            int "cAT UART RX task stack size"
            default 1024
            help
                Stack size for the UART RX task used by the cAT UART adapter (bytes).

        config SDK_MODULE_CAT_UART_RX_TASK_PRIORITY
            int "cAT UART RX task priority"
            default 10
            help
                Priority for the UART RX task used by the cAT UART adapter.

        config SDK_MODULE_CAT_UART_PROC_TASK_STACK_SIZE
            int "cAT UART process task stack size"
            default 2048
            help
                Stack size for the UART processing task used by the cAT UART adapter (bytes).

        config SDK_MODULE_CAT_UART_PROC_TASK_PRIORITY
            int "cAT UART process task priority"
            default 10
            help
                Priority for the UART processing task used by the cAT UART adapter.

    endif # SDK_MODULE_CAT

endmenu
```

## arcs-sdk/modules/cjson/Kconfig
```kconfig
config CJSON
    bool "CJSON"
    default n

config CJSON_CUSTOM_INCLUDE
    bool "CJSON custom include"
    default n

config CJSON_CUSTOM_INCLUDE_PATH
    string "CJSON custom include path"
    default ""
```

## arcs-sdk/modules/collections-c/Kconfig
```kconfig
menu "collections-c configuration"

config SDK_MODULE_COLLECTIONS_C
    bool "collections-c support"
    default n

if SDK_MODULE_COLLECTIONS_C

config SDK_MODULE_COLLECTIONS_C_WITHOUT_PREFIX
    bool "collections-c prefix"
    default n

config SDK_MODULE_COLLECTIONS_C_CUSTOM_INCLUDE
    bool "collections-c custom include"
    default n

config SDK_MODULE_COLLECTIONS_C_LIST_COMPILE_EN
    bool "collections-c compile list"
    default y

config SDK_MODULE_COLLECTIONS_C_CUSTOM_INCLUDE_PATH
    string "collections-c custom include path"
    default ""
    depends on SDK_MODULE_COLLECTIONS_C_CUSTOM_INCLUDE

endif

endmenu
```

## arcs-sdk/modules/coreHTTP/Kconfig
```kconfig
menu "coreHttp"

config SDK_MODULE_COREHTTP
    bool "enable sdk module core http"
    default n

endmenu
```

## arcs-sdk/modules/coreMQTT-Agent/Kconfig
```kconfig
menu "coreMQTT-Agent"

config SDK_MODULE_COREMQTT_AGENT
    bool "enable sdk module core mqtt agent"
    default n
    depends on SDK_MODULE_COREMQTT
    
endmenu
```

## arcs-sdk/modules/coreMQTT/Kconfig
```kconfig
menu "coreMQTT"

config SDK_MODULE_COREMQTT
    bool "enable sdk module core mqtt"
    default n

endmenu
```

## arcs-sdk/modules/coresntp/Kconfig
```kconfig
menu "SNTP C Client Configuration"

    config MODULE_CORESNTP
        bool "coresntp support"
        default n

endmenu
```

## arcs-sdk/modules/cpr/Kconfig
```kconfig
config LIB_CPR
    bool "lib cpr"
    default n
    select SDK_MODULE_CURL if LIB_CPR
    help
        Enable lib cpr (A http requests library based on curl)
```

## arcs-sdk/modules/crc32/Kconfig
```kconfig
menuconfig MODULE_CRC32
    bool "CRC32 Module"
    default y
    help
        CRC32(Cyclic Redundancy Check 32) Module
    if MODULE_CRC32
        config CRC32_DEFAULT_POLYNOM
            hex "CRC32 Generator Polynom"
            default 0x04C11DB7

        config CRC32_USE_STATIC_TABLE
            bool "Use Static Table"
            default y
            help
                say y to use static table in ROM
                say n to use dynmic table in RAM, and calc in init
    endif
```

## arcs-sdk/modules/csk_sqlite3/Kconfig
```kconfig
# SPDX-License-Identifier: BSD-3-Clause
menuconfig CSK_SQLITE
    bool "CSK SQLite"

if CSK_SQLITE

choice CSK_SQLITE_SDK
    prompt "Select SDK Type"
    default CSK_SQLITE_SDK_CSK6

config CSK_SQLITE_SDK_CSK6
    bool "CSK6 SDK"
    help
      Use CSK6 SDK for SQLite implementation

config CSK_SQLITE_SDK_ARCS
    bool "ARCS SDK"
    help
      Use ARCS SDK for SQLite implementation

endchoice

config CSK_SQLITE_CSK_MEM
    bool "CSK SQLite CSK Memory"
    default y if CSK_SQLITE_SDK_CSK6

if CSK_SQLITE_SDK_ARCS
    config CSK_SQLITE_ARCS_MEM_RAM
        bool "CSK SQLite ARCS RAM Memory"
        default n
endif

endif
```

## arcs-sdk/modules/easylogger/Kconfig
```kconfig
menu "easylogger configuration"

config SDK_MODULE_EASYLOGGER
    bool "easylogger support"
    default n

if SDK_MODULE_EASYLOGGER
config EASYLOGGER_LOG_MODE_ASYNC
    bool "Enable asynchronous logging"
    default n
    help
        Enable this option to allow asynchronous logging

config EASYLOGGER_ASYNC_BUF_SIZE
    int "asynchronous buffer size"
    default 10240
    depends on EASYLOGGER_LOG_MODE_ASYNC

config EASYLOGGER_LOG_ASYNC_TASK_STACK_SIZE
    int "asynchronous task stack size"
    default 512
    depends on EASYLOGGER_LOG_MODE_ASYNC

config EASYLOGGER_LOG_ASYNC_TASK_PRIORITY
    int "asynchronous task priority"
    default 1
    depends on EASYLOGGER_LOG_MODE_ASYNC

config EASYLOGGER_USE_POSIX_TIME
    bool "Use POSIX time"
    default n

config EASYLOGGER_LINE_BUF_SIZE
    int "line buffer size"
    default 1024

config EASYLOGGER_LOG_LEVEL_ASSERT
    bool "assert"
    default n

config EASYLOGGER_LOG_LEVEL_ERROR
    bool "error"
    default n

config EASYLOGGER_LOG_LEVEL_WARN
    bool "warning"
    default n

config EASYLOGGER_LOG_LEVEL_INFO
    bool "info"
    default n

config EASYLOGGER_LOG_LEVEL_DEBUG
    bool "debug"
    default n

config EASYLOGGER_LOG_LEVEL_VERBOSE
    bool "verbose"
    default n


endif

endmenu
```

## arcs-sdk/modules/flexlayout/Kconfig
```kconfig
menu "flexlayout configuration"

    config SDK_MODULE_FLEXLAYOUT
        bool "flexlayout support"
        default n

endmenu
```

## arcs-sdk/modules/freetype/Kconfig
```kconfig
menu "freetype configuration"

    config SDK_MODULE_FREETYPE
        bool "freetype support"
        default n

endmenu
```
