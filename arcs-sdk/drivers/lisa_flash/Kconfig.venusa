## arcs-sdk/drivers/lisa_sdmmc/Kconfig
```kconfig
# LISA SDMMC Driver Configuration
#
# Copyright (c) 2025, LISTENAI
# SPDX-License-Identifier: Apache-2.0

menuconfig LISA_SDMMC_DEVICE
	bool "Enable LISA SDMMC Driver"
	depends on LISA_DEVICE
	help
			Enable LISA SDMMC device driver based on lisa_device framework.
			Provides SD/MMC storage access interfaces.

			This driver wraps the HAL SDC functions and provides a unified
			device interface for sdmmc operations including read, write sectors,
			and sdmmc information queries.

if LISA_SDMMC_DEVICE

config LISA_SDMMC_INIT_PRIORITY
	int "SDMMC device initialization priority"
	default 60
	help
			Initialization priority for SDMMC device.
			Lower values mean earlier initialization.

config LISA_SDMMC_SCAN_TIMEOUT_MS
	int "Card scan timeout (ms)"
	default 1000 if BOOT_ADB
	default 3000
	help
			Timeout in milliseconds for SD card scan operation.
			Boot ADB recovery uses a shorter default so no-card boards
			fail SDMMC/FS preparation quickly and keep ADB available.
			Increase this value if card detection is unreliable.

config LISA_SDMMC_ACCESS_BUFFER_ALIGN_SIZE
	int "DMA buffer alignment size"
	default 32
	help
			Buffer alignment requirement for DMA operations.
			Buffers must be aligned to this boundary for direct DMA access.
			Non-aligned buffers will use wrap buffer for transfer.

config LISA_SDMMC_ACCESS_WRAP_BUFFER_SIZE
	int "Wrap buffer size for non-aligned DMA"
	default 4096
	help
			Size of internal wrap buffer used for non-aligned DMA operations.
			Larger buffer improves performance for large transfers but uses
			more memory. Must be multiple of sector size (512 bytes).

config LISA_SDMMC_ACCESS_MAX_SECTORS
	int "Maximum sectors per hardware transfer"
	default 128
	range 1 4096
	help
			Limit each SD controller request to this many 512-byte sectors.
			The ARCS SDMA path is sensitive to very large requests; 128 sectors
			(64 KiB) keeps MSC transfers multi-block while avoiding long DMA
			transactions that are more likely to time out or need recovery.

config LISA_SDMMC_VENUSA_FORCE_3_3V
	bool "Force Venusa SDMMC 3.3V signaling"
	depends on SOC_VENUSA
	help
			Force legacy 3.3V signaling on Venusa. Disable this option to allow
			UHS-I 1.8V negotiation and SDR50 on capable cards and boards.

config LISA_SDMMC_VENUSA_BUS_WIDTH
	int "Venusa SDMMC bus width"
	depends on SOC_VENUSA
	default 4
	range 1 4
	help
			SD card bus width requested after card detection. Use 4 for normal
			4-bit SDIO operation.

config LISA_SDMMC_VENUSA_TARGET_SPEED
	int "Venusa SDMMC target speed mode"
	depends on SOC_VENUSA
	default 2
	range 0 4
	help
			Target speed mode: 0=SDR12, 1=SDR25, 2=SDR50, 3=SDR104, 4=DDR50.
			The Venusa SDIO host supports up to SDR50/100MHz for SD cards.

config LISA_SDMMC_VENUSA_SDMA_BOUNDARY_ORDER
	int "Venusa SDMMC SDMA boundary order"
	depends on SOC_VENUSA
	default 7
	range 0 7
	help
			SDMA boundary order used by the FTSDC021 HAL. Boundary bytes are
			1 << (order + 12); 7 selects 512 KiB.

endif
```

## arcs-sdk/drivers/lisa_spi/Kconfig
```kconfig
# LISA SPI Driver Configuration
#
# Copyright (c) 2025, LISTENAI
# SPDX-License-Identifier: Apache-2.0

menuconfig LISA_SPI_DEVICE
	bool "Enable LISA SPI Driver"
	default n
	depends on LISA_DEVICE
	help
	  Enable LISA SPI device driver based on lisa_device framework.
	  Provides master and slave mode SPI communication interfaces.

	  This driver wraps the HAL SPI functions and provides a unified
	  device interface for SPI operations including read, write, and
	  full-duplex transfer.

if LISA_SPI_DEVICE

	config LISA_SPI0
		bool "Enable LISA SPI0"
		default n

	config LISA_SPI1
		bool "Enable LISA SPI1"
		default n

	config LISA_SPI2
		bool "Enable LISA SPI2"
		default n
endif
```

## arcs-sdk/drivers/lisa_touch/Kconfig
```kconfig
# LISA Touch Driver Configuration
#
# Copyright (c) 2025, LISTENAI
# SPDX-License-Identifier: Apache-2.0

menuconfig LISA_TOUCH_DEVICE
	bool "Enable LISA Touch Driver"
	default n
	depends on LISA_DEVICE
	help
	  Enable LISA touch device driver based on lisa_device framework.
	  Provides touch screen interfaces for reading touch events,
	  touch coordinates, and gesture recognition.

	  This driver wraps various touch chip drivers and provides a unified
	  device interface for touch operations.

if LISA_TOUCH_DEVICE

rsource "Kconfig.arcs.cst328"
rsource "Kconfig.arcs.axs15231b"
rsource "Kconfig.arcs.ft5336"
rsource "Kconfig.arcs.cst816d"
rsource "Kconfig.arcs.st77921"
rsource "Kconfig.arcs.bl6133"

endif # LISA_TOUCH_DEVICE
```

## arcs-sdk/drivers/lisa_touch/Kconfig.arcs.axs15231b
```kconfig
# LISA Touch Driver Configuration - AXS15231B
#
# Copyright (c) 2025, LISTENAI
# SPDX-License-Identifier: Apache-2.0

config LISA_TOUCH_ARCS_AXS15231B
    bool "Enable LISA Touch ARCS AXS15231B support"
    default n
    help
        Enable LISA Touch ARCS AXS15231B touch chip support.
        
        AXS15231B Features:
        - I2C Address: 0x3B (7-bit)
        - Register: Command-based (13-byte command)
        - Resolution: 390x390
        - Single touch point
        - Interrupt trigger: Falling edge
        - Reset sequence: High->Low->High (10ms-10ms-300ms)

if LISA_TOUCH_ARCS_AXS15231B

    config LISA_TOUCH_ARCS_AXS15231B_READ_TASK_PRIORITY
        int "AXS15231B interrupt mode read task priority"
        default 2
        range 1 10
        help
            Set the priority of the AXS15231B touch driver's internal read task.
            
            This task is created when interrupt mode is enabled and is responsible
            for reading I2C data from the touch chip after receiving a GPIO interrupt.
            
            Priority range: 1-10 (higher number = higher priority)
            Default: 2 (tskIDLE_PRIORITY + 2)
            
            Note:
            - Higher priority ensures faster response to touch events
            - Should be higher than idle task (1) but lower than critical system tasks
            - Recommended range: 2-5 for most applications

endif # LISA_TOUCH_ARCS_AXS15231B
```

## arcs-sdk/drivers/lisa_touch/Kconfig.arcs.bl6133
```kconfig
# LISA Touch Driver Configuration - BL6133
#
# Copyright (c) 2025, LISTENAI
# SPDX-License-Identifier: Apache-2.0

config LISA_TOUCH_ARCS_BL6133
    bool "Enable LISA Touch ARCS BL6133 support"
    default n
    help
        Enable LISA Touch ARCS BL6133 touch chip support.
        
        BL6133 Features:
        - I2C Address: 0x2C (7-bit)
        - Register: 0x01 (8-bit)
        - Resolution: 320x386
        - Single touch point
        - Interrupt trigger: Falling edge
        - Reset sequence: High->Low->High (10ms-100ms-300ms)

if LISA_TOUCH_ARCS_BL6133

    config LISA_TOUCH_ARCS_BL6133_READ_TASK_PRIORITY
        int "BL6133 interrupt mode read task priority"
        default 2
        range 1 10
        help
            Set the priority of the BL6133 touch driver's internal read task.
            
            This task is created when interrupt mode is enabled and is responsible
            for reading I2C data from the touch chip after receiving a GPIO interrupt.
            
            Priority range: 1-10 (higher number = higher priority)
            Default: 2 (tskIDLE_PRIORITY + 2)
            
            Note:
            - Higher priority ensures faster response to touch events
            - Should be higher than idle task (1) but lower than critical system tasks
            - Recommended range: 2-5 for most applications

endif # LISA_TOUCH_ARCS_BL6133
```

## arcs-sdk/drivers/lisa_touch/Kconfig.arcs.chsc6540
```kconfig
# LISA Touch Driver Configuration - CHSC6540
#
# Copyright (c) 2025, LISTENAI
# SPDX-License-Identifier: Apache-2.0

config LISA_TOUCH_ARCS_CHSC6540
	bool "Enable LISA Touch ARCS CHSC6540 support"
	help
		Enable LISA Touch ARCS CHSC6540 touch chip support.

		CHSC6540 Features:
		- I2C Address: 0x2E (7-bit)
		- Register: 0x00 (8-bit)
		- Resolution: configurable, default 240x320
		- Single touch point
		- Interrupt trigger: Falling edge

if LISA_TOUCH_ARCS_CHSC6540

	config LISA_TOUCH_ARCS_CHSC6540_MAX_X
		int "CHSC6540 max X coordinate"
		default 240
		help
			Set CHSC6540 touch X coordinate range.

	config LISA_TOUCH_ARCS_CHSC6540_MAX_Y
		int "CHSC6540 max Y coordinate"
		default 320
		help
			Set CHSC6540 touch Y coordinate range.

	config LISA_TOUCH_ARCS_CHSC6540_READ_TASK_PRIORITY
		int "CHSC6540 interrupt mode read task priority"
		default 2
		range 1 10
		help
			Set the priority of the CHSC6540 touch driver's internal read task.

			This task is created when interrupt mode is enabled and is responsible
			for reading I2C data from the touch chip after receiving a GPIO interrupt.

endif # LISA_TOUCH_ARCS_CHSC6540
```

## arcs-sdk/drivers/lisa_touch/Kconfig.arcs.cst328
```kconfig
# LISA Touch Driver Configuration - CST328
#
# Copyright (c) 2025, LISTENAI
# SPDX-License-Identifier: Apache-2.0

config LISA_TOUCH_ARCS_CST328
    bool "Enable LISA Touch ARCS CST328 support"
    default n
    help
        Enable LISA Touch ARCS CST328 touch chip support.
        
        CST328 Features:
        - I2C Address: 0x1D (7-bit)
        - Register: 0xD000 (16-bit, little-endian)
        - Resolution: 240x320
        - Single touch point
        - Interrupt trigger: Rising edge
        - Reset sequence: High->Low->High (10ms-10ms-200ms)

if LISA_TOUCH_ARCS_CST328

    config LISA_TOUCH_ARCS_CST328_READ_TASK_PRIORITY
        int "CST328 interrupt mode read task priority"
        default 2
        range 1 10
        help
            Set the priority of the CST328 touch driver's internal read task.
            
            This task is created when interrupt mode is enabled and is responsible
            for reading I2C data from the touch chip after receiving a GPIO interrupt.
            
            Priority range: 1-10 (higher number = higher priority)
            Default: 2 (tskIDLE_PRIORITY + 2)
            
            Note:
            - Higher priority ensures faster response to touch events
            - Should be higher than idle task (1) but lower than critical system tasks
            - Recommended range: 2-5 for most applications

endif # LISA_TOUCH_ARCS_CST328
```

## arcs-sdk/drivers/lisa_touch/Kconfig.arcs.cst816d
```kconfig
# LISA Touch Driver Configuration - CST816D
#
# Copyright (c) 2025, LISTENAI
# SPDX-License-Identifier: Apache-2.0

config LISA_TOUCH_ARCS_CST816D
    bool "Enable LISA Touch ARCS CST816D support"
    default n
    help
        Enable LISA Touch ARCS CST816D touch chip support.
        
        CST816D Features:
        - I2C Address: 0x15 (7-bit)
        - Register: 0xD000 (16-bit, little-endian)
        - Resolution: 240x240
        - Single touch point
        - Interrupt trigger: Falling edge
        - Reset sequence: High->Low->High (20ms-20ms-400ms)

if LISA_TOUCH_ARCS_CST816D

    config LISA_TOUCH_ARCS_CST816D_READ_TASK_PRIORITY
        int "CST816D interrupt mode read task priority"
        default 2
        range 1 10
        help
            Set the priority of the CST816D touch driver's internal read task.
            
            This task is created when interrupt mode is enabled and is responsible
            for reading I2C data from the touch chip after receiving a GPIO interrupt.
            
            Priority range: 1-10 (higher number = higher priority)
            Default: 2 (tskIDLE_PRIORITY + 2)
            
            Note:
            - Higher priority ensures faster response to touch events
            - Should be higher than idle task (1) but lower than critical system tasks
            - Recommended range: 2-5 for most applications

endif # LISA_TOUCH_ARCS_CST816D
```

## arcs-sdk/drivers/lisa_touch/Kconfig.arcs.ft5336
```kconfig
# LISA Touch Driver Configuration - FT5336
#
# Copyright (c) 2025, LISTENAI
# SPDX-License-Identifier: Apache-2.0

config LISA_TOUCH_ARCS_FT5336
    bool "Enable LISA Touch ARCS FT5336 support"
    default n
    help
        Enable LISA Touch ARCS FT5336 touch chip support.
        
        FT5336 Features:
        - I2C Address: 0x38 (7-bit)
        - Register: 0x02 (8-bit)
        - Resolution: 480x272
        - Single touch point
        - Interrupt trigger: Falling edge
        - Reset sequence: High->Low->High (10ms-10ms-300ms)

if LISA_TOUCH_ARCS_FT5336

    config LISA_TOUCH_ARCS_FT5336_READ_TASK_PRIORITY
        int "FT5336 interrupt mode read task priority"
        default 2
        range 1 10
        help
            Set the priority of the FT5336 touch driver's internal read task.
            
            This task is created when interrupt mode is enabled and is responsible
            for reading I2C data from the touch chip after receiving a GPIO interrupt.
            
            Priority range: 1-10 (higher number = higher priority)
            Default: 2 (tskIDLE_PRIORITY + 2)
            
            Note:
            - Higher priority ensures faster response to touch events
            - Should be higher than idle task (1) but lower than critical system tasks
            - Recommended range: 2-5 for most applications

endif # LISA_TOUCH_ARCS_FT5336
```
