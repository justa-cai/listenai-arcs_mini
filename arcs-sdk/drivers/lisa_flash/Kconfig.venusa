## arcs-sdk/drivers/lisa_flash/Kconfig.venusa
```kconfig
# Copyright (c) 2026, LISTENAI
# SPDX-License-Identifier: Apache-2.0

config LISA_FLASH_VENUSA
	bool "Enable LISA Flash VENUSA support"
	depends on SOC_VENUSA
	help
		Enable LISA Flash support on VENUSA platforms.

if LISA_FLASH_VENUSA

config LISA_FLASH_VENUSA_CONTROLLER_BASE_ADDR
	hex "Flash controller base address"
	default 0x44200000
	help
		Base address of the VENUSA Flash controller.

config LISA_FLASH_VENUSA_DELAY_LINE_BASE_ADDR
	hex "Flash delay line base address"
	default 0x44300000
	help
		Base address of the VENUSA Flash delay line control register block.

config LISA_FLASH_VENUSA_DISABLE_DELAY_LINE
	bool "Disable Flash delay line during init"
	default y
	help
		Disable Flash delay line before initializing the SPI Flash controller.

config LISA_FLASH_VENUSA_ERASE_SECTOR_SIZE
	int "Flash erase sector size"
	default 4096
	help
		Erase sector size for Flash operations.

config LISA_FLASH_VENUSA_WRITE_BLOCK_SIZE
	int "Flash write min block size"
	default 1
	help
		Write min block size for Flash operations.

config LISA_FLASH_VENUSA_DATA_WIDTH
	int "Flash data width (1, 2, or 4)"
	default 4
	range 1 4
	help
		Data width for Flash: 1 (standard SPI), 2 (dual SPI), or 4 (quad SPI).

config LISA_FLASH_VENUSA_SCLK_DIV
	int "Flash SPI clock divider"
	default 255
	help
		SPI clock divider for Flash. 255 means use the SPI clock source directly.

config LISA_FLASH_VENUSA_ADDR_BYTES
	int "Flash address bytes (3 or 4)"
	default 3
	range 3 4
	help
		Number of address bytes: 3 for Flash <= 16MB, 4 for Flash > 16MB.

config LISA_FLASH_VENUSA_ADDR_AUTO
	bool "Auto-detect Flash address bytes"
	help
		Read SFDP during init and auto-detect 3-byte or 4-byte address mode.

config LISA_FLASH_VENUSA_WRITE_PROTECT_ENABLE
	bool "Enable Flash write protection"
	default y
	help
		Re-enable Flash write protection after write and erase operations.

config LISA_FLASH_VENUSA_DISABLE_INTERRUPTS
	bool "Disable interrupts during Flash operations"
	default y
	help
		Disable system interrupts during low-level Flash operations.

config LISA_FLASH_VENUSA_TIMEOUT
	int "Flash operation timeout"
	default 1800000
	help
		Retry count used by the VENUSA SPI Flash HAL.

config LISA_FLASH_VENUSA_FLASH_PHYS_ADDR
	hex "Physical address of Flash memory"
	default MEM_FLASH_BASE
	help
		Physical address where the Flash memory is mapped.

config LISA_FLASH_VENUSA_FLASH_SIZE
	hex "Flash memory size"
	default MEM_FLASH_SIZE
	help
		Maximum Flash address space exposed by this LISA Flash device.

endif
```

## arcs-sdk/drivers/lisa_gpio/Kconfig
```kconfig
# LISA GPIO Driver Configuration
#
# Copyright (c) 2025, LISTENAI
# SPDX-License-Identifier: Apache-2.0

menuconfig LISA_GPIO_DEVICE
	bool "Enable LISA GPIO Driver"
	default n
	depends on LISA_DEVICE
	help
	  Enable LISA GPIO device driver based on lisa_device framework.
	  Provides simple configuration and output interfaces for GPIO pins.

	  This driver wraps the HAL GPIO functions and provides a unified
	  device interface for GPIO operations.

if LISA_GPIO_DEVICE

config LISA_GPIOA
	bool "Enable LISA GPIO Device PA"
	default n

config LISA_GPIOB
	bool "Enable LISA GPIO Device PB"
	default n

endif # LISA_GPIO_DEVICE
```

## arcs-sdk/drivers/lisa_hwtimer/Kconfig
```kconfig
# LISA Hardware Timer Driver Configuration
#
# Copyright (c) 2025, LISTENAI
# SPDX-License-Identifier: Apache-2.0

menuconfig LISA_HWTIMER_DEVICE
	bool "Enable LISA Hardware Timer Driver"
	depends on LISA_DEVICE
	help
			Enable LISA hardware timer device driver based on lisa_device framework.
			Provides hardware timer interfaces for oneshot and periodic timing,
			timeout callbacks, and timer value reading.

			This driver wraps the HAL timer functions and provides a unified
			device interface for hardware timer operations.

if LISA_HWTIMER_DEVICE

config LISA_HWTIMER_DUAL_TIMER
	bool
	help
		Internal platform-neutral enable selected by platform Dual Timer options.

config LISA_HWTIMER_AON_TIMER
	bool
	help
		Internal platform-neutral enable selected by platform AON Timer options.

config LISA_HWTIMER_GPT_TIMER
	bool
	help
		Internal platform-neutral enable selected by platform GPT Timer options.

rsource "Kconfig.arcs.dual_timer"
rsource "Kconfig.arcs.aon_timer"
rsource "Kconfig.arcs.gpt_timer"
rsource "Kconfig.venusa.dual_timer"
rsource "Kconfig.venusa.aon_timer"
rsource "Kconfig.venusa.gpt_timer"

endif # LISA_HWTIMER_DEVICE
```

## arcs-sdk/drivers/lisa_hwtimer/Kconfig.arcs.aon_timer
```kconfig
# LISA Hardware Timer Driver Configuration
#
# Copyright (c) 2025, LISTENAI
# SPDX-License-Identifier: Apache-2.0

config LISA_HWTIMER_ARCS_AON_TIMER
	bool "Enable LISA Hardware Timer ARCS AON Timer support"
	depends on SOC_ARCS
	select LISA_HWTIMER_AON_TIMER
	help
		Enable LISA Hardware Timer ARCS AON Timer support.

if LISA_HWTIMER_AON_TIMER && SOC_ARCS

choice
	prompt "ARCS AON Timer Clock Source"
	default LISA_HWTIMER_ARCS_AON_TIMER_CLK_RC32K
	help
		Select the clock source for AON Timer.
		internal RC oscillator: internal RC oscillator
		external crystal oscillator: external crystal oscillator

config LISA_HWTIMER_ARCS_AON_TIMER_CLK_RC32K
	bool "internal RC oscillator"
	help
		Use internal RC oscillator as the clock source for AON Timer. Internal RC clock source has larger error margins.

config LISA_HWTIMER_ARCS_AON_TIMER_CLK_XO32K
	bool "external crystal oscillator"
	help
		Use external crystal oscillator as the clock source for AON Timer. Requires external 32K crystal oscillator.

endchoice

endif # LISA_HWTIMER_AON_TIMER && SOC_ARCS
```

## arcs-sdk/drivers/lisa_hwtimer/Kconfig.arcs.dual_timer
```kconfig
# LISA Hardware Timer Driver Configuration
#
# Copyright (c) 2025, LISTENAI
# SPDX-License-Identifier: Apache-2.0

config LISA_HWTIMER_ARCS_DUAL_TIMER
	bool "Enable LISA Hardware Timer ARCS Dual Timer support"
	depends on SOC_ARCS
	select LISA_HWTIMER_DUAL_TIMER
	help
		Enable LISA Hardware Timer ARCS Dual Timer support.

if LISA_HWTIMER_DUAL_TIMER && SOC_ARCS

endif # LISA_HWTIMER_DUAL_TIMER && SOC_ARCS
```

## arcs-sdk/drivers/lisa_hwtimer/Kconfig.arcs.gpt_timer
```kconfig
# LISA Hardware Timer Driver Configuration
#
# Copyright (c) 2025, LISTENAI
# SPDX-License-Identifier: Apache-2.0

config LISA_HWTIMER_ARCS_GPT_TIMER
	bool "Enable LISA Hardware Timer ARCS GPT Timer support"
	depends on SOC_ARCS
	select LISA_HWTIMER_GPT_TIMER
	help
		Enable LISA Hardware Timer ARCS GPT Timer support.

if LISA_HWTIMER_GPT_TIMER && SOC_ARCS

endif # LISA_HWTIMER_GPT_TIMER && SOC_ARCS
```

## arcs-sdk/drivers/lisa_hwtimer/Kconfig.venusa.aon_timer
```kconfig
# LISA Hardware Timer Driver Configuration
#
# Copyright (c) 2026, LISTENAI
# SPDX-License-Identifier: Apache-2.0

config LISA_HWTIMER_VENUSA_AON_TIMER
	bool "Enable LISA Hardware Timer Venusa AON Timer support"
	depends on SOC_VENUSA
	select LISA_HWTIMER_AON_TIMER
	help
		Compatibility option for Venusa AON Timer configurations.

if LISA_HWTIMER_AON_TIMER && SOC_VENUSA

choice
	prompt "Venusa AON Timer Clock Source"
	default LISA_HWTIMER_VENUSA_AON_TIMER_CLK_RC32K
	help
		Select the clock source for Venusa AON Timer.

config LISA_HWTIMER_VENUSA_AON_TIMER_CLK_RC32K
	bool "Venusa internal RC32K oscillator"
	help
		Use internal RC32K oscillator as the clock source for Venusa AON Timer.

config LISA_HWTIMER_VENUSA_AON_TIMER_CLK_XO24M_DIV32K
	bool "Venusa external XO24M divided to 32K"
	help
		Use external 24MHz crystal divided to 32K domain as the clock source for Venusa AON Timer.

config LISA_HWTIMER_VENUSA_AON_TIMER_CLK_RC24M_DIV32K
	bool "Venusa internal RC24M divided to 32K"
	help
		Use internal 24MHz RC oscillator divided to 32K domain as the clock source for Venusa AON Timer.

endchoice

endif # LISA_HWTIMER_AON_TIMER && SOC_VENUSA
```

## arcs-sdk/drivers/lisa_hwtimer/Kconfig.venusa.dual_timer
```kconfig
# LISA Hardware Timer Driver Configuration
#
# Copyright (c) 2026, LISTENAI
# SPDX-License-Identifier: Apache-2.0

config LISA_HWTIMER_VENUSA_DUAL_TIMER
	bool "Enable LISA Hardware Timer Venusa Dual Timer support"
	depends on SOC_VENUSA
	select LISA_HWTIMER_DUAL_TIMER
	help
		Compatibility option for Venusa Dual Timer configurations.

if LISA_HWTIMER_DUAL_TIMER && SOC_VENUSA

endif # LISA_HWTIMER_DUAL_TIMER && SOC_VENUSA
```

## arcs-sdk/drivers/lisa_hwtimer/Kconfig.venusa.gpt_timer
```kconfig
# LISA Hardware Timer Driver Configuration
#
# Copyright (c) 2026, LISTENAI
# SPDX-License-Identifier: Apache-2.0

config LISA_HWTIMER_VENUSA_GPT_TIMER
	bool "Enable LISA Hardware Timer Venusa GPT Timer support"
	depends on SOC_VENUSA
	select LISA_HWTIMER_GPT_TIMER
	help
		Compatibility option for Venusa GPT Timer configurations.

if LISA_HWTIMER_GPT_TIMER && SOC_VENUSA

endif # LISA_HWTIMER_GPT_TIMER && SOC_VENUSA
```

## arcs-sdk/drivers/lisa_i2c/Kconfig
```kconfig
# LISA I2C Driver Configuration
#
# Copyright (c) 2025, LISTENAI
# SPDX-License-Identifier: Apache-2.0

menuconfig LISA_I2C
	bool "Enable LISA I2C Driver"
	default n
	depends on LISA_DEVICE
	help
	  Enable LISA I2C device driver based on lisa_device framework.
	  Provides master and slave mode I2C communication interfaces.

	  This driver wraps the HAL I2C functions and provides a unified
	  device interface for I2C operations including read, write, and
	  combined write-read transactions.

if LISA_I2C

config LISA_I2C0
	bool "Enable LISA I2C0"
	default n
	help
	  Enable LISA I2C0 controller.
	  I2C0 is the first I2C controller available on the ARCS platform.

config LISA_I2C1
	bool "Enable LISA I2C1"
	default n
	help
	  Enable LISA I2C1 controller.
	  I2C1 is the second I2C controller available on the ARCS platform.

endif # LISA_I2C
```

## arcs-sdk/drivers/lisa_i2s/Kconfig
```kconfig
# Copyright (c) 2025, LISTENAI
# SPDX-License-Identifier: Apache-2.0

# LISA I2S Driver Configuration

config LISA_I2S_DEVICE
	bool "Enable LISA I2S Device Driver"
	help
		Enable LISA I2S device driver support.

if LISA_I2S_DEVICE

config LISA_I2S0
	bool "Enable I2S0"
	help
		Enable I2S0 device.

config LISA_I2S1
	bool "Enable I2S1"
	help
		Enable I2S1 device.

config LISA_I2S_ECHO
	bool "Enable I2S echo"
	help
		Enable I2S echo.

config LISA_I2S_BLOCK_COUNT
	int "I2S inner block count"
	default 4
	help
		I2S inner block count.

config LISA_I2S_PIPO
	bool "Enable I2S PIPO mode"
	default y
	help
		Enable I2S PIPO mode.

config LISA_I2S0_RX_DMA_CHANNEL
	int "I2S0 RX GPDMA channel"
	default 0
	help
		I2S0 RX GPDMA channel.

config LISA_I2S0_TX_DMA_CHANNEL
	int "I2S0 TX GPDMA channel"
	default 1
	help
		I2S0 TX GPDMA channel.

config LISA_I2S1_RX_DMA_CHANNEL
	int "I2S1 RX GPDMA channel"
	default 2
	help
		I2S1 RX GPDMA channel.

config LISA_I2S1_TX_DMA_CHANNEL
	int "I2S1 TX GPDMA channel"
	default 3
	help
		I2S1 TX GPDMA channel.

config LISA_I2S_ECHO_DMA_CHANNEL
	int "I2S ECHO GPDMA channel"
	default 4
	help
		I2S ECHO GPDMA channel.

endif # LISA_I2S_DEVICE
```

## arcs-sdk/drivers/lisa_misc/Kconfig
```kconfig
# LISA CH32V003 EXMCU Base Driver Configuration
#
# Copyright (c) 2026, LISTENAI
# SPDX-License-Identifier: Apache-2.0

menuconfig LISA_CH32V003
	bool "Enable LISA CH32V003 EXMCU Driver"
	depends on LISA_DEVICE
	select LISA_I2C
	help
			Enable the CH32V003 external MCU bridge driver. The base device
			uses a LISA I2C bus and exposes optional LISA GPIO/ADC/PWM child
			devices named exgpioa, exgpiob, exgpioc, exgpiod, exadc and expwm.

if LISA_CH32V003

config LISA_CH32V003_I2C_DEVICE_NAME
	string "CH32V003 I2C device name"
	default "i2c1"

config LISA_CH32V003_I2C_ADDR
	hex "CH32V003 I2C slave address"
	default 0x6c

config LISA_CH32V003_INIT_DELAY_MS
	int "CH32V003 startup delay (ms)"
	default 40

config LISA_CH32V003_EXPECTED_PROTOCOL_VERSION
	int "Expected CH32V003 protocol version"
	default 14

config LISA_CH32V003_BUSY_WAIT_MS
	int "Register write busy retry delay (ms)"
	default 10

config LISA_CH32V003_BUSY_WAIT_RETRY
	int "Register write busy retry count"
	default 3

endif # LISA_CH32V003
```

## arcs-sdk/drivers/lisa_pwm/Kconfig
```kconfig
# LISA PWM Driver Configuration
#
# Copyright (c) 2025, LISTENAI
# SPDX-License-Identifier: Apache-2.0

config LISA_PWM
	bool "Enable LISA PWM Driver"
	depends on LISA_DEVICE
	help
			Enable LISA PWM device driver based on lisa_device framework.
			Provides PWM signal generation and control interfaces.

			This driver wraps the HAL PWM functions and provides a unified
			device interface for PWM operations including frequency, duty cycle,
			and polarity control.

			The driver provides one PWM device (pwm0) with 8 independent channels.

if LISA_CH32V003

config LISA_CH32V003_PWM
	bool "Enable CH32V003 PWM child device"
	default y
	select LISA_PWM

config LISA_CH32V003_PWM_CLOCK_FREQUENCY
	int "CH32V003 PWM source clock frequency"
	default 48000000

config LISA_CH32V003_PWM_CLOCK_PRESCALER
	int "CH32V003 PWM clock prescaler"
	default 480

config LISA_CH32V003_PWM_DEADTIME
	int "CH32V003 PWM dead-time register value"
	default 0

config LISA_CH32V003_PWM_BRAKE
	bool "Enable CH32V003 PWM brake"
	default n

endif # LISA_CH32V003
```

## arcs-sdk/drivers/lisa_qspilcd/Kconfig
```kconfig
# LISA QSPI LCD Driver Configuration
# Copyright (c) 2025, LISTENAI
# SPDX-License-Identifier: Apache-2.0

menuconfig LISA_QSPILCD_DEVICE
    bool "Enable LISA QSPI LCD driver"
    default n
    depends on LISA_DEVICE
    help
      Enable the LISA QSPI LCD device driver based on lisa_device framework.
      The driver wraps the HAL QSPI LCD interface and exposes a unified
      API for command and DMA based pixel transfers.

if LISA_QSPILCD_DEVICE

config LISA_QSPILCD_GPDMA_CH
    int "QSPI TX GPDMA channel"
    default 0
    help
      QSPI TX GPDMA channel used for pixel transfers.

config LISA_QSPILCD_DEFAULT_CLK_HZ
    int "Default QSPI LCD clock frequency (Hz)"
    default 50000000
    help
      Default bus clock used when the board specific configuration does not
      specify an explicit frequency.

endif # LISA_QSPILCD_DEVICE
```

## arcs-sdk/drivers/lisa_rgb/Kconfig
```kconfig
# Copyright (c) 2025, LISTENAI
# SPDX-License-Identifier: Apache-2.0

config LISA_RGB_DEVICE
	bool "Enable LISA RGB LCD driver"
	default n
	help
	  Enable LISA RGB (parallel) LCD device driver.
	  This driver provides a unified interface for RGB parallel LCD panels.

if LISA_RGB_DEVICE

config LISA_RGB_GPDMA_CH
	int "GPDMA channel for RGB data transfer"
	default 1
	range 0 5
	help
	  GPDMA channel number used for RGB framebuffer transfer.
	  Make sure this channel is not used by other peripherals.

endif # LISA_RGB_DEVICE
```

## arcs-sdk/drivers/lisa_rtc/Kconfig
```kconfig
# LISA RTC Driver Configuration
#
# Copyright (c) 2025, LISTENAI
# SPDX-License-Identifier: Apache-2.0

menuconfig LISA_RTC
	bool "Enable LISA RTC Driver"
	default n
	depends on LISA_DEVICE
	help
	  Enable LISA RTC (Real-Time Clock) device driver based on lisa_device framework.
	  Provides unified interface for RTC with alarm and periodic interrupt support.

if LISA_RTC

endif # LISA_RTC
```
