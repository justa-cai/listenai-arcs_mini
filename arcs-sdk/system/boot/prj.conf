## CMakeLists.txt
```
cmake_minimum_required(VERSION 3.19)

if(NOT DEFINED ARCS_SDK_BASE)
    set(ARCS_SDK_BASE "$ENV{ARCS_BASE}")
endif()

if(NOT ARCS_SDK_BASE)
    get_filename_component(ARCS_SDK_BASE "${CMAKE_CURRENT_LIST_DIR}/../.." ABSOLUTE)
endif()

if(NOT DEFINED ARCH)
    set(ARCH riscv)
endif()

include(${ARCS_SDK_BASE}/cmake/${ARCH}-toolchain.cmake)

set(LISTENAI_MODULES_DIR_LIST
    ${CMAKE_CURRENT_SOURCE_DIR}/src
)

set(CMAKE_EXPORT_COMPILE_COMMANDS ON)

find_package(listenai-cmake REQUIRED HINTS ${ARCS_SDK_BASE})

project(boot)

listenai_add_executable(${PROJECT_NAME})
listenai_set_linker_script(${CMAKE_CURRENT_SOURCE_DIR}/src/linker.ld)
```

## Kconfig
```
# Copyright (c) 2025, LISTENAI
# SPDX-License-Identifier: Apache-2.0

osource "$LISTENAI_MODULES"
rsource "Kconfig.boot"
```

## Kconfig.boot
```
# Copyright (c) 2025, LISTENAI
# SPDX-License-Identifier: Apache-2.0

config BOOT_AP_ENTRY
	hex "AP entry"
	default 0

config BOOT_CP_ENTRY
	hex "CP entry"
	default 0
	depends on !MEM_CONFIG

config BOOT_FLASH_SIZE
	hex "Flash size"
	default 0x4000

choice
	prompt "boot log level"
	default BOOT_LOG_LVL_ERR

	config BOOT_LOG_LVL_NON
		bool "non"
	config BOOT_LOG_LVL_ERR
		bool "err"
	config BOOT_LOG_LVL_WRN
		bool "wrn"
	config BOOT_LOG_LVL_INF
		bool "inf"
	config BOOT_LOG_LVL_DBG
		bool "dbg"

endchoice

config BOOT_UART_PORT
	int "boot log port"
	default 0

config BOOT_UART_TX_PIN
	int "boot uart tx pin"
	default 3

config BOOT_UART_BAUDRATE
	int "boot log baud rate"
	default 921600

config BOOT_UART_PIN_FUNC_SEL
	int "boot log pin func sel"
	default 2
```

## sample.yaml
```
tests:
  startup.boot:
    build_only: true
```

## prj.conf
```kconfig
# 项目可根据需要在此文件中设置对应的配置
```

## src/boot.c
```c
#include "chip.h"
#include "PSRAMManager.h"
#include "ClockManager.h"

#include "boot_log.h"

#include <stdint.h>

extern uint32_t __scat_copy_base, __scat_copy_last, __scat_zero_base, __scat_zero_last;
extern uint32_t __psram_scat_copy_base, __psram_scat_copy_last, __psram_scat_zero_base, __psram_scat_zero_last;

typedef struct {
    uint32_t len, *vma, *lma;
} scat_copy_item_t;
typedef struct {
    uint32_t len, *vma;
} scat_zero_item_t;

static __attribute__((section(".init"))) void _scatload(uint32_t *dst, const uint32_t *src, uint32_t cnt)
{
    while (cnt--) {
        *dst++ = *src++;
    }
}

static __attribute__((section(".init"))) void _scatfill(uint32_t *dst, uint32_t fill, int cnt)
{
    while (cnt--) {
        *dst++ = fill;
    }
}

static __attribute__((section(".init"))) void scatload(void)
{
    for (scat_copy_item_t *item = (void *)&__scat_copy_base; (uint32_t *)item < &__scat_copy_last; item++) {
        if (item->vma && item->len >= sizeof(uint32_t) && item->vma != item->lma) {
            _scatload(item->vma, item->lma, item->len >> 2);
        }
    }

    for (scat_zero_item_t *item = (void *)&__scat_zero_base; (uint32_t *)item < &__scat_zero_last; item++) {
        if (item->vma && item->len >= sizeof(uint32_t)) {
            _scatfill(item->vma, 0, item->len >> 2);
        }
    }
}

static void scatload_psram(void)
{
    for (scat_copy_item_t *item = (void *)&__psram_scat_copy_base; (uint32_t *)item < &__psram_scat_copy_last; item++) {
        if (item->vma && item->len >= sizeof(uint32_t) && item->vma != item->lma) {
            _scatload(item->vma, item->lma, item->len >> 2);
        }
    }

    for (scat_zero_item_t *item = (void *)&__psram_scat_zero_base; (uint32_t *)item < &__psram_scat_zero_last; item++) {
        if (item->vma && item->len >= sizeof(uint32_t)) {
            _scatfill(item->vma, 0, item->len >> 2);
        }
    }
}

void irq_default_handler(void)
{

}

#define FALLBACK_DEFAULT_ECLIC_BASE    0x0C000000UL
#define FALLBACK_DEFAULT_SYSTIMER_BASE 0x02000000UL

volatile IRegion_Info_Type SystemIRegionInfo;
static void _get_iregion_info(volatile IRegion_Info_Type *iregion)
{
    unsigned long mcfg_info;
    if (iregion == NULL) {
        return;
    }
    mcfg_info = __RV_CSR_READ(CSR_MCFG_INFO);
    if (mcfg_info & MCFG_INFO_IREGION_EXIST) { // IRegion Info present
        iregion->iregion_base = (__RV_CSR_READ(CSR_MIRGB_INFO) >> 10) << 10;
        iregion->eclic_base = iregion->iregion_base + IREGION_ECLIC_OFS;
        iregion->systimer_base = iregion->iregion_base + IREGION_TIMER_OFS;
        iregion->smp_base = iregion->iregion_base + IREGION_SMP_OFS;
        iregion->idu_base = iregion->iregion_base + IREGION_IDU_OFS;
    } else {
        iregion->eclic_base = FALLBACK_DEFAULT_ECLIC_BASE;
        iregion->systimer_base = FALLBACK_DEFAULT_SYSTIMER_BASE;
    }
}

static const uint32_t psram_size[] = {0, 32, 0, 64, 0, 128, 512, 256};

void boot_run(void)
{
    __disable_irq();

    scatload();

    _get_iregion_info(&SystemIRegionInfo);

    extern void BootClock_Init();
    BootClock_Init();
    __FENCE_I();

    bootlog_init(CONFIG_BOOT_UART_PORT, CONFIG_BOOT_UART_BAUDRATE);

    bootlog_dbg("main  clk: %d Hz\n", CRM_GetSrcFreq(CRM_IpSrcCoreClk));
    bootlog_dbg("psram clk: %d Hz\n", CRM_GetPsramFreq());

    uint32_t rdly = 18, wdly = 22;
    int r;

    r = PSRAM_Initialize(&rdly, &wdly, 1);
    if (r != 0) {
        bootlog_err("psram error, code: %d\n", r);
        while(1);
    }

    uint32_t density = ((IP_PSRAM_CTRL->REG_MR2.all & 0xff) >> 0) & 0x07;
    if (density < sizeof(psram_size)/ sizeof(psram_size[0])) {
        bootlog_dbg("psram inf, size: %d Mbit, w: %d, r: %d\n", psram_size[density], wdly, rdly);
    } else {
        bootlog_dbg("psram inf, size: unknown, w: %d, r: %d\n", wdly, rdly);
    }

    for (int i = 0; i < IRQ_MAX; i++) {
        disable_IRQ(i);
        clear_IRQ(i);
    }

#if defined CONFIG_BOOT_CP_ENTRY
    IP_CMN_SYS->REG_N300_CP_RST_ADDR.all = (uint32_t)CONFIG_BOOT_CP_ENTRY;
    IP_SYSCTRL->REG_SW_RESET_CP0.all = 0xCAFE000A;
    bootlog_dbg("cp: 0x%x\n", CONFIG_BOOT_CP_ENTRY);
#endif

#if defined CONFIG_BOOT_AP_ENTRY
    if (CONFIG_BOOT_AP_ENTRY) {
        void (*ap_core_start)(void) = (void (*)(void))CONFIG_BOOT_AP_ENTRY;
        ap_core_start();
        bootlog_dbg("ap: 0x%x\n", CONFIG_BOOT_AP_ENTRY);
    }
#endif

    bootlog_inf("ap: none\n");

    while (1) {
        __WFI();
    }
}
```

## src/boot_log.c
```c
#include "stdint.h"
#include "log_print.h"

#include <stdio.h>
#include "uart_reg.h"
#include "chip.h"
#include "ClockManager.h"
#include "IOMuxManager.h"

static UART_RegDef *uart = NULL;

__attribute__((weak)) uint32_t cloglvl = 0;

__attribute__((weak)) void logDbg(const char *format, ...)
{
    (void)format;
}

static uint32_t compute_gcd(uint32_t a, uint32_t c)
{
    uint32_t t;
    while (c != 0) {
        t = a % c;
        a = c;
        c = t;
    }
    return a;
}

static int32_t __log_compute_div(int dbg, uint32_t baudrate, uint32_t *pm, uint32_t *pn, uint32_t div)
{
    uint32_t gcd, m, n, tmp;
    int32_t ret = 0;

    tmp = div * baudrate;
    uint32_t uart_clk;

    if (dbg == 0) {
        uart_clk = 24000000;
    } else if (dbg == 1) {
        uart_clk = 24000000;
    }

    gcd = compute_gcd(uart_clk, tmp);
    m = uart_clk / gcd;
    n = tmp / gcd;

    if ((m > 1023) || (n > 511)) {
        return -1;
    }

    *pm = m;
    *pn = n;

    return 0;
}

static int32_t log_compute_div(int dbg, uint32_t baudrate, uint32_t *pm, uint32_t *pn, uint32_t *pdiv)
{
    int32_t ret = 0;

    do {
        if (__log_compute_div(dbg, baudrate, pm, pn, 4) == 0) {
            *pdiv = 4;
            break;
        }
        if (__log_compute_div(dbg, baudrate, pm, pn, 16) == 0) {
            *pdiv = 16;
            break;
        }
        ret = -1;
    } while (0);

    return ret;
}
#define CONFIG_SYSLOG_UART_TX_PIN          3
#define CONFIG_SYSLOG_UART_TX_PIN_FUNC_SEL 0x2

static void __log_io_config(int dbg)
{
    IOMuxManager_PinConfigure(CSK_IOMUX_PAD_A, CONFIG_SYSLOG_UART_TX_PIN, CONFIG_SYSLOG_UART_TX_PIN_FUNC_SEL);
}

int syslog_write(const char *data, int len)
{
    if (uart == NULL || data == NULL || len == 0) {
        return 0;
    }

    for (int i = 0; i < len; i++) {
        uart->REG_RXTX_BUFFER.all = data[i];
        while (!uart->REG_STATUS.bit.TX_FIFO_SPACE)
            ;
    }

    return len;
}

int bootlog_init(int dbg, uint32_t baudrate)
{
    uint32_t m, n, div, uart_base, cmn_reg;

    if (log_compute_div(dbg, baudrate, &m, &n, &div) < 0) {
        return -1;
    }

    __log_io_config(dbg);

    switch (dbg) {
    case 0:
        uart = (UART_RegDef *)UART0_BASE;

        __HAL_CRM_UART0_CLK_ENABLE();
        HAL_CRM_SetUart0ClkDiv(n, m);
        break;
    case 1:
    default:
        uart = (UART_RegDef *)UART1_BASE;

        __HAL_CRM_UART1_CLK_ENABLE();
        HAL_CRM_SetUart1ClkDiv(n, m);
        break;
    }

    uart->REG_IRQ_MASK.all = 0;
    uart->REG_CTRL.all = 0;

    if (div == 16) {
        uart->REG_CTRL.bit.DIVISOR_MODE = 1; // 0: sclk/4; 1: sclk/16
    } else {
        uart->REG_CTRL.bit.DIVISOR_MODE = 0;
    }

    uart->REG_CMD_SET.bit.TX_FIFO_RESET = 1; // reset tx fifo
    uart->REG_CMD_SET.bit.RX_FIFO_RESET = 1; // reset rx fifo

    uart->REG_CTRL.bit.DATA_BITS = 1; // 8bits
    uart->REG_CTRL.bit.ENABLE = 1;    // enable uart
    uart->REG_STATUS.all = 1;         // clear line error bits

    return 0;
}

static void int_to_str(int value, char *buf, size_t *written)
{
    if (value < 0) {
        buf[(*written)++] = '-';
        value = -value;
    }
    if (value == 0) {
        buf[(*written)++] = '0';
        return;
    }

    char temp[10];
    size_t index = 0;

    while (value > 0) {
        temp[index++] = (value % 10) + '0';
        value /= 10;
    }

    for (size_t i = 0; i < index; i++) {
        if (*written < 512 - 1) {
            buf[(*written)++] = temp[index - 1 - i];
        }
    }
}

static void uint_to_hex_str(unsigned int value, char *buf, size_t *written)
{
    if (value == 0) {
        buf[(*written)++] = '0';
        return;
    }

    char temp[8];
    size_t index = 0;

    while (value > 0) {
        unsigned int digit = value % 16;
        temp[index++] = (digit < 10) ? (digit + '0') : (digit - 10 + 'a');
        value /= 16;
    }

    for (size_t i = 0; i < index; i++) {
        if (*written < 512 - 1) {
            buf[(*written)++] = temp[index - 1 - i];
        }
    }
}

int bootlog_vsnprintf(char *buf, size_t size, const char *format, va_list args)
{
    size_t written = 0;
    const char *p;

    for (p = format; *p != '\0'; p++) {
        if (*p != '%') {
            if (written < size - 1) {
                buf[written++] = *p;
            }
            continue;
        }

        p++;
        switch (*p) {
        case 'd': {
            int value = va_arg(args, int);
            int_to_str(value, buf, &written);
            break;
        }
        case 'x': {
            unsigned int value = va_arg(args, unsigned int);
            uint_to_hex_str(value, buf, &written);
            break;
        }
        case 's': {
            const char *str = va_arg(args, const char *);
            while (*str && written < size - 1) {
                buf[written++] = *str++;
            }
            break;
        }
        default:
            if (written < size - 1) {
                buf[written++] = '%';
                buf[written++] = *p;
            }
            break;
        }
    }

    if (written < size) {
        buf[written] = '\0';
    } else if (size > 0) {
        buf[size - 1] = '\0';
    }

    return written;
}

void bootlog_output(const char *format, va_list args)
{
    static uint8_t buffer[512] = {0};
    uint32_t len = bootlog_vsnprintf((char *)buffer, 512 - 1, format, args);
    buffer[len] = '\0';
    syslog_write(buffer, len);
}

int vprintk(const char *format, va_list args)
{
    bootlog_output(format, args);

    return 0;
}

int printk(const char *format, ...)
{
    va_list args;
    va_start(args, format);
    vprintk(format, args);
    va_end(args);
    return 0;
}
```

## src/boot_log.h
```c
#ifndef __BOOT_LOG_H__
#define __BOOT_LOG_H__

int printk(const char *format, ...);
int bootlog_init(int dbg, uint32_t baudrate);

#define BOOTLOG_LVL_NON 0
#define BOOTLOG_LVL_ERR 1
#define BOOTLOG_LVL_WRN 2
#define BOOTLOG_LVL_INF 3
#define BOOTLOG_LVL_DBG 4

#if CONFIG_BOOT_LOG_LVL_NON
#define BOOTLOG_LVL BOOTLOG_LVL_NON
#elif CONFIG_BOOT_LOG_LVL_ERR
#define BOOTLOG_LVL BOOTLOG_LVL_ERR
#elif CONFIG_BOOT_LOG_LVL_WRN
#define BOOTLOG_LVL BOOTLOG_LVL_WRN
#elif CONFIG_BOOT_LOG_LVL_INF
#define BOOTLOG_LVL BOOTLOG_LVL_INF
#elif CONFIG_BOOT_LOG_LVL_DBG
#define BOOTLOG_LVL BOOTLOG_LVL_DBG
#endif

#ifndef BOOTLOG_LVL
#define BOOTLOG_LVL BOOTLOG_LVL_ERR
#endif

#if BOOTLOG_LVL >= BOOTLOG_LVL_ERR
#define bootlog_err(fmt, args...)                                                                                      \
    do {                                                                                                               \
        printk("[boot] err: " fmt, ##args);                                                                            \
    } while (0)
#else
#define bootlog_err(fmt, args...)
#endif

#if BOOTLOG_LVL >= BOOTLOG_LVL_WRN
#define bootlog_wrn(fmt, args...)                                                                                      \
    do {                                                                                                               \
        printk("[boot] wrn: " fmt, ##args);                                                                            \
    } while (0)
#else
#define bootlog_wrn(fmt, args...)
#endif

#if BOOTLOG_LVL >= BOOTLOG_LVL_INF
#define bootlog_inf(fmt, args...)                                                                                      \
    do {                                                                                                               \
        printk("[boot] inf: " fmt, ##args);                                                                            \
    } while (0)
#else
#define bootlog_inf(fmt, args...)
#endif


#if BOOTLOG_LVL >= BOOTLOG_LVL_DBG
#define bootlog_dbg(fmt, args...)                                                                                      \
    do {                                                                                                               \
        printk("[boot] dbg: " fmt, ##args);                                                                            \
    } while (0)
#else
#define bootlog_dbg(fmt, args...)
#endif

#endif
```

## src/cache.c
```c
/*
 * cache_ap.c
 *
 *  Created on: Jul 10, 2020
 *
 */
#include <assert.h>
#include "chip.h"
#include "nmsis_core.h"
#include "cache.h"

/**
 * @brief Enables the CPU instruction cache.
 *
 * This function activates the internal instruction cache of the CPU
 * to enhance the execution speed of programs. It is part of the Hardware
 * Abstraction Layer (HAL), providing an interface to manage hardware-specific
 * features such as caching operations. Enabling the instruction cache allows
 * for faster access to frequently executed instructions, which is crucial
 * for performance-critical applications.
 */
void HAL_EnableICache(void){
#if HAL_ICACHE_VALID
    __disable_irq();
	EnableICache();


    __enable_irq();
#endif
}

/**
 * @brief Disables the CPU instruction cache.
 *
 * This function deactivates the internal instruction cache of the CPU
 * to potentially aid in debugging or to meet specific system requirements
 * where caching of instructions needs to be prevented. It is part of the Hardware
 * Abstraction Layer (HAL), providing an interface to manage hardware-specific
 * features such as caching operations. Disabling the instruction cache may be
 * necessary in scenarios where precise control over instruction execution is required.
 */
void HAL_DisableICache(void){
#if HAL_ICACHE_VALID
    __disable_irq();
	DisableICache();


    __enable_irq();
#endif
}

/**
 * @brief Invalidates the CPU instruction cache.
 *
 * This function clears the contents of the internal instruction cache of the CPU.
 * Invalidating the cache is useful to ensure that no stale or corrupted data is used
 * by the CPU, which is particularly important after direct memory access (DMA) operations
 * or after loading new programs into memory. It is part of the Hardware Abstraction Layer (HAL),
 * providing an interface to manage hardware-specific features such as caching operations.
 * This operation helps in maintaining data coherency and consistency across the system.
 */
void HAL_InvalidateICache(void){
#if HAL_ICACHE_VALID
    __disable_irq();
	MInvalICache();


    __enable_irq();
#endif
}

/**
 * @brief Invalidates a range of the CPU data cache based on address and size.
 *
 * This function clears a specific portion of the CPU's internal data cache. By providing
 * an address and the size of the area, this function ensures that any modifications in
 * memory in this specified range do not use stale or outdated cache entries. This is particularly
 * useful for systems where memory regions are dynamically altered or when devices not supporting
 * cache coherency modify the memory. It helps in maintaining data integrity and coherency
 * especially in systems involving direct memory access (DMA) operations.
 *
 * @param addr Pointer to the start address of the memory region to invalidate.
 * @param dsize Size of the memory region to invalidate, in bytes.
 */
void HAL_InvalidateICache_by_Addr(uint32_t *addr, uint32_t dsize){
#if HAL_ICACHE_VALID
    __disable_irq();
    unsigned long cnt = 0;
    cnt = ((uint32_t)addr % HAL_ICACHE_CFG_LINE_SIZE + dsize + (HAL_ICACHE_CFG_LINE_SIZE - 1)) / HAL_ICACHE_CFG_LINE_SIZE;
    MInvalICacheLines((unsigned long)addr, (unsigned long)cnt);


    __enable_irq();
#endif
}

/**
 * @brief Locks a range of the CPU instruction cache based on address and size.
 *
 * This function prevents the CPU instruction cache from being updated or invalidated within a specified
 * range. It ensures that the cache entries in this range remain fixed and are not replaced or
 * evicted. This can be useful in scenarios where instruction stability is critical and should not be
 * changed by other operations or processes.
 *
 * @param addr Pointer to the start address of the memory region to lock.
 * @param dsize Size of the memory region to lock, in bytes.
 */
void HAL_LockICache_by_Addr(uint32_t *addr, uint32_t dsize){
#if HAL_ICACHE_VALID
    __disable_irq();
    unsigned long cnt = 0;
    cnt = ((uint32_t)addr % HAL_ICACHE_CFG_LINE_SIZE + dsize + (HAL_ICACHE_CFG_LINE_SIZE - 1)) / HAL_ICACHE_CFG_LINE_SIZE;
    MLockICacheLines((unsigned long)addr, (unsigned long)cnt);


    __enable_irq();
#endif
}

/**
 * @brief Unlocks a previously locked range of the CPU instruction cache based on address and size.
 *
 * This function allows the CPU instruction cache to be updated or invalidated within a previously locked
 * range. It ensures that the cache entries in this range can now be replaced or evicted as needed,
 * returning the cache operation to its normal behavior. This is useful when the critical operation
 * requiring instruction stability is complete and normal cache operations need to resume.
 *
 * @param addr Pointer to the start address of the memory region to unlock.
 * @param dsize Size of the memory region to unlock, in bytes.
 */
void HAL_UnLockICache_by_Addr(uint32_t *addr, uint32_t dsize){
#if HAL_ICACHE_VALID
    __disable_irq();
    unsigned long cnt = 0;
    cnt = ((uint32_t)addr % HAL_ICACHE_CFG_LINE_SIZE + dsize + (HAL_ICACHE_CFG_LINE_SIZE - 1)) / HAL_ICACHE_CFG_LINE_SIZE;
    MUnlockICacheLines((unsigned long)addr, (unsigned long)cnt);


    __enable_irq();
#endif
}


/**
 * @brief Enables the CPU data cache.
 *
 * This function activates the internal data cache of the CPU
 * to enhance the execution speed and efficiency of data access and processing.
 * It is part of the Hardware Abstraction Layer (HAL), providing an interface to manage
 * hardware-specific features such as caching operations. Enabling the data cache helps
 * improve system performance by reducing memory access times and minimizing CPU idle time
 * during data fetches from main memory.
 */
void HAL_EnableDCache(void){
#if HAL_DCACHE_VALID
    __disable_irq();
	EnableDCache();


    __enable_irq();
#endif
}

/**
 * @brief Disables the CPU data cache.
 *
 * This function deactivates the internal data cache of the CPU.
 * Disabling the data cache can be useful in scenarios where data caching may lead
 * to consistency issues, such as during non-cache-coherent DMA operations or when
 * the predictability of every data access is required. It is part of the Hardware
 * Abstraction Layer (HAL), providing an interface to manage hardware-specific features.
 * Disabling the data cache ensures that all data reads and writes are directly made to
 * and from the main memory, which can be crucial for real-time and safety-critical applications.
 */
void HAL_DisableDCache(void){
#if HAL_DCACHE_VALID
    __disable_irq();
	DisableDCache();


    __enable_irq();
#endif
}


/**
 * @brief Invalidates the CPU data cache.
 *
 * This function clears the contents of the internal data cache of the CPU.
 * Invalidating the cache is essential to prevent the use of stale or incorrect data
 * that might remain after changes in memory. It is commonly used after direct memory
 * access (DMA) operations or when hardware devices modify memory outside of the CPU's control.
 * It is part of the Hardware Abstraction Layer (HAL), providing an interface to manage
 * hardware-specific features such as caching operations. This operation ensures data coherency
 * and consistency across the system, particularly in systems where memory is shared between the CPU
 * and other hardware components.
 */
void HAL_InvalidateDCache(void){
#if HAL_DCACHE_VALID
    __disable_irq();
    MInvalDCache();


    __enable_irq();
#endif
}

/**
 * @brief Flushes the CPU data cache.
 *
 * This function ensures that all modified data within the CPU's internal data cache
 * are written back to the main memory. Flushing the data cache is crucial before
 * any operations that require up-to-date data from other processors or hardware
 * that do not have cache coherency mechanisms. It is part of the Hardware
 * Abstraction Layer (HAL), providing an interface to manage hardware-specific features
 * such as caching operations. This operation helps maintain data coherency and
 * consistency across different parts of the system, particularly in multi-core
 * or multi-processor environments.
 */
void HAL_FlushDCache(void){
#if HAL_DCACHE_VALID
    __disable_irq();
	MFlushDCache();


    __enable_irq();
#endif
}

/**
 * @brief Flushes and invalidates the CPU data cache.
 *
 * This function ensures that all modified data within the CPU's internal data cache
 * are written back to the main memory, and then invalidates the cache to remove all entries.
 * This is particularly useful in scenarios where data coherence and consistency are critical,
 * such as before DMA operations where peripheral devices need to access the latest data,
 * or after updating firmware that changes the memory layout. It is part of the Hardware
 * Abstraction Layer (HAL), providing an interface to manage hardware-specific features
 * such as caching operations. Flushing and invalidating the data cache ensures that
 * no stale data is used and all future data reads are done directly from the main memory.
 */
void HAL_FlushInvalidateDCache(void){
#if HAL_DCACHE_VALID
    __disable_irq();
	MFlushInvalDCache();


    __enable_irq();
#endif
}

/**
 * @brief Invalidates a range of the CPU data cache based on address and size.
 *
 * This function clears a specific portion of the CPU's internal data cache. By providing
 * an address and the size of the area, this function ensures that any modifications in
 * memory in this specified range do not use stale or outdated cache entries. This is particularly
 * useful for systems where memory regions are dynamically altered or when devices not supporting
 * cache coherency modify the memory. It helps in maintaining data integrity and coherency
 * especially in systems involving direct memory access (DMA) operations.
 *
 * @param addr Pointer to the start address of the memory region to invalidate.
 * @param dsize Size of the memory region to invalidate, in bytes.
 */
void HAL_InvalidateDCache_by_Addr(uint32_t *addr, uint32_t dsize){
#if HAL_DCACHE_VALID
    __disable_irq();
	unsigned long cnt = 0;
	cnt = ((uint32_t)addr % HAL_DCACHE_CFG_LINE_SIZE + dsize + (HAL_DCACHE_CFG_LINE_SIZE - 1)) / HAL_DCACHE_CFG_LINE_SIZE;
	MInvalDCacheLines((unsigned long)addr, (unsigned long)cnt);


    __enable_irq();
#endif
}

/**
 * @brief Flushes a range of the CPU data cache based on address and size.
 *
 * This function writes back all modified data within a specified range of the CPU's internal data cache
 * to the main memory. This operation is crucial for ensuring data coherence in systems where other processors
 * or hardware devices access the same memory region but do not share a cache coherency mechanism. It is typically
 * used prior to DMA operations or when processors in a multi-processor system access shared data.
 *
 * @param addr Pointer to the start address of the memory region to flush.
 * @param dsize Size of the memory region to flush, in bytes.
 */
void HAL_FlushDCache_by_Addr(uint32_t *addr, uint32_t dsize){
#if HAL_DCACHE_VALID
    __disable_irq();
	unsigned long cnt = 0;
	cnt = ((uint32_t)addr % HAL_DCACHE_CFG_LINE_SIZE + dsize + (HAL_DCACHE_CFG_LINE_SIZE - 1)) / HAL_DCACHE_CFG_LINE_SIZE;
	MFlushDCacheLines((unsigned long)addr, (unsigned long)cnt);


    __enable_irq();
#endif
}

/**
 * @brief Flushes and invalidates a range of the CPU data cache based on address and size.
 *
 * This function combines the actions of writing back all modified data within a specified range
 * of the CPU's internal data cache to the main memory and then invalidating the cache entries.
 * This ensures that no stale data remains and all future accesses to this memory range will be
 * fetched directly from the main memory. This operation is particularly vital in systems with
 * non-cache-coherent DMA operations or in multi-core systems where processors need to share
 * up-to-date data without any inconsistencies.
 *
 * @param addr Pointer to the start address of the memory region to flush and invalidate.
 * @param dsize Size of the memory region to flush and invalidate, in bytes.
 */
void HAL_FlushInvalidateDCache_by_Addr(uint32_t *addr, uint32_t dsize){
#if HAL_DCACHE_VALID
    __disable_irq();
	unsigned long cnt = 0;
	cnt = ((uint32_t)addr % HAL_DCACHE_CFG_LINE_SIZE + dsize + (HAL_DCACHE_CFG_LINE_SIZE - 1)) / HAL_DCACHE_CFG_LINE_SIZE;
	MFlushInvalDCacheLines((unsigned long)addr, (unsigned long)cnt);


    __enable_irq();
#endif
}

/**
 * @brief Locks a range of the CPU data cache based on address and size.
 *
 * This function prevents the CPU data cache from being updated or invalidated within a specified
 * range. It ensures that the cache entries in this range remain fixed and are not replaced or
 * evicted. This can be useful in scenarios where data stability is critical and should not be
 * changed by other operations or processes.
 *
 * @param addr Pointer to the start address of the memory region to lock.
 * @param dsize Size of the memory region to lock, in bytes.
 */
void HAL_LockDCache_by_Addr(uint32_t *addr, uint32_t dsize){
#if HAL_DCACHE_VALID
    __disable_irq();
    unsigned long cnt = 0;
    cnt = ((uint32_t)addr % HAL_DCACHE_CFG_LINE_SIZE + dsize + (HAL_DCACHE_CFG_LINE_SIZE - 1)) / HAL_DCACHE_CFG_LINE_SIZE;
    MLockDCacheLines((unsigned long)addr, (unsigned long)cnt);


    __enable_irq();
#endif
}

/**
 * @brief Unlocks a previously locked range of the CPU data cache based on address and size.
 *
 * This function allows the CPU data cache to be updated or invalidated within a previously locked
 * range. It ensures that the cache entries in this range can now be replaced or evicted as needed,
 * returning the cache operation to its normal behavior. This is useful when the critical operation
 * requiring data stability is complete and normal cache operations need to resume.
 *
 * @param addr Pointer to the start address of the memory region to unlock.
 * @param dsize Size of the memory region to unlock, in bytes.
 */
void HAL_UnLockDCache_by_Addr(uint32_t *addr, uint32_t dsize){
#if HAL_DCACHE_VALID
    __disable_irq();
    unsigned long cnt = 0;
    cnt = ((uint32_t)addr % HAL_DCACHE_CFG_LINE_SIZE + dsize + (HAL_DCACHE_CFG_LINE_SIZE - 1)) / HAL_DCACHE_CFG_LINE_SIZE;
    MUnlockDCacheLines((unsigned long)addr, (unsigned long)cnt);


    __enable_irq();
#endif
}

// This function will be abandon
int range_is_cacheable(unsigned long start, unsigned long size){
	return 0;
}

void unaligned_cache_line_move(unsigned char* src, unsigned char* dst, unsigned long len)
{

    __disable_irq();
    int i;
    unsigned char* src_p = (unsigned char*) src;
    unsigned char* dst_p = (unsigned char*) dst;
    for (i = 0; i < len; ++i) {
        *(dst_p + i) = *(src_p + i);
    }
    __enable_irq();

}
void dcache_clean_range(unsigned long start, unsigned long end){
    uint32_t line_mask = HAL_DCACHE_CFG_LINE_SIZE - 1;

    // 对start向上取整到cache line边界
    unsigned long aligned_start = (start + line_mask) & (~line_mask);

    // 对end向下取整到cache line边界
    unsigned long aligned_end = end & (~line_mask);

    __disable_irq();
    // 只有当有完整的cache line需要处理时才进行操作
    if (aligned_start < aligned_end) {
        HAL_FlushDCache_by_Addr((uint32_t *)aligned_start, (aligned_end - aligned_start));
    }

    // 对不对齐的部分进行单独处理
    if (start < aligned_start) {
        // 处理start到aligned_start之间的数据
        // 这里需要更细粒度的处理方式
    }

    if (end > aligned_end) {
        // 处理aligned_end到end之间的数据
        // 这里需要更细粒度的处理方式
    }
    __enable_irq();
}

void dcache_invalidate_range(unsigned long start, unsigned long end){
    uint32_t line_mask = HAL_DCACHE_CFG_LINE_SIZE - 1;

    // 对start向上取整到cache line边界
    unsigned long aligned_start = (start + line_mask) & (~line_mask);

    // 对end向下取整到cache line边界
    unsigned long aligned_end = end & (~line_mask);

    __disable_irq();

    // 只有当有完整的cache line需要处理时才进行操作
    if (aligned_start < aligned_end) {
        HAL_InvalidateDCache_by_Addr((uint32_t *)aligned_start, (aligned_end - aligned_start));
    }

    // 对不对齐的部分进行单独处理
    if (start < aligned_start) {
        // 处理start到aligned_start之间的数据
        // 这里需要更细粒度的处理方式
    }

    if (end > aligned_end) {
        // 处理aligned_end到end之间的数据
        // 这里需要更细粒度的处理方式
    }
    __enable_irq();
}

void dcache_flush_range(unsigned long start, unsigned long end){
	uint32_t line_mask = HAL_DCACHE_CFG_LINE_SIZE - 1;

	// 对start向上取整到cache line边界
	unsigned long aligned_start = (start + line_mask) & (~line_mask);

	// 对end向下取整到cache line边界
	unsigned long aligned_end = end & (~line_mask);

    __disable_irq();
	// 只有当有完整的cache line需要处理时才进行操作
	if (aligned_start < aligned_end) {
		HAL_FlushDCache_by_Addr((uint32_t *)aligned_start, (aligned_end - aligned_start));
		HAL_InvalidateDCache_by_Addr((uint32_t *)aligned_start, (aligned_end - aligned_start));
	}

	// 对不对齐的部分进行单独处理
	if (start < aligned_start) {
		// 处理start到aligned_start之间的数据
		// 这里需要更细粒度的处理方式
	}

	if (end > aligned_end) {
		// 处理aligned_end到end之间的数据
		// 这里需要更细粒度的处理方式
	}
    __enable_irq();
}
void cache_dma_fast_inv_stage1(unsigned long start, unsigned long end){
unsigned long line_size;
	unsigned long old_start = start;
	unsigned long old_end = end;
	line_size = HAL_DCACHE_CFG_LINE_SIZE;
	start = start & (~(line_size - 1));
	end = (end + line_size - 1) & (~(line_size - 1));
	if (start == end)
		return;

    __disable_irq();
	if (start != old_start) {
		HAL_FlushDCache_by_Addr((uint32_t *)start, line_size);
	}
	if (end != old_end) {
		HAL_FlushDCache_by_Addr((uint32_t *)(end - line_size), line_size);
	}
	HAL_InvalidateDCache_by_Addr((uint32_t *)start, (end - start));
    __enable_irq();
}
// void cache_dma_fast_inv_stage2(unsigned long start, unsigned long end){

// }
// dcache_clean_range(buff_addr, buff_addr + blk_sz * blk_cnt);
//         gm_cpu_clean_dcache_range(q->payload, q->len);
//         gm_cpu_dcache_invalidate_range(q->payload, q->len);
//             	cache_dma_fast_inv_stage1(buff_addr, buff_addr + blk_sz * blk_cnt);

//             	dcache_clean_range(buff_addr, buff_addr + blk_sz * blk_cnt);
// // usually called after transferring data to memory  (NOT cache-line-aligned) via DMA

void cache_dma_fast_inv_stage2(unsigned long start, unsigned long end)
{
	unsigned long line_size;
	unsigned long old_start = start;
	unsigned long old_end = end;
	static unsigned char cache_line_buf[32];

	line_size = HAL_DCACHE_CFG_LINE_SIZE;
	start = start & (~(line_size - 1));
	end = (end + line_size - 1) & (~(line_size - 1));
	if (start == end)
		return;

	int use_lock = 0;
	// interrupt enabled, and not in interrupt context

	if(start != old_start || end != old_end)
		use_lock = 1;

	if (use_lock) {
		disable_GINT();
	}

    __disable_irq();
	if (start != old_start) {
		unaligned_cache_line_move((unsigned char*) start, cache_line_buf, old_start - start);
		HAL_InvalidateDCache_by_Addr((uint32_t *)start, line_size);
		unaligned_cache_line_move(cache_line_buf, (unsigned char*) start, old_start - start);
	}
	if (end != old_end) {
		unaligned_cache_line_move((unsigned char*) old_end, cache_line_buf, end - old_end);
		HAL_InvalidateDCache_by_Addr((uint32_t *)(end - line_size), line_size);
		unaligned_cache_line_move(cache_line_buf, (unsigned char*) old_end, end - old_end);
	}
    __enable_irq();

	if (use_lock) {
		enable_GINT();
	}

}
```
