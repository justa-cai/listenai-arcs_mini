## CMakeLists.txt
```
cmake_minimum_required(VERSION 3.19)

# This is always a bare-metal cross build. Set the target system before the
# first project() call so CMake does not inject host linker flags on macOS.
set(CMAKE_SYSTEM_NAME Generic)

project(boot NONE)

set(CMAKE_EXPORT_COMPILE_COMMANDS ON)
include(${CMAKE_CURRENT_LIST_DIR}/cmake/boot_standalone.cmake)
```

## Kconfig
```
# Define the boot-owned control store symbols before loading the shared SDK
# tree so standalone boot builds can reference them.
config BOOT_CONTROL_STORE_BASE_ADDR
    hex
    default 0x3003E000 if BOOT_ADB_SYNC
    default 0x30026000 if BOOT_OTA_SOURCE_TF
    default 0x3001A000 if BOOT_SECOND_STAGE && BOOT_OTA_PACKAGE
    default 0x30F00000

config BOOT_CONTROL_STORE_SIZE
    int
    default 4096

# Reuse the shared SDK configuration tree first, matching the sample project
# entry style, then overlay the boot-specific standalone fragments.
osource "$ARCS_BASE/Kconfig"

rsource "Kconfig.boot"
rsource "Kconfig.public"
rsource "src/Kconfig"
```

## Kconfig.boot
```
#
# Boot standalone Kconfig defaults that must stay local to the boot image build.
#

config BOOT_STANDALONE
    bool
    default y

config LINK_OPTION_LISTENAI_LIBRARY_GROUP
    bool
    default y

config ARCS_HAL_EXT_RAM_SECTION
    string
    default ".ramcode"

config MEM_PSRAM_BASE
    hex
    default 0x28000000

config MEM_PSRAM_SIZE
    hex
    default 0x00800000

config MAIN_TASK_STACK_SIZE
    int
    default 2048

config MAIN_TASK_PRIORITY
    int
    default 1

choice BOOT_APP_CORE
    prompt "Application target core"
    default BOOT_APP_CORE_CP
    help
      Select which core the application runs on.

config BOOT_APP_CORE_AUTO
    bool "Auto-detect from image header"
    help
      Read target core from the target_core field written by mkhdr -f.
      When the flag is absent (legacy image), falls back to the
      BOOT_APP_CORE_AUTO_FALLBACK choice below.

config BOOT_APP_CORE_CP
    bool "CP core (force)"
    help
      Always start the application on the CP core via software reset.
      Ignores image header flags.

config BOOT_APP_CORE_AP
    bool "AP core (force, direct call)"
    help
      Always call the application entry point directly on the AP core.
      Ignores image header flags.

endchoice

choice BOOT_APP_CORE_AUTO_FALLBACK
    prompt "Auto-detect fallback core (legacy image)"
    default BOOT_APP_CORE_AUTO_FALLBACK_CP
    depends on BOOT_APP_CORE_AUTO
    help
      When auto-detect is enabled but the app image does not contain
      a valid target core flag, fall back to this core selection.

config BOOT_APP_CORE_AUTO_FALLBACK_CP
    bool "CP core"

config BOOT_APP_CORE_AUTO_FALLBACK_AP
    bool "AP core"

endchoice
```

## Kconfig.public
```
#
# Public boot options: expose only BOOT_* knobs to the main
# application Kconfig tree and avoid leaking boot-internal defaults.
#
config BOOT_AP_ENTRY
    hex "AP entry"
    default 0

config BOOT_FACTORY_PARAMS
    bool "Boot application selected by factory parameters"
    default n
    help
      Read the FACT header from the factory parameter sector during boot_f.
      A valid header selects the configured factory-test image; otherwise the
      normal application address is used.

config BOOT_FACTORY_PARAMS_OFFSET
    hex "Factory parameter Flash offset"
    default 0x3E000
    depends on BOOT_FACTORY_PARAMS

config BOOT_FACTORY_TEST_OFFSET
    hex "Factory-test image Flash offset"
    default 0xA00000
    depends on BOOT_FACTORY_PARAMS

config BOOT_SECOND_STAGE
    bool "Enable boot second stage (boot_s)"
    default n
    help
        Enable the second boot stage which includes FreeRTOS, USB stack,
        ADB, display, and other advanced features.
        When disabled, boot_f jumps directly to the application.

config BOOT_DISPLAY
    bool "Bootloader LCD recovery indicator"
    default n
    select BOOT_SECOND_STAGE
    select LISA_DEVICE
    select LISA_DISPLAY_DEVICE
    select LISA_DISPLAY_BUS_SPI_4WIRE
    select LISA_DISPLAY_PANEL_ST7789P3
    select LISA_SPI0
    select LISA_GPIOA
    select LISA_GPIOB
    select LISA_PWM
    help
        Show a pre-rendered "recovery mode" indicator on the LCD when
        the bootloader enters recovery. Uses the LISA display stack
        (panel driver, SPI bus, PWM backlight).
        Currently wired for the arcs_mini ST7789P3 panel (spi0, GPIOA/B,
        pwm0); other board/panel combos must extend this option with
        their own select lines.

config BOOT_DISPLAY_MADCTL
    hex "Bootloader ST7789P3 MADCTL value"
    default 0x60
    range 0x00 0xFF
    depends on BOOT_DISPLAY
    help
      ST7789P3 memory access control value used by boot display init.
      The default preserves the existing arcs_mini recovery image rotation.

config BOOT_DISPLAY_POWER_KEY_HINT_POSITION
    int "Boot charging power-key hint position (keypad grid 1-9)"
    range 1 9
    default 7
    depends on BOOT_DISPLAY
    help
      Where the charging power-key hint arrow sits on screen, numbered
      like a phone keypad: 1/2/3 = top-left/top-center/top-right,
      4/6 = middle-left/middle-right, 7/8/9 = bottom-left/
      bottom-center/bottom-right. 5 (center) fails the build: it would
      overlap the centered charging image. The default 7 keeps the
      original arcs_mini bottom-left placement.

config BOOT_DISPLAY_POWER_KEY_HINT_DIRECTION
    int "Boot charging power-key hint direction (keypad grid, 5 invalid)"
    range 1 9
    default 4
    depends on BOOT_DISPLAY
    help
      Which way the hint arrow points, using the same phone keypad
      numbering: 2 = up, 4 = left, 6 = right, 8 = down, and 1/3/7/9 for
      the diagonals. 5 has no direction and fails the build. The default
      4 keeps the original arcs_mini left-pointing arrow.

config BOOT_ADB
    bool "Bootloader recovery ADB transport"
    default n
    select BOOT_SECOND_STAGE
    help
        Compile the bootloader ADB transport into boot_s for explicit
        recovery sessions only.
        Normal boot and automatic OTA second-stage handoff must not
        enumerate ADB through this option.

if BOOT_ADB

choice
    prompt "Bootloader recovery ADB backend"
    default BOOT_ADB_BACKEND_TINYUSB
    help
        Select the USB stack backend used by boot recovery ADB.

    config BOOT_ADB_BACKEND_TINYUSB
        bool "TinyUSB"
        select TINY_USB
        select TINY_USB_USE_CUSTOM_CONFIG_FILE
        select TUSB_APP_CLASS
        help
            Use the TinyUSB-based boot recovery ADB backend.

    config BOOT_ADB_BACKEND_CHERRYUSB
        bool "CherryUSB"
        select CHERRYUSB
        select CHERRYUSB_DEVICE
        select CHERRYUSB_APP_CLASS
        select ADB_PERF_MODE
        help
            Use the CherryUSB-based boot recovery ADB backend.

endchoice

endif

config BOOT_ADB_SHELL
    bool "Bootloader recovery ADB shell"
    default n
    depends on BOOT_ADB
    select SDK_MODULE_LETTER_SHELL
    select ARCS_HAL_CRYPTO
    help
        Enable the bootloader ADB shell for explicit recovery sessions.
        Applications should request this with BOOT_* knobs rather than
        enabling CONFIG_ADB_SHELL in the main app build.

config BOOT_ADB_SYNC
    bool "Bootloader recovery ADB sync"
    default n
    select BOOT_ADB
    select BOOT_ADB_SHELL
    select BOOT_RECOVERY
    select BOOT_EARLY_INIT
    select BOOT_EARLY_CLOCK_INIT
    select BOOT_EARLY_PSRAM_INIT
    select FILE_SYSTEM
    select LSFS
    select DISK_DRIVER
    help
        Enable recovery-only ADB push/pull and sync support in boot_s.
        Applications should request this through BOOT_* knobs. SDMMC raw
        access and TF filesystem mounting stay behind dedicated BOOT_* knobs
        so plain recovery ADB sessions do not pull them in implicitly.

config BOOT_ADB_SDMMC_RAW
    bool "Bootloader recovery ADB raw SDMMC access"
    default n
    depends on BOOT_ADB_SYNC
    select DISK_DRIVER_SDMMC
    help
        Enable `/RAW/SDRAW/...` access during boot recovery ADB sessions.
        Keep this disabled unless the recovery image must access raw TF
        sectors directly.

config BOOT_ADB_SDMMC_FS
    bool "Bootloader recovery ADB TF filesystem access"
    default n
    depends on BOOT_ADB_SYNC
    select FATFS_FILESYSTEM
    select LSFS_FAT
    select DISK_DRIVER_SDMMC
    help
        Enable TF FAT filesystem mounting for boot recovery ADB sessions and
        switch the default adb push/pull root to `/SD:/adb/`.

config BOOT_ADB_SDMMC_FS_ROOT
    string "Bootloader recovery ADB TF filesystem root"
    default "/SD:/adb/"
    depends on BOOT_ADB_SDMMC_FS
    help
        Filesystem root exposed to `adb push/pull` after the TF FAT
        filesystem is mounted for boot recovery.

config ADB_SHELL
    default y if BOOT_ADB_SHELL

config ADB_SYNC
    default y if BOOT_ADB_SYNC

config TINY_USB_CONFIG_FILE
    default "boot_tusb_config.h" if BOOT_ADB_BACKEND_TINYUSB

config ADB_PUSH_PULL_DEFAULT_ROOT
    default BOOT_ADB_SDMMC_FS_ROOT if BOOT_ADB_SDMMC_FS

config SDK_MODULE_LETTER_SHELL
    default y if BOOT_ADB_SHELL

config SDK_MODULE_LETTER_SHELL_CONFIG_FILE
    default "shell_cfg_user.h" if BOOT_ADB_SHELL

config BOOT_CP_ENTRY
    hex "CP entry"
    default 0
    depends on !MEM_CONFIG

config BOOT_DUAL_FLASH
    bool "Bootloader dual flash support"
    default n
    select DUAL_FLASH
    help
      Enable dual flash memory support in the bootloader.

config BOOT_FLASH_SIZE
    hex "Flash size"
    default 0x40000 if BOOT_ADB_SYNC
    default 0x28000 if BOOT_OTA_SOURCE_TF
    default 0x1C000 if BOOT_SECOND_STAGE && BOOT_OTA_PACKAGE
    default 0x4000 if BOOT_SECOND_STAGE
    default 0x2000

config BOOT_PARTAB_SIZE
    hex "Boot OTA partab size"
    default 0x1000
    depends on BOOT_OTA_PACKAGE
    help
      Reserve one flash page at the tail of the boot area for OTA partab and
      request metadata. The merge step subtracts this size from the boot image
      payload budget.

choice
    prompt "boot log level"
    default BOOT_LOG_LVL_NON

    config BOOT_LOG_LVL_NON
        bool "non"
    config BOOT_LOG_LVL_ERR
        bool "err"
    config BOOT_LOG_LVL_WRN
        bool "wrn"
    config BOOT_LOG_LVL_INF
        bool "inf"
    config BOOT_LOG_LVL_DBG
        bool "dbg"

endchoice

config BOOT_LOG
    bool "Boot UART logging"
    default y
    help
      Enable UART syslog initialization and the boot banner (version,
      commit, serial number, reset reason) emitted at boot_s entry.
      Disable to keep UART silent when the recovery image hands UART
      off to another consumer, or to trim boot time and code size.

config BOOT_EARLY_LOG
    bool "Emit boot_f (stage 1) raw UART log"
    default n
    help
      Enable raw UART character output from boot_f before scatload
      finishes. Bypasses syslog (which depends on .text in SRAM).
      Use for diagnosing early boot flow such as app address resolution
      or stage_gate decision. Disable in production.

config BOOT_UART_PORT
    int "boot log port"
    default 0

config BOOT_UART_TX_PIN
    int "boot uart tx pin"
    default 3

config BOOT_UART_BAUDRATE
    int "boot log baud rate"
    default CONSOLE_UART_BAUDRATE if CONSOLE_UART_BACKEND
    default 921600

config BOOT_UART_PIN_FUNC_SEL
    int "boot log pin func sel"
    default 2

menuconfig BOOT_CHECK_GPIO
    bool "GPIO Boot Check"
    default n
    help
      Enable GPIO boot check to determine the boot mode based on GPIO states.

if BOOT_CHECK_GPIO

config BOOT_CHECK_GPIO_PIN
    int "GPIO Boot Check Pin"
    default 0

config BOOT_CHECK_GPIO_PORT
    int "GPIO Boot Check Port"
    default 0

config BOOT_CHECK_GPIO_LEVEL
    int "GPIO Boot Check Level"
    default 0

endif

menuconfig BOOT_CHECK_POWER_KEY
    bool "Boot power-key GPIO check"
    default n
    select BOOT_SECOND_STAGE
    select BOOT_RECOVERY
    help
      Force entry into the boot recovery path when a power-key GPIO is
      held down, optionally gated on a USB-detect GPIO. Covers two user
      flows on arcs_mini-class boards:
        - plug USB while holding power key: enter recovery from off state
        - press reset while holding power key: enter recovery from on state
      The check runs once in boot_f, only driving recovery when all
      configured GPIOs match their active levels at that moment.

if BOOT_CHECK_POWER_KEY

config BOOT_CHECK_POWER_KEY_PORT
    int "Power key IOMUX pad (0 = PAD_A, 1 = PAD_B)"
    default 1
    range 0 1

config BOOT_CHECK_POWER_KEY_PIN
    int "Power key pin within the pad"
    default 4

config BOOT_CHECK_POWER_KEY_LEVEL
    int "Power key level considered 'pressed' (0 = active-low, 1 = active-high)"
    default 0
    range 0 1

config BOOT_CHECK_POWER_KEY_REQUIRE_USB
    bool "Also require USB-detect GPIO to be asserted"
    default y
    help
      When enabled, the power-key check only triggers recovery if an
      additional USB-detect GPIO is in its asserted level. Prevents a
      stuck power key from accidentally blocking normal boot when USB
      is not connected.

if BOOT_CHECK_POWER_KEY_REQUIRE_USB

config BOOT_CHECK_POWER_KEY_USB_PORT
    int "USB-det IOMUX pad (0 = PAD_A, 1 = PAD_B)"
    default 1
    range 0 1

config BOOT_CHECK_POWER_KEY_USB_PIN
    int "USB-det pin within the pad"
    default 0

config BOOT_CHECK_POWER_KEY_USB_LEVEL
    int "USB-det level considered 'plugged' (0 = active-low, 1 = active-high)"
    default 1
    range 0 1

endif

endif

menuconfig BOOT_POWER_GUARD
    bool "Stage0 power guard"
    default n
    select BOOT_SECOND_STAGE
    help
      Manage POWER_KEY/PWR_LOCK during stage0 boot. The guard can either
      require a POWER_KEY long-press before latching PWR_LOCK on cold boot,
      or latch immediately for products that should boot directly. Recovery
      gestures and boot_info.shutdown_req handling run entirely inside boot_f
      with bare-metal register access and the mcycle CSR.

if BOOT_POWER_GUARD

config BOOT_POWER_GUARD_LONG_PRESS_STARTUP
    bool "Require POWER_KEY long-press to start"
    default y
    help
      When enabled, keep the original startup policy: cold boot waits for a
      POWER_KEY long-press before normal boot, and USB-only cold boot enters
      the charging-wait path.

      When disabled, cold boot latches PWR_LOCK immediately and starts the
      application directly. PB+reset and PB+USB recovery gestures are still
      handled by the boot guard.

config BOOT_POWER_GUARD_KEY_PORT
    int "Power-key IOMUX pad (0 = PAD_A, 1 = PAD_B)"
    default 1
    range 0 1

config BOOT_POWER_GUARD_KEY_PIN
    int "Power-key pin within pad"
    default 4

config BOOT_POWER_GUARD_KEY_LEVEL
    int "Power-key level considered 'pressed' (0 = active-low, 1 = active-high)"
    default 0
    range 0 1

config BOOT_POWER_GUARD_LATCH_PORT
    int "PWR_LOCK IOMUX pad (0 = PAD_A, 1 = PAD_B)"
    default 1
    range 0 1

config BOOT_POWER_GUARD_LATCH_PIN
    int "PWR_LOCK pin within pad"
    default 3

config BOOT_POWER_GUARD_LATCH_ACTIVE_LEVEL
    int "PWR_LOCK level to latch on (0 or 1)"
    default 1
    range 0 1

config BOOT_POWER_GUARD_USB_PORT
    int "USB-detect IOMUX pad (0 = PAD_A, 1 = PAD_B)"
    default 1
    range 0 1

config BOOT_POWER_GUARD_USB_PIN
    int "USB-detect pin within pad"
    default 0

config BOOT_POWER_GUARD_USB_LEVEL
    int "USB-detect level considered 'plugged' (0 = active-low, 1 = active-high)"
    default 1
    range 0 1

config BOOT_POWER_GUARD_HOLD_TIME_MS
    int "Required PB hold time (ms)"
    default 3000

config BOOT_POWER_GUARD_SAMPLE_INTERVAL_MS
    int "PB sample interval (ms)"
    default 50

config BOOT_POWER_GUARD_LED
    bool "Drive boot indicator LED during guard"
    default n
    help
      Turn off the indicator LED while guard is waiting, turn it back on
      once the guard decides to continue booting (PB long-press satisfied
      or non-POR path through). Recovery entry and fake-shutdown spin
      leave the LED off.

if BOOT_POWER_GUARD_LED

config BOOT_POWER_GUARD_LED_PORT
    int "LED IOMUX pad (0 = PAD_A, 1 = PAD_B)"
    default 1
    range 0 1

config BOOT_POWER_GUARD_LED_PIN
    int "LED pin within pad"
    default 1

config BOOT_POWER_GUARD_LED_ACTIVE_LEVEL
    int "LED level considered 'on' (0 or 1)"
    default 0
    range 0 1

endif

endif

config BOOT_RECOVERY
    bool "Boot recovery logic"
    default n
    help
      Enable recovery checks in boot_f: watchdog timeout detection,
      soft/hard reboot requests, application header validation, and
      reboot counter management.

config BOOT_RECOVERY_API
    bool "Boot public recovery API"
    default n
    select BOOT_RECOVERY
    help
      Expose uboot recovery public API for app-side recovery request/reboot.
      This switch enables API integration without requiring boot image build.

config BOOT_WDT_API
    bool "Boot public watchdog API"
    default n
    help
      Expose uboot watchdog public API for app-side enable/disable/feed of the
      boot AP watchdog. This switch only enables the API surface; boot-side
      runtime watchdog behavior is still controlled by CONFIG_BOOT_WDT.

config BOOT_POWER_API
    bool "Boot public power API"
    default n
    help
      Expose uboot_shutdown_request() to the app. Sets boot_info.shutdown_req
      and triggers a software reset; stage0 power-guard spins on it.

config BOOT_FEATURES
    bool "Emit boot features descriptor for backward-compat probing"
    default n
    help
      Emit a 32-byte descriptor at CONFIG_BOOT_FEATURES_ADDR advertising the
      optional boot capabilities the image supports. Apps probe it via
      BOOT_FEATURES_API to decide whether to fall back to legacy behavior.

config BOOT_FEATURES_ADDR
    hex "Boot features descriptor flash address"
    default 0x30000180
    depends on BOOT_FEATURES || BOOT_FEATURES_API
    help
      Absolute flash address of the features descriptor, placed right after
      .vtable (ListenAI boot header inclusive). Used by both boot (to emit)
      and app (to read).

config BOOT_FEATURES_API
    bool "Boot public features query API"
    default n
    help
      Expose uboot_features_query() / uboot_features_has() to the app.
      Reads CONFIG_BOOT_FEATURES_ADDR and returns 0 on magic mismatch so
      apps can detect legacy boot images.

menuconfig BOOT_EARLY_INIT
    bool "Boot early initialization (stage 1)"
    default n
    help
      Enable early hardware initialization in boot_f (Flash XIP stage).

if BOOT_EARLY_INIT

config BOOT_EARLY_CLOCK_INIT
    bool "Early clock initialization"
    default n

config BOOT_EARLY_PSRAM_INIT
    bool "Early PSRAM initialization"
    default n

endif

menuconfig BOOT_OTA_PACKAGE
    bool "OTA package support"
    default n
    help
      Enable boot-side OTA package upgrade support.

config BOOT_OTA_API
    bool "Boot public OTA API"
    default n
    select LISA_DEVICE
    select LISA_FLASH
    help
      Expose uboot OTA public API for app-side OTA request/reboot.
      Boot-side package parsing and source handling remain internal.
      Store backend defaults to flash so APP-only projects do not need
      to select BOOT_CONTROL_STORE_* internals explicitly.

config BOOT_OTA_SOURCE_TF
    bool "Bootloader OTA source from TF card"
    default n
    depends on BOOT_OTA_PACKAGE && BOOT_SECOND_STAGE
    select FILE_SYSTEM
    select FATFS_FILESYSTEM
    select LSFS
    select LSFS_FAT
    select DISK_DRIVER
    select DISK_DRIVER_SDMMC
    help
      Enable boot-side OTA package reading from the default TF mount point.
      Request paths may be provided as `/SD:/download/update.txz`,
      `/download/update.txz`, or `download/update.txz`; boot normalizes the
      latter two forms to `/SD:/...` before opening the package. Projects that
      override `CONFIG_BOOT_FLASH_SIZE` should reserve at least `0x28000` for
      boot when this option is enabled.

choice BOOT_CONTROL_STORE
    prompt "Boot control store backend"
    default BOOT_CONTROL_STORE_FLASH if BOOT_OTA_API
    default BOOT_CONTROL_STORE_FLASH if BOOT_OTA_PACKAGE
    default BOOT_CONTROL_STORE_NONE

config BOOT_CONTROL_STORE_NONE
    bool "None (stub)"

config BOOT_CONTROL_STORE_FLASH
    bool "Direct Flash R/W"

config BOOT_CONTROL_STORE_TEST
    bool "In-memory test backend"

endchoice

if BOOT_CONTROL_STORE_FLASH || BOOT_OTA_API

config BOOT_CONTROL_STORE_BASE_ADDR
    hex "Boot control store base address"
    default 0x3003E000 if BOOT_ADB_SYNC
    default 0x30026000 if BOOT_OTA_SOURCE_TF
    default 0x3001A000 if BOOT_SECOND_STAGE && BOOT_OTA_PACKAGE
    default 0x30F00000
    help
      Flash base address reserved for the boot control store.
      Boot OTA builds default to the page right before the boot tail metadata
      so the control store stays between boot payload and the application
      image without consuming extra app flash space.

config BOOT_CONTROL_STORE_SIZE
    int "Boot control store size"
    default 4096
    help
      Size of the flash region reserved for the boot control store.
      Uses hybrid storage: register for boot_mode, flash for OTA request.

endif

config BOOT_WDT
    bool "Boot watchdog before jumping to app"
    default n
    help
      Enable the boot watchdog before jumping to app. This watchdog is connected
      to the AP core side, and is the AP watchdog used by boot and the public
      WDT API exposed to app-side projects.

menuconfig BOOT_VADDR_REMAP
    bool "Use vaddr_remap for application partition switching"
    default n

if BOOT_VADDR_REMAP

choice BOOT_VADDR_TARGET
    prompt "Remap target device"
    default BOOT_VADDR_TARGET_FLASH

config BOOT_VADDR_TARGET_FLASH
    bool "Flash"

config BOOT_VADDR_TARGET_PSRAM
    bool "PSRAM"

endchoice

choice BOOT_VADDR_REGION
    prompt "Default boot region"
    default BOOT_VADDR_REGION_A

config BOOT_VADDR_REGION_A
    bool "Region A (0x08000000)"

config BOOT_VADDR_REGION_B
    bool "Region B (0x10000000)"

config BOOT_VADDR_REGION_C
    bool "Region C (0x18000000)"

config BOOT_VADDR_REGION_D
    bool "Region D (0x1C000000)"

endchoice

config BOOT_VADDR_FLASH_OFFSET
    hex "Flash offset for boot region"
    default 0x20000

config BOOT_VADDR_PSRAM_COPY_SIZE
    hex "PSRAM copy size (bytes)"
    default 0x80000
    depends on BOOT_VADDR_TARGET_PSRAM

config BOOT_VADDR_RUNTIME_SELECT
    bool "Enable runtime partition selection"
    default n

endif
```

## prj.conf
```kconfig
CONFIG_ARCS_AP_CORE=y
CONFIG_HARTID=0

CONFIG_CONSOLE=n
CONFIG_LOG=n

CONFIG_MEM_SRAM_BASE=0x20050000
CONFIG_MEM_SRAM_SIZE=0x00060000
CONFIG_MEM_FLASH_BASE=0x30000000
CONFIG_MEM_FLASH_SIZE=0x0003F000
CONFIG_MEM_ILM_BASE=0x00080000
CONFIG_MEM_ILM_SIZE=0x00004000
CONFIG_MEM_DLM_BASE=0x00100000
CONFIG_MEM_DLM_SIZE=0x00002000
CONFIG_MEM_INTERRUPT_STACK_SIZE=0x2000
CONFIG_MEM_HEAP_SIZE=512
CONFIG_HEAP_SIZE=0x40000
CONFIG_PSRAM_HEAP_SIZE=0x60000
CONFIG_MODULE_FREERTOS=y
CONFIG_MODULE_HEAP=y

CONFIG_BOOT_CP_ENTRY=0x30001000
CONFIG_APPLICATION_ADDRESS=0x30001000

CONFIG_BOOT_EARLY_INIT=y
CONFIG_BOOT_EARLY_CLOCK_INIT=y
CONFIG_BOOT_EARLY_PSRAM_INIT=y
CONFIG_BOOT_LOG=y
CONFIG_ADB_MAX_PAYLOAD_SIZE=65536
CONFIG_FREERTOS_FAST_FUNC_SECTION=".text"
```

## src/main.c
```c
#include "xutils.h"
// #include <stdio.h>
#include <stdlib.h>
// #include <string.h>

#include "syslog.h"
#include "cache.h"
#include "PSRAMManager.h"
#include "ClockManager.h"
#include "PowerManager.h"
#include "Driver_WDT.h"
// #include "FreeRTOS.h"
// #include "task.h"
// #include "timers.h"
// #include "stdio.h"
#include "arcs_ap.h"

// #include "adb.h"
// #include "adb_device.h"
// #include "adb_shell.h"
// #include "adb_sync.h"
#include "boot_adb_runtime.h"
#include "boot_config.h"
#ifdef CONFIG_BOOT_ADB
#include "boot_recovery_adb_gate.h"
#endif
#ifdef CONFIG_BOOT_DISPLAY
#include "boot_display.h"
#endif
#include "boot_version.h"

#include "boot_flash.h"
#include "trng.h"
#include "IOMuxManager.h"
#include "Driver_GPIO.h"
#include "multi_heap.h"
#include "esp_heap_caps.h"
#ifdef CONFIG_BOOT_OTA_PACKAGE
#include "boot_config.h"
#include "boot_ota.h"
#include "boot_ota_handoff.h"
#include "boot_ota_lifecycle.h"
#include "boot_ota_request.h"
#include "boot_ota_source.h"
#endif
#include "boot_power_guard.h"
#ifdef CONFIG_BOOT_POWER_GUARD
#include "boot_config.h"
#endif

extern int boot_watchdog_feed(void);
extern int lisa_device_init(void);

#ifdef CONFIG_BOOT_ADB_SHELL
static void boot_flush_exec_range(const void *addr, uint32_t size)
{
    uintptr_t start = (uintptr_t)addr;
    uintptr_t line_mask = HAL_DCACHE_CFG_LINE_SIZE - 1U;
    uintptr_t aligned_start = start & ~line_mask;
    uintptr_t aligned_end = (start + size + line_mask) & ~line_mask;

    HAL_FlushDCache_by_Addr((uint32_t *)aligned_start, (uint32_t)(aligned_end - aligned_start));
    __asm__ volatile("fence.i");
}

int lisa_log_init(void);
#endif

#define BOOT_MAIN_TASK_STACK_WORDS 2048

/* stage1 内部所有 CMN reset 入口都应通过此 helper：先把 latch 切到 AON
 * IOMUX force-output，避免 CMN reset 期间 GPIO 外设复位让电池模式下
 * MOSFET 栅极掉电。public_api_contract.py 要求本文件直接出现
 * __HAL_PMU_WholeChip_RST_ENABLE() 字面量，故保留在此 helper 内部。 */
static void main_reboot_cmn(void)
{
    boot_power_guard_lock_latch_for_reset();
    __HAL_PMU_WholeChip_RST_ENABLE();
}

#if 0
static const uint32_t psram_size[] = {0, 32, 0, 64, 0, 128, 512, 256};

TimerHandle_t usb_conn_timer;
static bool usb_connected = false;

void tud_mount_cb(void)
{
    printf("USB device connected.\n");
    usb_connected = true;
}

void tud_umount_cb(void)
{
    printf("USB device disconnected.\n");
}

void vTimerCallback(TimerHandle_t xTimer)
{
    if (usb_connected) {
        return;
    }

    struct boot_info *info = (struct boot_info *)&IP_AON_CTRL->REG_AON_DIG_RSVD4.all;
    info->boot_wdt = 1;
    printf("USB connected timeout, reboot!\n");
    vTaskDelay(pdMS_TO_TICKS(200));

    __asm__ volatile("fence.i");
    /* 为防止看门狗无法复位, 冗余软件复位 */
    info->req = 1;
    main_reboot_cmn();
}

void usb_task(void *arg)
{
    printk("usb task\n");

    usb_connected = false;

    /* 10秒无连接, 重启 */
    usb_conn_timer = xTimerCreate("usb-conn", pdMS_TO_TICKS(10 * 1000), pdFALSE, (void *)0, vTimerCallback);
    if (usb_conn_timer == NULL) {
        printk("usb task: create timer failed\n");
        return;
    }
    xTimerStart(usb_conn_timer, 0);

    // enable usb clock
    IP_SYSCTRL->REG_PERI_CLK_CFG6.bit.ENA_USB_CLK = 0x01;
    IP_CMN_SYS->REG_USB_CTRL1.bit.USBPHY_OUTCLKSEL = 0x1;
    IP_CMN_SYS->REG_USB_CTRL1.bit.USBC_CFG_IDDIG = 0x1;   // Config "B" device
    IP_CMN_SYS->REG_USB_CTRL1.bit.UTMI_DATABUS16_8 = 0x1; // 16bit mode

    adb_init();

#if CONFIG_ADB_SHELL
    adb_shell_init();
#endif

#if CONFIG_ADB_SYNC
    adb_sync_init();
#endif

    tud_disconnect(); // soft-disconnect from host
    // Initialize TinyUSB
    tusb_init();
    tud_connect(); // soft-connect to host

    while (1) {
        extern int boot_watchdog_feed(void);
        boot_watchdog_feed();
        tud_task();
    }
}
#endif

static void heap_summary(void)
{
    void heap_summary_info(void);
    heap_summary_info();
}
static void task_summary(void)
{
    uint32_t tasks = uxTaskGetNumberOfTasks();
    TaskStatus_t *const items = exram_malloc(sizeof(uint32_t), tasks * sizeof(TaskStatus_t));
    if (items) {
        uint32_t total = 0;
        tasks = uxTaskGetSystemState(items, tasks, &total);
        if (total > 0) {
            TRACE("%20s %9s %9s %9s %18s %12s %9s"
                , "[TASK]", "[STA.]", "[PRIO.]", "[STK/B]", "[TOTAL]", "[CALL.]", "[PCT.%]");
            for (TaskStatus_t *stat = items; stat < &items[tasks]; stat++) {
                TRACE("%9s@%p %9s %9d %9d %9d@%9p %12d %8d%%", stat->pcTaskName, stat->xHandle
                    , ((const char *[]){"RUN", "RDY", "BLK", "SUS", "DEL" })[stat->eCurrentState]
                    , (int)stat->uxCurrentPriority, (int)stat->usStackHighWaterMark * sizeof(StackType_t)
                    , (stat->pxEndOfStack - stat->pxStackBase)* sizeof(StackType_t), stat->pxStackBase
                    , (int)stat->ulRunTimeCounter, (int)(100.0f * stat->ulRunTimeCounter / total));
            }
            TRACE("");
        }
        exram_free(items);
    }
}

static void heap_travel_cb(void *start, void *end, multi_heap_info_t *info)
{
    printf("%-12p\t%-12p\t%-12d\t%-12d\t%-12d\n", start, end, info->total_free_bytes, info->total_allocated_bytes,
           info->minimum_free_bytes);
}

static void heap_info(void)
{
    void heap_caps_travel(void (*callback)(void *, void *, multi_heap_info_t *));
    printf("**********************heap info**********************\n");
    printf("%-12s\t%-12s\t%-12s\t%-12s\t%-12s\n", "start", "end", "free", "used", "free(min)");
    heap_caps_travel(heap_travel_cb);
    printf("\n");
}

#ifdef CONFIG_BOOT_OTA_PACKAGE
static int boot_ota_update_handler(const uboot_ota_request_t *req,
                                   uboot_ota_failure_info_t *failure,
                                   void *ctx)
{
    boot_ota_source_t source;
    int ret;

    (void)ctx;

    if (boot_ota_source_from_request(req, &source, failure) != 0) {
        printk("ota: request source convert failed\n");
        return -1;
    }

    ret = boot_ota_txz_update_from_source(NULL, &source, failure);
    if (ret == BOOT_OTA_SOURCE_ERR_UNAVAILABLE) {
        printk("ota: source unavailable, discard request\n");
        return BOOT_OTA_LIFECYCLE_FAILED_DISCARD_REQUEST;
    }

    return ret;
}

static void boot_ota_try_handle_update(void)
{
    int result;

    if (boot_ota_request_get_mode() != BOOT_MODE_UPDATE) {
        if (boot_ota_request_has_pending()) {
            /* flash 里还挂着一份上轮 OTA 的请求记录，说明 lifecycle 没跑
             * 完；RSVD4 里的 mode 被硬复位 / POR 清掉了，把它写回 UPDATE
             * 让下面继续跑。这样"erase 到一半被硬复位"的设备能续上。*/
            printk("ota: resume pending request after mode reset\n");
            boot_ota_request_set_mode(BOOT_MODE_UPDATE);
        } else {
            if (boot_ota_handoff_has_pending_update()) {
                printk("ota: clear stale pending handoff and reboot\n");
                boot_ota_handoff_clear_pending_update();
                /* CMN reset：AON SW reset 在 stage1 外设全开上下文会触发
                 * stage0 第一次 flash 读 fault 复位循环，见 power-management
                 * §3.2。CMN reset 保留 boot_info；CMN reset 在本芯片上会顺
                 * 手置 POR_STATUS，guard 仅靠 POR 会把全 0 的 boot_info 当
                 * 冷启动 + USB → charging_wait，借 resume_normal_boot 给
                 * guard 一个明确的 warm 信号。*/
                struct boot_info *info = (struct boot_info *)&IP_AON_CTRL->REG_AON_DIG_RSVD4.all;
                info->resume_normal_boot = 1;
                main_reboot_cmn();
            }
            return;
        }
    }

#ifdef CONFIG_BOOT_DISPLAY
    boot_display_init();
    boot_display_show_ota();
#endif

    result = boot_ota_lifecycle_run(boot_ota_update_handler, NULL);
    if (result == BOOT_OTA_LIFECYCLE_IDLE) {
        return;
    }

    if (result == BOOT_OTA_LIFECYCLE_UPDATED) {
        boot_ota_handoff_clear_pending_update();
        /* 见 stale handoff 路径：清掉 ota_pending 之后 boot_info 全 0，
         * CMN reset 顺手置 POR 会让 guard 误判冷启动。置 resume_normal_boot
         * 给 guard 明确的 warm 信号。*/
        struct boot_info *info = (struct boot_info *)&IP_AON_CTRL->REG_AON_DIG_RSVD4.all;
        info->resume_normal_boot = 1;
        printk("ota: lifecycle updated, reboot\n");
        main_reboot_cmn();
        return;
    }

    if (result == BOOT_OTA_LIFECYCLE_DISCARDED) {
        boot_ota_handoff_clear_pending_update();
        printk("ota: lifecycle discarded, continue normal boot\n");
        return;
    }

    printk("ota: lifecycle failed, retry after reboot\n");
    /* 失败路径要进 recovery 让用户介入。先清掉 ota_pending 防 gate 走
     * OTA 重试无限循环（gate 现在看到 req=1 + ota_pending=1 会直接路
     * 由到 OTA handler）。recovery_software_enter 单独留 req=1，gate
     * 兜底成 HARD_REQ 进 recovery UI。CMN reset 同上。*/
    boot_ota_handoff_clear_pending_update();
    boot_recovery_software_enter();
    main_reboot_cmn();
}
#endif

void main_task(void *p)
{
#ifdef CONFIG_BOOT_ADB_SHELL
    extern void boot_handshake_detect_init(void);
    boot_handshake_detect_init();
#endif

    boot_watchdog_feed();

    /* 双flash需要使用此引脚 */
    IOMuxManager_PinConfigure(CSK_IOMUX_PAD_A, 11, CSK_IOMUX_FUNC_ALTER1);
    GPIO_Initialize(GPIOA(), NULL, NULL);

#ifdef CONFIG_BOOT_POWER_GUARD
    {
        struct boot_info *info = (struct boot_info *)&IP_AON_CTRL->REG_AON_DIG_RSVD4.all;
        if (info->charging_wait) {
            info->charging_wait = 0;

#ifdef CONFIG_BOOT_DISPLAY
            boot_display_init();
            boot_display_show_charging();
#endif
            /* 关机态插 USB：显示 3 秒充电提示后走 shutdown_req 进假关机自旋。
             * 期间持续轮询 POWER_KEY——用户在此时长按 3 秒就置 resume_normal_boot
             * 直接起系统，避免被迫先等这 3 秒过完、再经假关机态再长按 3 秒。
             * guard 入口已 latch(0)，期间拔 USB 则 VCC 掉 → 真关机。100ms
             * 粒度喂 boot watchdog，防它先超时把我们复位掉。*/
            const int tick_ms = 100;
            const int charging_total_ms = 3000;
            const int boot_hold_ms = 3000;
            int elapsed_ms = 0;
            int pb_held_ms = 0;
            bool confirm_boot = false;
            while (elapsed_ms < charging_total_ms || pb_held_ms > 0) {
                boot_watchdog_feed();
                vTaskDelay(pdMS_TO_TICKS(tick_ms));
                elapsed_ms += tick_ms;
                if (boot_power_guard_key_pressed()) {
                    pb_held_ms += tick_ms;
                    if (pb_held_ms >= boot_hold_ms) {
                        confirm_boot = true;
                        break;
                    }
                } else {
                    pb_held_ms = 0;
                }
            }
            if (confirm_boot) {
                info->resume_normal_boot = 1;
            } else {
                info->shutdown_req = 1;
            }
            main_reboot_cmn();
            while (1) {
                __asm__ volatile("wfi");
            }
        }
    }
#endif

#ifdef CONFIG_BOOT_DISPLAY
    {
        struct boot_info *info = (struct boot_info *)&IP_AON_CTRL->REG_AON_DIG_RSVD4.all;
        if (info->recover_reason != RECOVER_REASON_NONE) {
            boot_display_init();
            boot_display_show_recovery();
        }
    }
#endif

    boot_flash_init();
    /* set recover flag */
    boot_config_init();

#ifdef CONFIG_BOOT_OTA_PACKAGE
    boot_ota_try_handle_update();
#endif

#ifdef CONFIG_BOOT_ADB
    uint32_t boot_info_raw = IP_AON_CTRL->REG_AON_DIG_RSVD4.all;

    if (boot_recovery_adb_should_start(boot_info_raw)) {
        (void)boot_adb_runtime_start(boot_info_raw);
    } else {
        boot_adb_runtime_log_skip(boot_info_raw);
    }
#endif

#if CONFIG_DISK_DRIVER && !(CONFIG_BOOT_ADB && CONFIG_ADB_SYNC)
    /* Sync-enabled recovery ADB owns /SD: preparation before USB connect. */
    extern int disk_init(const void *dev);
    disk_init(NULL);
#endif

    uint32_t last_time = pdTICKS_TO_MS(xTaskGetTickCount());
    while (1) {
        extern int boot_watchdog_feed(void);
        boot_watchdog_feed();
        vTaskDelay(500);
#ifdef SHOW_HEAP_INFO
        uint32_t curr_time = pdTICKS_TO_MS(xTaskGetTickCount());
        if ((curr_time - last_time) >= 3000) {
            heap_info();
            last_time = curr_time;
        }
#endif
    }

    vTaskDelete(NULL);
}

static char id_str[16 + 1] = {0};
const char *device_id_str_get(void)
{
    uint8_t fake_id[6] = {0};

    if (strlen(id_str) != 0) {
        return id_str;
    }
    uint8_t *id_1 = (uint8_t *)0x48600208;
    uint8_t *id_2 = (uint8_t *)0x4860020c;
    int i;

    uint32_t *id1 = (uint32_t *)id_1;
    uint32_t *id2 = (uint32_t *)id_2;

    if (*id1 == 0 && *id2 == 0) {
        uint32_t olen = 0;
        trng_get(fake_id, 6, &olen);
        sprintf(id_str, "fake");
        char *s = id_str + 4;
        for (i = 0; i < 6; i++) {
            sprintf(s + i * 2, "%02x", fake_id[i]);
        }
    } else {
        for (i = 0; i < 8; i++) {
            sprintf(id_str + i * 2, "%02x", id_1[i]);
        }
        for (i = 0; i < 8; i++) {
            sprintf(id_str + i * 2 + 8, "%02x", id_2[i]);
        }
    }

    id_str[16] = '\0';

    return id_str;
}

void boot_mode_reason_print(void)
{
    const char *reason_str[RECOVER_REASON_MAX] = {
        "none", "soft req", "hard req", "app invalid", "ap wdt timeout", "boot wdt timeout",
    };

    struct boot_info *info = (struct boot_info *)&IP_AON_CTRL->REG_AON_DIG_RSVD4.all;
    const char *reason = info->recover_reason >= RECOVER_REASON_MAX ? "unknown" : reason_str[info->recover_reason];

    printk("boot reason: %s, handshake timeout: %d\n", reason, info->handshake_timeout);
}

static void mem_dump(uint8_t *addr, uint32_t size)
{
    uint32_t i;
    for (i = 0; i < size; i += 16) {
        boot_watchdog_feed();
        printk("%08x: ", addr + i);
        uint32_t j;
        for (j = 0; j < 16; j++) {
            printk("%02x ", addr[i + j]);
        }
        printk("\n");
    }
}

static void psram_test(void)
{
    uint8_t test[256];
    uint32_t olen = 0;
    int rt = trng_get(test, 256, &olen);
    if (rt != 0 || olen != 256) {
        printk("trng get failed, %d, %d\n", rt, olen);
        while (1) {
        }
    }

    uint8_t *addr = (uint8_t *)0x28000000;
    uint32_t size = 16 * 1024 * 1024;

    uint32_t i;
    for (i = 0; i < size; i += 256) {
        memcpy(addr + i, test, 256);
        boot_watchdog_feed();
        HAL_FlushDCache_by_Addr((uint32_t *)(addr + i), 256);
        __asm__ volatile("fence.i");
        HAL_InvalidateDCache_by_Addr((uint32_t *)(addr + i), 256);
        __asm__ volatile("fence.i");
        for (uint32_t j = 0; j < 256; j++) {
            if (addr[i + j] != test[j]) {
                printk("psram test failed, addr: 0x%08x\n", addr + i + j);
                mem_dump(addr + i, 256);
                boot_watchdog_feed();
                printk("test data: \n");
                mem_dump(test, 256);
                while (1) {
                }
            }
        }
    }

    printk("psram test passed\n");
}

void main(void)
{
#ifdef CONFIG_BOOT_LOG
    syslog_init(CONFIG_SYSLOG_UART_PORT, CONFIG_SYSLOG_UART_BAUDRATE);
#endif
    extern int boot_watchdog_init(void);
    boot_watchdog_init();
#ifdef CONFIG_BOOT_LOG
    printk("\n\n------------------------------------------------\n");
    printk("boot running...\n");
    printk("boot version: %d.%d.%d\n", VERSION_MAJOR, VERSION_MINOR, VERSION_BUILD);
    printk("boot commit: %s\n", VERSION_COMMIT);
    printk("chip cfg: 0x%04x\n", (*((uint32_t *)0x48600204) >> 15));
    printk("serial num: %s\n", device_id_str_get());
    boot_mode_reason_print();
#endif
    boot_watchdog_feed();

    extern int sysheap_init(void);
    sysheap_init();

#ifdef CONFIG_BOOT_DISPLAY
    /* 驱动被 relocate 到 PSRAM，先把代码/数据从 flash 拷过去；DCache 非一致，
     * 需要 flush 后 fence.i，下一次取指才能看到新代码。*/
    extern void scatload_psram(void);
    extern void HAL_FlushDCache_by_Addr(uint32_t *addr, uint32_t dsize);
    scatload_psram();
    HAL_FlushDCache_by_Addr((uint32_t *)CONFIG_MEM_PSRAM_BASE, CONFIG_MEM_PSRAM_SIZE);
    __asm__ volatile("fence.i");
#endif

#ifdef CONFIG_BOOT_ADB_SHELL
    boot_flush_exec_range((const void *)lisa_log_init, 256U);
    lisa_log_init();
#endif

#ifdef CONFIG_LISA_DEVICE
    lisa_device_init();
#endif

    // extern void trace_init(void);
    // trace_init();

    BaseType_t r = xTaskCreate(main_task, "main", BOOT_MAIN_TASK_STACK_WORDS, NULL, OS_PRIO_DEF, NULL);
    if (r != pdPASS) {
        printk("xTaskCreate failed\n");
        while (1) {
        }
    }
    vTaskStartScheduler();

    while (1) {
    }
}

#include "sys/stat.h"

__attribute__((weak, used)) int _kill(int pid, int sig)
{
    return -1;
}

__attribute__((weak, used)) int _stat(const char *file, struct stat *st)
{
    return -1;
}

__attribute__((weak, used)) int _lseek(int file, int ptr, int dir)
{
    return -1;
}

__attribute__((weak, used)) int _open(const char *name, int flags, int mode)
{
    return -1;
}

__attribute__((weak, used)) int _close(int file)
{
    return -1;
}

__attribute__((weak, used)) int _read(int file, char *ptr, int len)
{
    return -1;
}

__attribute__((weak, used)) _ssize_t _write(int file, char *ptr, size_t len)
{
    return -1;
}

/* Reentrant versions that call the base implementations */
__attribute__((weak, used)) int _fstat_r(struct _reent *r, int file, struct stat *st)
{
    return -1;
}

__attribute__((weak, used)) int _getpid_r(struct _reent *r)
{
    return -1;
}
__attribute__((weak, used)) int _getpid(void)
{
    return 1;
}
__attribute__((weak, used)) int _isatty(int fd)
{
    return 1;
}
```

## include/sha256.h
```c
#ifndef SHA256_H
#define SHA256_H

#include <stdint.h>

typedef void (*sha256_done_cb_t)(void *ctx, const uint8_t *data, uint32_t len, void *user_data);

void *sha256_init(sha256_done_cb_t callback, void *user_data);
int sha256_start(void *ctx);
int sha256_update(void *ctx, const void *data, uint32_t len);
int sha256_final(void *ctx, uint8_t out[32]);
void sha256_free(void *ctx);

#endif
```

## include/uboot_features.h
```c
#ifndef __UBOOT_FEATURES_H__
#define __UBOOT_FEATURES_H__

#ifdef __cplusplus
extern "C" {
#endif

#include <stdint.h>

#define UBOOT_FEATURES_MAGIC    0x55424F46u    /* "UBOF" */
#define UBOOT_FEATURES_VERSION  1u

#define UBOOT_FEATURE_OTA           (1u << 0)
#define UBOOT_FEATURE_POWER_GUARD   (1u << 1)

struct uboot_features_desc {
    uint32_t magic;
    uint32_t version;
    uint32_t size;
    uint32_t features;
    uint32_t reserved[4];
};

#ifdef __cplusplus
}
#endif

#endif /* __UBOOT_FEATURES_H__ */
```

## include/uboot_features_api.h
```c
#ifndef __UBOOT_FEATURES_API_H__
#define __UBOOT_FEATURES_API_H__

#ifdef __cplusplus
extern "C" {
#endif

#include <stdbool.h>
#include <stdint.h>

#include "uboot_features.h"

/* 返回 boot 在 CONFIG_BOOT_FEATURES_ADDR 声明的特性位。老 boot 无 descriptor
 * 时读到的 magic 不匹配，返回 0，上层据此回退到自带实现。结果单次启动内缓存。 */
uint32_t uboot_features_query(void);

bool uboot_features_has(uint32_t feature);

#ifdef __cplusplus
}
#endif

#endif /* __UBOOT_FEATURES_API_H__ */
```

## include/uboot_ota_api.h
```c
#ifndef __UBOOT_OTA_API_H__
#define __UBOOT_OTA_API_H__

#include <stdint.h>

#ifdef __cplusplus
extern "C" {
#endif

typedef enum {
    UBOOT_OTA_SOURCE_FLASH = 0,
    UBOOT_OTA_SOURCE_TF = 1,
} uboot_ota_source_t;

typedef enum {
    UBOOT_OTA_FAILURE_NONE = 0,
    UBOOT_OTA_FAILURE_BAD_REQUEST,
    UBOOT_OTA_FAILURE_SOURCE_UNAVAILABLE,
    UBOOT_OTA_FAILURE_SOURCE_IO,
    UBOOT_OTA_FAILURE_PACKAGE_INVALID,
    UBOOT_OTA_FAILURE_MANIFEST_INVALID,
    UBOOT_OTA_FAILURE_IMAGE_MISSING,
    UBOOT_OTA_FAILURE_IMAGE_VERIFY_FAILED,
    UBOOT_OTA_FAILURE_APPLY_FAILED,
    UBOOT_OTA_FAILURE_INTERNAL,
} uboot_ota_failure_reason_t;

typedef enum {
    UBOOT_OTA_FAILURE_DETAIL_NONE = 0,
    UBOOT_OTA_FAILURE_DETAIL_REQUEST_CONVERT_FAILED,
    UBOOT_OTA_FAILURE_DETAIL_FLASH_RANGE_INVALID,
    UBOOT_OTA_FAILURE_DETAIL_TF_PATH_INVALID,
    UBOOT_OTA_FAILURE_DETAIL_TF_OPEN_FAILED,
    UBOOT_OTA_FAILURE_DETAIL_SOURCE_READ_FAILED,
    UBOOT_OTA_FAILURE_DETAIL_PACKAGE_FORMAT_UNSUPPORTED,
    UBOOT_OTA_FAILURE_DETAIL_PACKAGE_TRUNCATED,
    UBOOT_OTA_FAILURE_DETAIL_TAR_PARSE_FAILED,
    UBOOT_OTA_FAILURE_DETAIL_MANIFEST_MISSING,
    UBOOT_OTA_FAILURE_DETAIL_MANIFEST_PARSE_FAILED,
    UBOOT_OTA_FAILURE_DETAIL_MANIFEST_SCHEMA_INVALID,
    UBOOT_OTA_FAILURE_DETAIL_IMAGE_ENTRY_MISSING,
    UBOOT_OTA_FAILURE_DETAIL_IMAGE_INCOMPLETE,
    UBOOT_OTA_FAILURE_DETAIL_IMAGE_MD5_NOT_VERIFIED,
    UBOOT_OTA_FAILURE_DETAIL_IMAGE_MD5_MISMATCH,
    UBOOT_OTA_FAILURE_DETAIL_PARTITION_NOT_FOUND,
    UBOOT_OTA_FAILURE_DETAIL_FLASH_ERASE_FAILED,
    UBOOT_OTA_FAILURE_DETAIL_FLASH_WRITE_FAILED,
    UBOOT_OTA_FAILURE_DETAIL_FLASH_VERIFY_FAILED,
    UBOOT_OTA_FAILURE_DETAIL_UNKNOWN,
} uboot_ota_failure_detail_t;

typedef struct uboot_ota_failure_info_t {
    uboot_ota_source_t source;
    uboot_ota_failure_reason_t reason;
    uboot_ota_failure_detail_t detail;
} uboot_ota_failure_info_t;

#define UBOOT_OTA_PATH_MAX 128

typedef struct {
    uboot_ota_source_t source;
    uint32_t package_size;
    union {
        struct {
            uint32_t flash_offset;
        } flash;
        struct {
            char path[UBOOT_OTA_PATH_MAX];
        } tf;
    };
} uboot_ota_request_t;

int uboot_ota_start(const uboot_ota_request_t *req);
int uboot_ota_start_from_flash(uint32_t flash_offset, uint32_t package_size);
int uboot_ota_start_from_tf(const char *path);
int uboot_ota_start_from_ota_partition(void);
int uboot_ota_get_last_failure(uboot_ota_failure_info_t *info);

#ifdef __cplusplus
}
#endif

#endif /* __UBOOT_OTA_API_H__ */
```

## include/uboot_power_api.h
```c
#ifndef __UBOOT_POWER_API_H__
#define __UBOOT_POWER_API_H__

#ifdef __cplusplus
extern "C" {
#endif

/* 置位 boot_info.shutdown_req 后触发软复位，stage0 电源守护识别标志后释放
 * PWR_LOCK 并自旋等 POWER_KEY 长按重启。用于 USB 维持 VCC 无法真关机的场景。*/
void uboot_shutdown_request(void) __attribute__((noreturn));

#ifdef __cplusplus
}
#endif

#endif /* __UBOOT_POWER_API_H__ */
```

## include/uboot_recovery_api.h
```c
#ifndef __UBOOT_RECOVERY_API_H__
#define __UBOOT_RECOVERY_API_H__

#ifdef __cplusplus
extern "C" {
#endif

typedef enum {
    UBOOT_RECOVERY_MODE_SOFT = 0,
    UBOOT_RECOVERY_MODE_HARD = 1,
} uboot_recovery_mode_t;

int uboot_recovery_request(uboot_recovery_mode_t mode);

#ifdef __cplusplus
}
#endif

#endif /* __UBOOT_RECOVERY_API_H__ */
```

## include/uboot_wdt_api.h
```c
#ifndef __UBOOT_WDT_API_H__
#define __UBOOT_WDT_API_H__

#ifdef __cplusplus
extern "C" {
#endif

int uboot_wdt_feed(void);
int uboot_wdt_enable(void);
int uboot_wdt_disable(void);

#ifdef __cplusplus
}
#endif

#endif /* __UBOOT_WDT_API_H__ */
```

## src/boot_adb_backend.h
```c
#ifndef __BOOT_ADB_BACKEND_H__
#define __BOOT_ADB_BACKEND_H__

#include <stdbool.h>

#include "boot_adb_runtime.h"

bool boot_adb_backend_bind_runtime_ops(boot_adb_runtime_ops_t *ops);

#endif /* __BOOT_ADB_BACKEND_H__ */
```

## src/boot_adb_backend_cherryusb.c
```c
#include "boot_adb_backend.h"

#include <stdint.h>

#include "adb_device.h"
#include "arcs_ap.h"
#include "syslog.h"
#include "usbd_core.h"

extern const struct usb_descriptor boot_adb_cherryusb_descriptor;
extern const uint8_t boot_adb_cherryusb_in_ep;
extern const uint8_t boot_adb_cherryusb_out_ep;

#define BOOT_ADB_CHERRYUSB_BUSID 0

static struct usbd_interface boot_adb_cherryusb_intf;

static void boot_adb_backend_cherryusb_soft_disconnect(void)
{
#ifdef USB_ARCS_POWER_SOFTCONN
    IP_USBC->POWER &= ~USB_ARCS_POWER_SOFTCONN;
#endif
}

static void boot_adb_backend_cherryusb_soft_connect(void)
{
#ifdef USB_ARCS_POWER_SOFTCONN
    IP_USBC->POWER |= USB_ARCS_POWER_SOFTCONN;
#endif
}

static void boot_adb_backend_cherryusb_event_handler(uint8_t busid, uint8_t event)
{
    (void)busid;

    switch (event) {
    case USBD_EVENT_RESET:
        printk("boot adb: usb reset backend=cherryusb\n");
        break;
    case USBD_EVENT_CONNECTED:
        printk("boot adb: usb connected backend=cherryusb\n");
        break;
    case USBD_EVENT_DISCONNECTED:
        printk("boot adb: usb disconnected backend=cherryusb\n");
        break;
    case USBD_EVENT_CONFIGURED:
        printk("boot adb: usb configured backend=cherryusb\n");
        break;
    default:
        break;
    }
}

static bool boot_adb_backend_cherryusb_usb_stack_init(void)
{
    usbd_desc_register(BOOT_ADB_CHERRYUSB_BUSID, &boot_adb_cherryusb_descriptor);
    usbd_add_interface(
        BOOT_ADB_CHERRYUSB_BUSID,
        adb_dev_init_intf(BOOT_ADB_CHERRYUSB_BUSID,
                          &boot_adb_cherryusb_intf,
                          boot_adb_cherryusb_in_ep,
                          boot_adb_cherryusb_out_ep));

    if (usbd_initialize(BOOT_ADB_CHERRYUSB_BUSID,
                        (uintptr_t)USBC_BASE,
                        boot_adb_backend_cherryusb_event_handler) != 0) {
        return false;
    }

    boot_adb_backend_cherryusb_soft_disconnect();
    return true;
}

static bool boot_adb_backend_cherryusb_usb_task_start(void)
{
    return true;
}

bool boot_adb_backend_bind_runtime_ops(boot_adb_runtime_ops_t *ops)
{
    if (ops == NULL) {
        return false;
    }

    ops->usb_stack_init = boot_adb_backend_cherryusb_usb_stack_init;
    ops->usb_task_start = boot_adb_backend_cherryusb_usb_task_start;
    ops->soft_disconnect = boot_adb_backend_cherryusb_soft_disconnect;
    ops->soft_connect = boot_adb_backend_cherryusb_soft_connect;
    return true;
}
```

## src/boot_adb_backend_tinyusb.c
```c
#include "boot_adb_backend.h"

#include "boot_config.h"

#include "FreeRTOS.h"
#include "syslog.h"
#include "task.h"
#include "tusb.h"

extern int boot_watchdog_feed(void);
void boot_tusb_appclass_force_link(void);

#define BOOT_ADB_USB_TASK_STACK_WORDS 1024

static StackType_t boot_adb_usb_task_stack[BOOT_ADB_USB_TASK_STACK_WORDS];
static StaticTask_t boot_adb_usb_task_tcb;

static bool boot_adb_backend_tinyusb_usb_stack_init(void)
{
    printk("boot adb: usb-stack-init backend=tinyusb inited=%d\n", tud_inited());
    boot_tusb_appclass_force_link();
    return tusb_init();
}

static void boot_adb_backend_tinyusb_usb_task(void *arg)
{
    (void)arg;

    for (;;) {
        boot_watchdog_feed();
        tud_task();
    }
}

static bool boot_adb_backend_tinyusb_usb_task_start(void)
{
#if defined(CONFIG_FREERTOS_STATIC_ALLOCATION_ENABLE)
    TaskHandle_t task = xTaskCreateStatic(
        boot_adb_backend_tinyusb_usb_task,
        "boot_adb_usb",
        BOOT_ADB_USB_TASK_STACK_WORDS,
        NULL,
        CONFIG_ADB_TASK_PRIORITY,
        boot_adb_usb_task_stack,
        &boot_adb_usb_task_tcb);

    return task != NULL;
#else
    BaseType_t created = xTaskCreate(
        boot_adb_backend_tinyusb_usb_task,
        "boot_adb_usb",
        BOOT_ADB_USB_TASK_STACK_WORDS,
        NULL,
        CONFIG_ADB_TASK_PRIORITY,
        NULL);

    return created == pdPASS;
#endif
}

static void boot_adb_backend_tinyusb_soft_disconnect(void)
{
    tud_disconnect();
}

static void boot_adb_backend_tinyusb_soft_connect(void)
{
    tud_connect();
}

bool boot_adb_backend_bind_runtime_ops(boot_adb_runtime_ops_t *ops)
{
    if (ops == NULL) {
        return false;
    }

    ops->usb_stack_init = boot_adb_backend_tinyusb_usb_stack_init;
    ops->usb_task_start = boot_adb_backend_tinyusb_usb_task_start;
    ops->soft_disconnect = boot_adb_backend_tinyusb_soft_disconnect;
    ops->soft_connect = boot_adb_backend_tinyusb_soft_connect;
    return true;
}
```
