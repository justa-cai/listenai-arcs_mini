## arcs-sdk/system/Kconfig
```kconfig
# Copyright (c) 2025, LISTENAI
# SPDX-License-Identifier: Apache-2.0

menu "SDK System Configuration"

config ARCS_STARTUP_CONFIG
	bool "ARCS system config"
	default y
	imply MODULE_FREERTOS
	imply MODULE_HEAP
	imply LOG
	imply ARCS_HAL_WARNING_DISABLE
	imply BOOT_HART

if ARCS_STARTUP_CONFIG

config MAIN_TASK_STACK_SIZE
	int "main task stack size"
	default 2048

config MAIN_TASK_PRIORITY
	int "main task priority"
	default 1

config BANNER
	bool "Print boot banner"
	default y
	help
		Print SDK version and hart-id at boot.

config BOOT
	bool "BOOT embedded"
	default y if ARCS_CP_CORE

endif # ARCS_STARTUP_CONFIG

config PRINTF_LOG_REDIRECT
	bool "Redirect printf to log system"
	depends on LOG
	help
		When enabled, printf/printk output will be redirected to the
		log system after log init. Before log init, output still goes
		through console backend directly.

rsource "init/Kconfig"
rsource "console/Kconfig"
rsource "backtrace/Kconfig"
rsource "cpp/Kconfig"
rsource "ringbuf/Kconfig"
rsource "heap/Kconfig"
rsource "workq/Kconfig"
rsource "log/Kconfig"
rsource "os/Kconfig"

if BOOT
	orsource "boot/Kconfig.boot"
endif

endmenu
```

## arcs-sdk/system/backtrace/Kconfig
```kconfig
# Copyright (c) 2025, LISTENAI
# SPDX-License-Identifier: Apache-2.0

menu "Exception & Backtrace"

config BACK_TRACE
	bool "backtrace support"
	help
		Enable the exception back trace

config EXCEPTION_REBOOT_IMMEDIATELY
	bool "reboot immediately in exception handler"

endmenu
```

## arcs-sdk/system/console/Kconfig
```kconfig
# Copyright (c) 2025, LISTENAI
# SPDX-License-Identifier: Apache-2.0

menu "Console"

config CONSOLE
	bool "Enable console subsystem"
	default y
	help
		Enable the console subsystem for stdout/stderr output.

menu "Console UART Backend"
	depends on CONSOLE

config CONSOLE_UART_BACKEND
	bool "Enable UART as console backend"
	default y
	select LISA_DEVICE
	select LISA_UART_DEVICE
	help
		Use UART device as the console output backend.

if CONSOLE_UART_BACKEND

config CONSOLE_UART_BAUDRATE
	int "UART baudrate"
	default 921600

config CONSOLE_UART_NAME
	string "UART device name for console"
	default "uart0"
	help
		The lisa_device name of the UART used for console output,
		e.g. "uart0", "uart1", "uart2".
		Note: the corresponding LISA_UARTx driver must be enabled.

config CONSOLE_UART0_SELECT
	bool
	default y if CONSOLE_UART_NAME = "uart0"
	select LISA_UART0

config CONSOLE_UART1_SELECT
	bool
	default y if CONSOLE_UART_NAME = "uart1"
	select LISA_UART1

config CONSOLE_UART2_SELECT
	bool
	default y if CONSOLE_UART_NAME = "uart2"
	select LISA_UART2

config CONSOLE_UART_EARLY_INIT
	bool
	default y
	help
		Hidden config. When console UART backend is enabled,
		the selected UART device should be initialized at EARLY level
		so it is available before heap/log init.

endif # CONSOLE_UART_BACKEND

endmenu

endmenu
```

## arcs-sdk/system/cpp/Kconfig
```kconfig
# Copyright (c) 2025, LISTENAI
# SPDX-License-Identifier: Apache-2.0

menu "C++ Support"

config LINK_CPP_RUNTIME_SECTIONS
	bool "link cpp runtime sections"
	default y
	help
		Link the C++ runtime sections

config CPP_INIT_DEFERRED
	bool "Defer cpp_init() to application code"
	depends on LINK_CPP_RUNTIME_SECTIONS
	help
		When disabled (default), cpp_init() is called automatically during
		entry() before the RTOS scheduler starts.

		When enabled, cpp_init() is NOT called in entry(). You must call
		cpp_init() manually in your application code. This allows time-critical
		tasks (e.g. camera startup) to run before C++ global constructors.

config CPP_EXCEPTIONS
	bool "Enable C++ exceptions"
	default y

endmenu
```

## arcs-sdk/system/init/Kconfig
```kconfig
# Copyright (c) 2025, LISTENAI
# SPDX-License-Identifier: Apache-2.0

menu "System Initialization"

config SYS_INIT
	bool "Enable system initialization framework"
	default y
	help
		Enable the SYS_INIT framework for multi-level system initialization.

		This framework provides 5 initialization levels that match ARCS boot flow:

		- PRE_SYSTEM_INIT:   BEFORE rom_copy_table_load (in soc_pre_init)
								WARNING: .data NOT copied, .bss NOT zeroed!
								DO NOT use global variables!
		- PRE_DEVICES_INIT:  Before lisa_device_init(), in system_entry()
		- PRE_KERNEL:        Before vTaskStartScheduler(), in system_entry()
		- POST_KERNEL:       After vTaskStartScheduler(), in main_task
		- PRE_APPLICATION:   Before main(), in main_task

		Use SYS_INIT macro to register initialization functions at different levels.

		If unsure, say Y.

config SYS_INIT_DEBUG
	bool "Enable system initialization debug output"
	depends on SYS_INIT
	help
		Enable detailed debug logging for system initialization.

endmenu
```

## arcs-sdk/system/log/Kconfig
```kconfig
# Copyright (c) 2025, LISTENAI
# SPDX-License-Identifier: Apache-2.0

menu "log configuration"

config LOG
	bool "enable log"

if LOG

choice
	prompt "log frontend"
	default LOG_FRONTEND_EASYLOGGER
	config LOG_FRONTEND_EASYLOGGER
		bool "easylogger frontend"
		select SDK_MODULE_EASYLOGGER
endchoice

config LOG_BACKEND_CONSOLE
	bool "console backend"
	default y

rsource "Kconfig.early_log"

config LOG_BACKEND_IPC_WRITER
	bool "IPC log writer backend"
	select ARCS_HAL_IPC
	select ARCS_HAL_IPC_PRINT_WRITER
	help
		Forward local logs to the peer core through the IPC debug ring buffer.
		Works on either IPC role (master or slave); the peer image must
		enable LOG_BACKEND_IPC_READER.

config LOG_BACKEND_IPC_READER
	bool "IPC log reader"
	select ARCS_HAL_IPC
	select ARCS_HAL_IPC_PRINT_READER
	help
		Receive peer-core logs from the IPC debug ring buffer and print them
		locally. Works on either IPC role (master or slave); the peer image
		must enable LOG_BACKEND_IPC_WRITER.

config LOG_BACKEND_SEGGER_RTT
	bool "SEGGER RTT backend"
	select SUPPORT_SEGGER_RTT
	help
		Enable SEGGER RTT as log backend.

config LOG_CLOG_EARLY_UART_FALLBACK
	bool "Route CLOG to early UART before lisa_log init"
	depends on SOC_EARLY_LOG
	default y
	help
		Route HAL CLOG/logDbg output to the SoC early UART logger before
		lisa_log_init() has initialized the normal EasyLogger frontend.
		After lisa_log_init(), CLOG/logDbg continues through the normal
		lisa_log path.

if LOG_BACKEND_IPC_WRITER

config LOG_BACKEND_IPC_NAME
	string "IPC log backend name"
	default "ipc.log"
	help
		Define the name of the IPC log backend.

config LOG_BACKEND_IPC_PREFIX
	string "IPC log prefix"
	default "[REMOTE] "
	help
		Prefix added to AP-side logs forwarded through the IPC backend.

config LOG_BACKEND_IPC_CACHE_SIZE
	int "IPC log backend cache size"
	default 4096
	range 256 65536
	help
		Size of the AP-side cache used before the IPC debug ring is ready.

endif

if LOG_BACKEND_SEGGER_RTT

config LOG_BACKEND_SEGGER_RTT_NAME
	string "SEGGER RTT log backend name"
	default "rtt.log"
	help
		Define the name of the SEGGER RTT log backend.
		This name will be used to identify the log backend in the system.

endif

config LOG_MODE_ASYNC
	bool "asynchronous mode"
	default y
	select EASYLOGGER_LOG_MODE_ASYNC if SDK_MODULE_EASYLOGGER
	help
		Enable asynchronous logging mode for better performance.
		Logs will be buffered and output in a separate task.

if LOG_MODE_ASYNC
config LOG_ASYNC_BUF_SIZE
	int "asynchronous buffer size"
	default 10240
	help
		Size of the buffer for asynchronous logging (in bytes).
		Larger buffer can handle more log messages but uses more memory.

config LOG_ASYNC_TASK_STACK_SIZE
	int "asynchronous task stack size"
	default 512
	help
		Stack size for the asynchronous logging task (in bytes).
		Increase this if you experience stack overflow in log task.

config LOG_ASYNC_TASK_PRIORITY
	int "asynchronous task priority"
	default 1
	help
		Priority of the asynchronous logging task.
		Higher value means higher priority (depends on your RTOS).
endif

config LOG_LINE_BUF_SIZE
	int "line buffer size"
	default 1024
	help
		Maximum size of a single log line (in bytes).
		Log messages longer than this will be truncated.

config LOG_USE_POSIX_TIME
	bool "use POSIX time"
	help
		Enable this to use POSIX time functions for timestamps.
		Requires POSIX time support in your system.

config LOG_BACKEND_SYS_NAME
	string "system log backend name"
	default "sys.log"
	help
		Define the name of the system log backend.
		This name will be used to identify the log backend in the system.
endif

choice
	prompt "log level"
	default LOG_LEVEL_INFO
	config LOG_LEVEL_ASSERT
		bool "assert"
		select EASYLOGGER_LOG_LEVEL_ASSERT if SDK_MODULE_EASYLOGGER
	config LOG_LEVEL_ERROR
		bool "error"
		select EASYLOGGER_LOG_LEVEL_ERROR if SDK_MODULE_EASYLOGGER
	config LOG_LEVEL_WARN
		bool "warning"
		select EASYLOGGER_LOG_LEVEL_WARN if SDK_MODULE_EASYLOGGER
	config LOG_LEVEL_INFO
		bool "info"
		select EASYLOGGER_LOG_LEVEL_INFO if SDK_MODULE_EASYLOGGER
	config LOG_LEVEL_DEBUG
		bool "debug"
		select EASYLOGGER_LOG_LEVEL_DEBUG if SDK_MODULE_EASYLOGGER
	config LOG_LEVEL_VERBOSE
		bool "verbose"
		select EASYLOGGER_LOG_LEVEL_VERBOSE if SDK_MODULE_EASYLOGGER
endchoice

endmenu
```

## arcs-sdk/system/log/Kconfig.early_log
```kconfig
# Copyright (c) 2026, LISTENAI
# SPDX-License-Identifier: Apache-2.0

config SOC_EARLY_LOG
	bool "Enable SoC early UART log"
	depends on (SOC_ARCS || SOC_VENUSA) && CONSOLE_UART_BACKEND
	help
		Enable a minimal polling UART logger in SoC startup. It reuses the
		console UART instance, baudrate and board pinmux, and is intended for
		messages that must be printed before PSRAM initialization and before
		the normal console/log backends are ready.
```

## arcs-sdk/system/os/Kconfig
```kconfig
# Copyright (c) 2025, LISTENAI
# SPDX-License-Identifier: Apache-2.0

menuconfig LISA_OS
	bool "lisa os adapt layer"
	select MODULE_FREERTOS
	select FREERTOS_STATIC_ALLOCATION_ENABLE
	help
		lisa os adapt layer
```

## arcs-sdk/system/ringbuf/Kconfig
```kconfig
# Copyright (c) 2025, LISTENAI
# SPDX-License-Identifier: Apache-2.0

config RINGBUF
	bool "Enable RINGBUF"
	help
		Enable RINGBUF
```

## arcs-sdk/system/uboot/src/Kconfig
```kconfig
rsource "Kconfig.syslog"

config APPLICATION_ADDRESS
    hex "Application Address"
    default 0x30200000
    help
    Specify the address where the application will be loaded.

config APPLICATION_DYNAMIC_ADDRESS
    hex "Application Dynamic Address"
    default 0x30FFF000
    help
    Specify the dynamic address where the application will be loaded.
```

## arcs-sdk/system/uboot/test/boot_adb_raw_flash_fastpath/testcase.yaml
```yaml
tests:
  test.boot_adb_raw_flash_fastpath:
    runner: linux
    builder: cmake
    log_analyzer: "unity"
```

## arcs-sdk/system/uboot/test/boot_adb_raw_policy/testcase.yaml
```yaml
tests:
  test.boot_adb_raw_policy:
    runner: linux
    builder: cmake
    log_analyzer: "unity"
```

## arcs-sdk/system/uboot/test/boot_adb_runtime/testcase.yaml
```yaml
tests:
  test.boot_adb_runtime:
    runner: linux
    builder: cmake
    log_analyzer: "unity"
```

## arcs-sdk/system/uboot/test/boot_recovery_adb_gate/testcase.yaml
```yaml
tests:
  test.boot_recovery_adb_gate:
    runner: linux
    builder: cmake
    log_analyzer: "unity"
```

## arcs-sdk/system/uboot/test/boot_stage_gate/testcase.yaml
```yaml
tests:
  test.boot_stage_gate:
    runner: linux
    builder: cmake
    log_analyzer: "unity"
```

## arcs-sdk/system/uboot/test/uboot_ota_api/testcase.yaml
```yaml
tests:
  test.uboot_ota_api:
    runner: linux
    builder: cmake
    log_analyzer: "unity"
```

## arcs-sdk/system/uboot/test/uboot_recovery_api/testcase.yaml
```yaml
tests:
  test.uboot_recovery_api:
    runner: linux
    builder: cmake
    log_analyzer: "unity"
```

## arcs-sdk/system/uboot/test/uboot_wdt_api/testcase.yaml
```yaml
tests:
  uboot.api.wdt:
    platform_allow: native_sim
    tags:
      - uboot
      - api
      - wdt
```

## arcs-sdk/system/workq/Kconfig
```kconfig
# Copyright (c) 2025, LISTENAI
# SPDX-License-Identifier: Apache-2.0

menu "work_queue"

config WORK_QUEUE
	bool "Enable work queue component"
	help
		Enable the work queue component for asynchronous task execution.

endmenu
```

## arcs-sdk/test/components/adb_sync_stage_host/testcase.yaml
```yaml
tests:
  test.adb_sync_stage_host:
    runner: linux
    builder: cmake
    log_analyzer: "unity"
```

## arcs-sdk/test/components/exclib/testcase.yaml
```yaml
tests:
  test.components.exclib:
    programmer: arcs
    runner: uart
    log_analyzer: Unity
    
```

## arcs-sdk/test/components/lisa_bluetooth/testcase.yaml
```yaml
tests:
  test.components.lisa_bluetooth:
    programmer: arcs
    runner: uart
    log_analyzer: Unity
```
