## arcs-sdk/components/acomp/translation/Kconfig
```kconfig
# Copyright (c) 2025, LISTENAI
# SPDX-License-Identifier: Apache-2.0

if ACOMP_TRANSLATION

	config ACOMP_TRANS_RES_ENCN_ENC_A_EMMC_ADDR
		hex "Translation ENCN encoder A eMMC address"
		default 0x0

	config ACOMP_TRANS_RES_ENCN_ENC_A_SIZE
		int "Translation ENCN encoder A size (bytes)"
		default 3306480

	config ACOMP_TRANS_RES_ENCN_ENC_B_EMMC_ADDR
		hex "Translation ENCN encoder B eMMC address"
		default 0x328000

	config ACOMP_TRANS_RES_ENCN_ENC_B_SIZE
		int "Translation ENCN encoder B size (bytes)"
		default 3286864

	config ACOMP_TRANS_RES_ENCN_ENC_C_EMMC_ADDR
		hex "Translation ENCN encoder C eMMC address"
		default 0x64b000

	config ACOMP_TRANS_RES_ENCN_ENC_C_SIZE
		int "Translation ENCN encoder C size (bytes)"
		default 3286864

	config ACOMP_TRANS_RES_ENCN_ENC_D_EMMC_ADDR
		hex "Translation ENCN encoder D eMMC address"
		default 0x96e000

	config ACOMP_TRANS_RES_ENCN_ENC_D_SIZE
		int "Translation ENCN encoder D size (bytes)"
		default 3286864

	config ACOMP_TRANS_RES_ENCN_ENC_E_EMMC_ADDR
		hex "Translation ENCN encoder E eMMC address"
		default 0xc91000

	config ACOMP_TRANS_RES_ENCN_ENC_E_SIZE
		int "Translation ENCN encoder E size (bytes)"
		default 3286864

	config ACOMP_TRANS_RES_ENCN_ENC_F_EMMC_ADDR
		hex "Translation ENCN encoder F eMMC address"
		default 0xfb4000

	config ACOMP_TRANS_RES_ENCN_ENC_F_SIZE
		int "Translation ENCN encoder F size (bytes)"
		default 3561152

	config ACOMP_TRANS_RES_ENCN_DEC_EMMC_ADDR
		hex "Translation ENCN decoder eMMC address"
		default 0x131a000

	config ACOMP_TRANS_RES_ENCN_DEC_SIZE
		int "Translation ENCN decoder size (bytes)"
		default 4429216

	config ACOMP_TRANS_RES_ENCN_DEC_EMB_EMMC_ADDR
		hex "Translation ENCN decoder embedding eMMC address"
		default 0x1754000

	config ACOMP_TRANS_RES_ENCN_DEC_EMB_SIZE
		int "Translation ENCN decoder embedding size (bytes)"
		default 1936384

	config ACOMP_TRANS_RES_ENCN_ENC_EMB_EMMC_ADDR
		hex "Translation ENCN encoder embedding eMMC address"
		default 0x192d000

	config ACOMP_TRANS_RES_ENCN_ENC_EMB_SIZE
		int "Translation ENCN encoder embedding size (bytes)"
		default 1936384

	config ACOMP_TRANS_RES_CNEN_ENC_A_EMMC_ADDR
		hex "Translation CNEN encoder A eMMC address"
		default 0x1b06000

	config ACOMP_TRANS_RES_CNEN_ENC_A_SIZE
		int "Translation CNEN encoder A size (bytes)"
		default 3306480

	config ACOMP_TRANS_RES_CNEN_ENC_B_EMMC_ADDR
		hex "Translation CNEN encoder B eMMC address"
		default 0x1e2e000

	config ACOMP_TRANS_RES_CNEN_ENC_B_SIZE
		int "Translation CNEN encoder B size (bytes)"
		default 3286864

	config ACOMP_TRANS_RES_CNEN_ENC_C_EMMC_ADDR
		hex "Translation CNEN encoder C eMMC address"
		default 0x2151000

	config ACOMP_TRANS_RES_CNEN_ENC_C_SIZE
		int "Translation CNEN encoder C size (bytes)"
		default 3286864

	config ACOMP_TRANS_RES_CNEN_ENC_D_EMMC_ADDR
		hex "Translation CNEN encoder D eMMC address"
		default 0x2474000

	config ACOMP_TRANS_RES_CNEN_ENC_D_SIZE
		int "Translation CNEN encoder D size (bytes)"
		default 3286864

	config ACOMP_TRANS_RES_CNEN_ENC_E_EMMC_ADDR
		hex "Translation CNEN encoder E eMMC address"
		default 0x2797000

	config ACOMP_TRANS_RES_CNEN_ENC_E_SIZE
		int "Translation CNEN encoder E size (bytes)"
		default 3286864

	config ACOMP_TRANS_RES_CNEN_ENC_F_EMMC_ADDR
		hex "Translation CNEN encoder F eMMC address"
		default 0x2aba000

	config ACOMP_TRANS_RES_CNEN_ENC_F_SIZE
		int "Translation CNEN encoder F size (bytes)"
		default 3561152

	config ACOMP_TRANS_RES_CNEN_DEC_EMMC_ADDR
		hex "Translation CNEN decoder eMMC address"
		default 0x2e20000

	config ACOMP_TRANS_RES_CNEN_DEC_SIZE
		int "Translation CNEN decoder size (bytes)"
		default 4429216

	config ACOMP_TRANS_RES_CNEN_DEC_EMB_EMMC_ADDR
		hex "Translation CNEN decoder embedding eMMC address"
		default 0x325a000

	config ACOMP_TRANS_RES_CNEN_DEC_EMB_SIZE
		int "Translation CNEN decoder embedding size (bytes)"
		default 1936384

	config ACOMP_TRANS_RES_CNEN_ENC_EMB_EMMC_ADDR
		hex "Translation CNEN encoder embedding eMMC address"
		default 0x3433000

	config ACOMP_TRANS_RES_CNEN_ENC_EMB_SIZE
		int "Translation CNEN encoder embedding size (bytes)"
		default 1936384

endif
```

## arcs-sdk/components/acomp/tuner/Kconfig
```kconfig
# Copyright (c) 2025, LISTENAI
# SPDX-License-Identifier: Apache-2.0

if ACOMP_TUNER

	config ACOMP_TUNER_STREAM_BUFFER_SIZE
		int "Tuner stream buffer size"
		default 2560

	config ACOMP_TUNER_STREAM_NUM_DESCS
		int "Tuner stream descriptor count"
		default 16

endif
```

## arcs-sdk/components/acomp/wakeup/Kconfig
```kconfig
if ACOMP_WAKEUP
    choice ACOMP_WAKEUP_ALGORITHM_TYPE
        prompt "Wakeup type"
        default ACOMP_WAKEUP_ALGORITHM_TYPE_SINGLE_MIC
        
        config ACOMP_WAKEUP_ALGORITHM_TYPE_SINGLE_MIC
            bool "Single mic wakeup algorithm"
        
        config ACOMP_WAKEUP_ALGORITHM_TYPE_DUAL_MIC
            bool "dual mic wakeup algorithm"

    endchoice

    config ACOMP_WAKEUP_RES_CAE_ESR_MLP_ADDRESS
        hex "cae esr mlp address"
        default 0xcd00000
    config ACOMP_WAKEUP_RES_CAE_ESR_MLP_LENGTH
        int "cae esr mlp length"
        default 419904
    config ACOMP_WAKEUP_RES_AI_WRAP_ADDRESS
        hex "ai wrap address"
        default 0xcd00000
    config ACOMP_WAKEUP_RES_AI_WRAP_LENGTH
        int "ai wrap length"
        default 419904

endif
```

## arcs-sdk/components/acomp/xtts/Kconfig
```kconfig
# Copyright (c) 2025, LISTENAI
# SPDX-License-Identifier: Apache-2.0

if ACOMP_XTTS

	config ACOMP_XTTS_RES_CNCN_DICT_EMMC_ADDR
		hex "XTTS CN dict eMMC address"
		default 0x5f00000

	config ACOMP_XTTS_RES_CNCN_DICT_SIZE
		int "XTTS CN dict size (bytes)"
		default 3166858

	config ACOMP_XTTS_RES_ENUS_DICT_EMMC_ADDR
		hex "XTTS EN dict eMMC address"
		default 0x6400000

	config ACOMP_XTTS_RES_ENUS_DICT_SIZE
		int "XTTS EN dict size (bytes)"
		default 2470275

	config ACOMP_XTTS_RES_CRF_EMMC_ADDR
		hex "XTTS CRF eMMC address"
		default 0x6900000

	config ACOMP_XTTS_RES_CRF_SIZE
		int "XTTS CRF size (bytes)"
		default 7791842

	config ACOMP_XTTS_RES_FRONT_USER_EMMC_ADDR
		hex "XTTS front user dict eMMC address"
		default 0x360c000

	config ACOMP_XTTS_RES_FRONT_USER_SIZE
		int "XTTS front user dict size (bytes)"
		default 3082688

	config ACOMP_XTTS_RES_REAR_EMMC_ADDR
		hex "XTTS rear model eMMC address"
		default 0x7d00000

	config ACOMP_XTTS_RES_REAR_SIZE
		int "XTTS rear model size (bytes)"
		default 4273824

	config ACOMP_XTTS_RES_REAR_NHV_EMMC_ADDR
		hex "XTTS rear NHV eMMC address"
		default 0x8200000

	config ACOMP_XTTS_RES_REAR_NHV_SIZE
		int "XTTS rear NHV size (bytes)"
		default 284992

	config ACOMP_XTTS_RES_ROLE_RESID
		int "XTTS role resource ID in flash resmgr"
		default 5

	config ACOMP_XTTS_RES_FRONT_RESID
		int "XTTS front resource ID in flash resmgr"
		default 6

	config ACOMP_XTTS_STREAM_BUFFER_SIZE
		int "XTTS stream buffer size"
		default 8192

	config ACOMP_XTTS_STREAM_NUM_DESCS
		int "XTTS stream descriptor count"
		default 32

endif
```

## arcs-sdk/components/app_player/Kconfig
```kconfig
# Copyright (c) 2025, LISTENAI
# SPDX-License-Identifier: Apache-2.0

menuconfig APP_PLAYER
    bool "Enable APP Player"
    default n
    select LISA_OS
    select LOG
    select LISA_AUDIO_DEVICE
    select LISA_DEVICE
    select SDK_MODULE_SPEEXDSP
    select SDK_MODULE_MP3_DECODER
    select SDK_MODULE_AAC_DECODER
    select SDK_MODULE_MEMPOOL
    select MODULE_ZE_TLS
    select MODULE_HTTPCLIENT
    select SDK_MODULE_COREHTTP
    select LISA_HTTP
    select LWIP
    select SYSLOG_PRINTK_REDIRECT
    help
      Enable the APP Player component.

if APP_PLAYER

config APP_PLAYER_PA_OFF_DELAY_MS
    int "PA off delay time in milliseconds"
    default 1000
    range 0 10000
    help
      Delay time before turning off PA (Power Amplifier) after playback stops.
      Set to 0 for immediate PA off, or set a delay to avoid pop noise.
      Default is 1000ms (1 second).

config APP_PLAYER_CALLBACK_THREAD_STACK_SIZE
    int "Callback thread stack size"
    default 4096
    range 1024 16384
    help
      Stack size for the callback thread that handles player events.
      Default is 4096 bytes.

config APP_PLAYER_CALLBACK_THREAD_PRIORITY
    int "Callback thread priority"
    default 5
    range 0 32
    help
      Priority for the callback thread that handles player events.
      Lower values indicate higher priority.
      Default is 5.

config APP_PLAYER_AUDIO_FOCUS
    bool "Enable audio focus management"
    default n
    help
      Enable audio focus management for coordinating multiple player instances.
      When enabled, players can have different priorities and automatically
      handle focus acquisition and release (e.g., pause music when playing tone).

      Features:
      - Priority-based focus arbitration
      - Automatic focus state transitions (FOREGROUND/BACKGROUND/NONE)
      - Customizable focus change callbacks
      - Capture rules for channel preemption

      If disabled, all focus-related APIs will be unavailable and the code
      footprint will be reduced.

endif # APP_PLAYER
```

## arcs-sdk/components/camera/Kconfig
```kconfig
menuconfig COMPONENT_CAMERA
    bool "camera component"
    default n
    help
        camera component

if COMPONENT_CAMERA 
    choice CAMERA_INTERFACE
        prompt "Select camera interface"
        default CAMERA_INTERFACE_SPI

        config CAMERA_INTERFACE_SPI
            bool "SPI"
            help
                use SPI interface

        config CAMERA_INTERFACE_DVP
            bool "DVP"
            help
                use dvp interface
    endchoice
    
    if CAMERA_INTERFACE_SPI
        choice
            prompt "Select SPI interface"
            default SPI_INTERFACE_NORM
            config SPI_INTERFACE_VIC
                bool "vic spi interface"
                depends on CAMERA_INTERFACE_SPI
                help
                    use vic spi interface
            config SPI_INTERFACE_NORM
                bool "normal spi interface"
                depends on CAMERA_INTERFACE_SPI
                help
                    use normal spi interface
        endchoice
    endif

    config BF3901_SUPPORT
        bool "BF3901"
        default y
    
    config GC032A_SUPPORT
        bool "GC032A"
        default n
    
    config GC0328_SUPPORT
        bool "GC0328"
        default n

endif # COMPONENT_CAMERA
```

## arcs-sdk/components/cherryusb-appclass/Kconfig
```kconfig
# Copyright (c) 2026, LISTENAI
# SPDX-License-Identifier: Apache-2.0

menu "cherry usb app class"

config CHERRYUSB_APP_CLASS
	bool "cherry usb app class"
	depends on CHERRYUSB && CHERRYUSB_DEVICE && !TUSB_APP_CLASS
	help
		Enable app-level USB classes implemented on CherryUSB.

if CHERRYUSB_APP_CLASS
	rsource "adb/Kconfig"
endif

endmenu
```

## arcs-sdk/components/cherryusb-appclass/adb/Kconfig
```kconfig
# Copyright (c) 2025, LISTENAI
# SPDX-License-Identifier: Apache-2.0

menu "adb"

config ADB
	bool "adb"

config ADB_MAX_PAYLOAD_SIZE
	int "adb max payload size"
	default 51200
	range 1024 65536

config ADB_PERF_MODE
	bool "ADB performance mode (uses more SRAM)"
	depends on ADB
	help
	  Enable performance mode for ADB device transport.
	  In this mode, the USB RX drop buffer is sized to MAX_PAYLOAD
	  (CONFIG_ADB_MAX_PAYLOAD_SIZE, default 50 KiB), allowing the host
	  to be drained in a single USB transfer when packet allocation fails.

	  When disabled (default), the drop buffer is one USB bulk packet
	  (ADB_BULK_PACKET_SIZE, 512 B in HS mode), matching the static SRAM
	  footprint of the pre-refactor implementation. Sufficient for normal
	  use; packet allocation failures on the drop path are rare.

config ADB_TASK_PRIORITY
	int "adb task priority"
	default 5

config ADB_SYNC
	bool "adb sync"
	select ADB
	select LSFS

config ADB_REBOOT
	bool "adb reboot"
	select ADB

config ADB_SHELL
	bool "adb shell"
	select ADB

config ADB_SHELL_BUFFER_SIZE
	int "adb shell buffer size"
	default 4096

config ADB_SHELL_EARLY_LOG
	bool "Cache early boot logs for ADB shell"
	default y
	depends on ADB_SHELL
	help
		Enable caching of early boot logs before ADB shell is connected.
		Logs are stored in a PSRAM buffer and flushed to ADB shell on
		first connection. Dropped messages are counted and reported.

config ADB_SHELL_EARLY_LOG_SIZE
	int "Early log buffer size in bytes"
	default 16384
	depends on ADB_SHELL_EARLY_LOG
	help
		Size of the PSRAM buffer for caching early boot logs.
		Typical log lines are 60-100 bytes, so 4096 bytes holds
		about 40-65 lines. Increase if boot logs are truncated.

config ADB_PUSH_PULL_DEFAULT_ROOT
	string "adb push/pull default root"
	default "/RAM:/adb/"
	depends on ADB_SYNC

endmenu
```

## arcs-sdk/components/core_spinlock/Kconfig
```kconfig
# Copyright (c) 2025, LISTENAI
# SPDX-License-Identifier: Apache-2.0

config CORE_SPINLOCK
	bool "core spinlock support"
```

## arcs-sdk/components/dirent/Kconfig
```kconfig
# Copyright (c) 2025, LISTENAI
# SPDX-License-Identifier: Apache-2.0

menu "Custom dirent.h"

config DIRENT
	bool "custom <dirent.h>"
	select LSFS
	select MODULE_HEAP

config DIRENT_EMPTY_IMPLEMENTATION
	bool "empty implementation"

endmenu
```

## arcs-sdk/components/display/Kconfig
```kconfig
menu "display configuration"

    config LISA_DISPLAY
        bool "display support"
        default n

if LISA_DISPLAY

    choice LISA_DISPLAY_DEVICE
        prompt "lisa display device"
        default LISA_DISPLAY_ST77926

        config LISA_DISPLAY_AXS15231B
            bool "LCD AXS15231B"

        config LISA_DISPLAY_ST77926
            bool "LCD ST77926"

        config LISA_DISPLAY_ST7789P3
            bool "LCD ST7789p3"
        
        config LISA_DISPLAY_GC9309NA
            bool "LCD GC9309NA"

        config LISA_DISPLAY_ST7789V
            bool "LCD ST7789v"

        config LISA_DISPLAY_NV3030B
            bool "LCD NV3030B"

        config LISA_DISPLAY_GC9A01
            bool "LCD GC9A01"

        config LISA_DISPLAY_UC8253C
            bool "LCD UC8253C"
            select LISA_DISPLAY_INTERFACE_SPI_4_LINE
            select LISA_DISPLAY_BUSY_SYNC

    endchoice

    config LISA_DISPLAY_TE_SYNC
        bool "Enable LCD TE pin synchronization"
        default n
        help
            If enabled, display update will be synchronized with LCD TE signal.
            This helps to prevent screen tearing effects.

    config LISA_DISPLAY_BUSY_SYNC
        bool "Enable EPD BUSY pin synchronization"
        default n
        help
            If enabled, EPD update will be synchronized with EPD BUSY signal.
            This helps to prevent updating display when EPD is busy.

    config LISA_DISPLAY_CPDMA_ROTATE
        bool "Enable LCD CPDMA rotate"
        default n
        help
            If enabled, CPDMA will rotate display.

    config LISA_DISPLAY_CPDMA_CH
        int "CPDMA channel"
        default 2
        depends on LISA_DISPLAY_CPDMA_ROTATE

    choice LISA_DISPLAY_BRIGHTNESS_TYPE
        prompt "lisa display brightness type"
        default LISA_DISPLAY_BRIGHTNESS_TYPE_PWM

        config LISA_DISPLAY_BRIGHTNESS_TYPE_PWM
            bool "LCD Brightness Type PWM"

        config LISA_DISPLAY_BRIGHTNESS_TYPE_WIRE_DIMMING
            bool "LCD Brightness Type Wire Dimming"
    endchoice
            
            
endif # LISA_DISPLAY

endmenu

rsource "Kconfig.axs15231b"
rsource "Kconfig.st77926"
rsource "Kconfig.st7789p3"
rsource "Kconfig.st7789v"
rsource "Kconfig.gc9309na"
rsource "Kconfig.nv3030b"
rsource "Kconfig.gc9a01"
rsource "Kconfig.uc8253c"
rsource "trans_ctx/Kconfig.trans_ctx"
```
