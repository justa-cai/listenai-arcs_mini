## arcs-sdk/boards/arcs_mini/Kconfig
```kconfig
# Board Configuration
#
# Copyright (c) 2025, LISTENAI
# SPDX-License-Identifier: Apache-2.0

config BOARD_NAME
	string
	default "arcs_mini"
	prompt "Board Name"
	help
		Board Name

config BOARD_ARCS_MINI
	bool
	default y
	select SOC_LS2684 if !SOC_LS2663
	help
		Board is arcs_mini. Defaults to LS2684 unless the application explicitly
		selects another SoC, for example CONFIG_SOC_LS2663=y.

config BOARD_ARCS_MINI_MODEM_UART2_REMAP
	bool "Remap UART2 to PA09/PA08 for modem"
	help
		Remap UART2 to PA09/PA08 for an external 4G modem.
		This conflicts with SDMMC on PA08/PA09.
```

## arcs-sdk/boards/arcs_mini3/Kconfig
```kconfig
# Board Configuration
#
# Copyright (c) 2026, LISTENAI
# SPDX-License-Identifier: Apache-2.0

config BOARD_NAME
	string
	default "arcs_mini3"
	prompt "Board Name"
	help
		Board Name

config BOARD_ARCS_MINI
	bool
	default y
	select SOC_LS2663
	help
		Board is arcs_mini series

config BOARD_ARCS_MINI3
	bool
	default y if BOARD_ARCS_MINI
	select LISA_DEVICE
	select LISA_I2C
	# CH32V003 及其 I2C1 总线仅归 CP 核，避免双核争用同一 I2C1 控制器
	select LISA_I2C1 if ARCS_CP_CORE
	select LISA_CH32V003 if ARCS_CP_CORE
	select LISA_CH32V003_GPIO if ARCS_CP_CORE
	select LISA_CH32V003_ADC if ARCS_CP_CORE
	select LISA_CH32V003_PWM if ARCS_CP_CORE
	help
		Board is arcs_mini3

config BOARD_ARCS_MINI_MODEM_UART2_REMAP
	bool "Remap UART2 to PA09/PA08 for modem"
	help
		Kept for arcs-mini prj.conf compatibility. arcs_mini3 uses the
		pinmux-tool UART2 mapping in pinmux.c instead of the legacy PA09/PA08
		override used by the SDK arcs_mini board.
```

## arcs-sdk/boards/arcs_mini_v3/Kconfig
```kconfig
# Board Configuration
#
# Copyright (c) 2026, LISTENAI
# SPDX-License-Identifier: Apache-2.0

config BOARD_NAME
    string
    default "arcs_mini_v3"
    prompt "Board Name"
    help
        Board Name

config BOARD_ARCS_MINI
    bool
    default y
    select SOC_LS2684
    help
        Board is arcs_mini series

config BOARD_ARCS_MINI_V3
    bool
    default y if BOARD_ARCS_MINI
    select LISA_DEVICE
    select LISA_I2C
    select LISA_I2C1
    select LISA_CH32V003
    select LISA_CH32V003_GPIO
    select LISA_CH32V003_ADC
    select LISA_CH32V003_PWM
    help
        Board is arcs_mini_v3

config BOARD_ARCS_MINI_MODEM_UART2_REMAP
    bool "Remap UART2 to PA09/PA08 for modem"
    default n
    help
        Kept for arcs-mini prj.conf compatibility. arcs_mini_v3 uses the
        pinmux-tool UART2 mapping in pinmux.c instead of the legacy PA09/PA08
        override used by the SDK arcs_mini board.
```

## arcs-sdk/boards/venusa_rd_evb/Kconfig
```kconfig
# Board Configuration
#
# Copyright (c) 2025, LISTENAI
# SPDX-License-Identifier: Apache-2.0

config BOARD_NAME
	string
	default "venusa_rd_evb"
	prompt "Board Name"
	help
		Board Name

config BOARD_VENUSA_RD_EVB
	bool
	default y
	select SOC_CSK7004J8U
	help
		Board is venusa_rd_evb
```

## arcs-sdk/cmake/Kconfig
```kconfig
menu "Common Compile and Link Options"

config DEBUG
    bool "debug"
    default y

choice
    prompt "optimize level"
    default COMPILE_OPTION_OPTIMIZE_LEVEL_OS
    config COMPILE_OPTION_OPTIMIZE_LEVEL_O0
        bool "O0"
    config COMPILE_OPTION_OPTIMIZE_LEVEL_O1
        bool "O1"
    config COMPILE_OPTION_OPTIMIZE_LEVEL_O2
        bool "O2"
    config COMPILE_OPTION_OPTIMIZE_LEVEL_O3
        bool "O3"
    config COMPILE_OPTION_OPTIMIZE_LEVEL_OS
        bool "OS"
endchoice

config LINK_OPTION_LISTENAI_LIBRARY_WHOLE_ARCHIVE
    bool "whole arch link"
    default y
    help
        Enable whole archive link option for listenai libraries (libm.a is automatically excluded)

config LINK_OPTION_LISTENAI_LIBRARY_GROUP
    bool "group link"
    default n
    help
        Enable group link option for listenai libraries

config LINK_OPTION_GC_SECTIONS
    bool "gc sections"
    default y

config COMPILE_OPTION_GENERATE_DEBUG_FILES
    bool "generate debug files"
    default y
    help
        Enable generate debug files like lst, relf, symbol table, etc

config COMPILE_OPTION_WARNING_AS_ERROR
    bool "warning as error"
    default n

config COMPILE_OPTION_WARNING_ALL
    bool "warning all"
    default n

config COMPILE_OPTION_WARNING_DISABLE
    bool "warning disable"
    default n

config FPU
    bool "fpu"
    default n

config PRINT_MEMORY_USAGE
    bool "print memory usage"
    default y

choice
    prompt "link options specs"
    default LINK_OPTION_NONE_SPECS

    config LINK_OPTION_NOSYS_SPECS
        bool "link options nosys specs"

    config LINK_OPTION_NANO_SPECS
        bool "link options nano specs"

    config LINK_OPTION_NONE_SPECS
        bool "link options none specs"
endchoice

endmenu
```

## arcs-sdk/components/Kconfig
```kconfig
# Copyright (c) 2025, LISTENAI
# SPDX-License-Identifier: Apache-2.0

# Components Configuration
# This file includes all component Kconfig files
menu "component"

rsource "acomp/Kconfig"
rsource "dirent/Kconfig"
rsource "exclib/Kconfig"
rsource "ipclsf/Kconfig"
rsource "irq_proxy/Kconfig"
rsource "lis_algo/Kconfig"
rsource "lite_adc/Kconfig"
rsource "lite_dac/Kconfig"
rsource "simple_box/Kconfig"
rsource "tinyusb-appclass/Kconfig"
rsource "cherryusb-appclass/Kconfig"
rsource "lisa_sntp/Kconfig"
rsource "lisa_evt_pub/Kconfig"
rsource "lisa_shell/Kconfig"
rsource "lisa_http/Kconfig"
rsource "lisa_websocket/Kconfig"
rsource "lisa_kv/Kconfig"
rsource "lisa_wifi/Kconfig"
rsource "lisa_bluetooth/Kconfig"
rsource "app_player/Kconfig"
rsource "lisa_modem/Kconfig"
rsource "lisa_net/Kconfig"
rsource "httpdns/Kconfig"
rsource "lisa_bt_audio_framework/Kconfig"

endmenu
```

## arcs-sdk/components/acomp/Kconfig
```kconfig
# Copyright (c) 2025, LISTENAI
# SPDX-License-Identifier: Apache-2.0

menu "algo components"

config ACOMP
	bool "algo components"

config ACOMP_MASTER
	bool "algo components master"
	default y

if ACOMP
	config ACOMP_WSP
		bool "algo component word spell"

	config ACOMP_WAKEUP
		bool "algo component wakeup"

	config ACOMP_LOGGER
		bool "algo component logger"

	config ACOMP_FD
		bool "algo component face detection"

	config ACOMP_PALM
		bool "algo component palm vein recognition"

	config ACOMP_CV
		bool "algo component cv"

	config ACOMP_XTTS
		bool "algo component xtts"

	config ACOMP_TRANSLATION
		bool "algo component translation"

	config ACOMP_TUNER
		bool "algo component tuner (EQ/DRC/Limiter)"

	config ACOMP_CAE
		bool "algo component cae"

rsource "resmgr/Kconfig"
rsource "wakeup/Kconfig"
rsource "fd/Kconfig"
rsource "palm/Kconfig"
rsource "cv/Kconfig"
rsource "xtts/Kconfig"
rsource "translation/Kconfig"
rsource "tuner/Kconfig"
rsource "cae/Kconfig"
endif

if ACOMP_LOGGER
	rsource "logger/Kconfig"
endif

rsource "Kconfig.res"
endmenu
```

## arcs-sdk/components/acomp/cae/Kconfig
```kconfig
# Copyright (c) 2026, LISTENAI
# SPDX-License-Identifier: Apache-2.0

if ACOMP_CAE

choice ACOMP_CAE_ALGORITHM_TYPE
	prompt "CAE Algorithm Type"
	default ACOMP_CAE_ALGORITHM_TYPE_SINGLE_MIC

config ACOMP_CAE_ALGORITHM_TYPE_SINGLE_MIC
	bool "Single Microphone"

config ACOMP_CAE_ALGORITHM_TYPE_DUAL_MIC
	bool "Dual Microphones"

endchoice

config ACOMP_CAE_RES_CAE_AES_ADDRESS
	hex "CAE AES Model Address"
	default 0x30200000
	help
	  CAE AES 模型在存储介质中的起始地址。

config ACOMP_CAE_RES_CAE_AES_LENGTH
	int "CAE AES Model Length"
	default 200000
	help
	  CAE AES 模型的字节大小。

config ACOMP_CAE_RES_CAE_JSON_ADDRESS
	hex "CAE Parameter JSON Address"
	default 0x304D0000
	help
	  CAE 参数 JSON 配置在存储介质中的起始地址。

config ACOMP_CAE_RES_CAE_JSON_LENGTH
	int "CAE Parameter JSON Length"
	default 141
	help
	  CAE 参数 JSON 配置的字节大小。

endif # ACOMP_CAE
```

## arcs-sdk/components/acomp/cv/Kconfig
```kconfig
# Copyright (c) 2025, LISTENAI
# SPDX-License-Identifier: Apache-2.0

if ACOMP_CV

	config ACOMP_CV_RES_CUTLINE_EMMC_ADDR
		hex "Cutline model eMMC address"
		default 0x9b00000
		help
			eMMC byte address of the cutline model resource.
			Used as fallback when the model is not on flash.

	config ACOMP_CV_RES_CUTLINE_SIZE
		int "Cutline model size (bytes)"
		default 462320

	config ACOMP_CV_RES_OCR_EMMC_ADDR
		hex "OCR model eMMC address"
		default 0xa000000
		help
			eMMC byte address of the OCR thinker model resource.

	config ACOMP_CV_RES_OCR_SIZE
		int "OCR model size (bytes)"
		default 2289296

endif
```

## arcs-sdk/components/acomp/fd/Kconfig
```kconfig
if ACOMP_FD
    config ACOMP_FD_RES_FACE_DETECT_ADDRESS
        hex "mlp face detect address"
        default 0xd200000
    config ACOMP_FD_RES_FACE_DETECT_LENGTH
        int "mlp face detect length"
        default 3546864
    config ACOMP_FD_RES_FACE_ALIGN_ADDRESS
        hex "mlp face align address"
        default 0xcd00000
    config ACOMP_FD_RES_FACE_ALIGN_LENGTH
        int "mlp face align length"
        default 419904
    config ACOMP_FD_RES_FACE_LIVE_ADDRESS
        hex "mlp face live address"
        default 0xcd00000
    config ACOMP_FD_RES_FACE_LIVE_LENGTH
        int "mlp face live length"
        default 419904
    config ACOMP_FD_FACE_VERIFY_ADDRESS
        hex "mlp face verify address"
        default 0xcd00000
    config ACOMP_FD_FACE_VERIFY_LENGTH
        int "mlp face verify length"
        default 419904

endif
```

## arcs-sdk/components/acomp/logger/Kconfig
```kconfig
# SPDX-License-Identifier: Apache-2.0

if ACOMP_LOGGER

config ACOMP_LOGGER_STREAM_BUFFER_SIZE
    int "Logger stream buffer size (bytes)"
    default 256
    help
        Size of each buffer in the logger stream.
        This determines the maximum size of data that can be written
        to a single buffer before it needs to be submitted.

config ACOMP_LOGGER_STREAM_BUFFER_COUNT
    int "Logger stream buffer count"
    default 128
    help
        Number of buffers in the logger stream.
        More buffers can improve performance but consume more memory.
        NOTE: Must be a power of 2 (e.g., 2, 4, 8, 16, 32, etc.).

choice ACOMP_LOGGER_KICK_POLICY
    prompt "Logger stream kick policy"
    default ACOMP_LOGGER_KICK_MANUAL
    help
        Determines when the logger stream is kicked/flushed.

    config ACOMP_LOGGER_KICK_MANUAL
        bool "Manual kick"
        help
            Stream is manually polled and kicked/flushed.
            Requires periodic polling based on configured interval.

    config ACOMP_LOGGER_KICK_AUTO
        bool "Auto kick"
        help
            Stream is automatically kicked/flushed when buffer threshold is reached.

endchoice


if ACOMP_LOGGER_KICK_AUTO

config ACOMP_LOGGER_AUTO_KICK_BUFFER_THRESHOLD
    int "Logger auto kick buffer threshold"
    default 4
    help
        Number of buffers received before automatically triggering a kick/flush.
        Only used when kick policy is set to auto.
        The logger will automatically flush data after receiving this many buffers.
endif

if ACOMP_LOGGER_KICK_MANUAL        
config ACOMP_LOGGER_MANUAL_POLL_INTERVAL_MS
    int "Logger buffer poll interval (ms)"
    default 10
    help
        Polling interval in milliseconds for checking buffers.
        Only used when kick policy is set to manual.
        The logger will check for available buffers at this interval.
endif # ACOMP_LOGGER_KICK_MANUAL

config ACOMP_LOGGER_THREAD_PRIORITY
    int "Logger thread priority"
    default 5
    help
        Thread priority for logger processing thread.
        Higher values indicate higher priority.
        Range: 0 (lowest) to 31 (highest).

config ACOMP_LOGGER_THREAD_STACK_SIZE
    int "Logger thread stack size (bytes)"
    default 2048
    help
        Stack size in bytes for logger processing thread.
        Adjust based on logger processing requirements.

config ACOMP_LOGGER_USE_COLOR
    bool "Enable color highlighting for AP logs"
    default y
    help
        Enable ANSI color codes to highlight AP logs with background color.
        This makes it easier to distinguish AP logs from Master logs.

if ACOMP_LOGGER_USE_COLOR

choice ACOMP_LOGGER_COLOR_SCHEME
    prompt "AP log color scheme"
    default ACOMP_LOGGER_COLOR_CYAN_BG
    help
        Select the color scheme for AP logs.

    config ACOMP_LOGGER_COLOR_CYAN_BG
        bool "Cyan background"
        help
            Use cyan background for AP logs (recommended).

    config ACOMP_LOGGER_COLOR_BLUE_BG
        bool "Blue background"
        help
            Use blue background for AP logs.

    config ACOMP_LOGGER_COLOR_GREEN_BG
        bool "Green background"
        help
            Use green background for AP logs.

    config ACOMP_LOGGER_COLOR_YELLOW_BG
        bool "Yellow background"
        help
            Use yellow background for AP logs.

    config ACOMP_LOGGER_COLOR_PURPLE_BG
        bool "Purple background"
        help
            Use purple background for AP logs.

    config ACOMP_LOGGER_COLOR_LIGHT_GRAY_BG
        bool "Light gray background"
        help
            Use light gray background for AP logs.

endchoice

endif # ACOMP_LOGGER_USE_COLOR

endif # ACOMP_LOGGER
```

## arcs-sdk/components/acomp/palm/Kconfig
```kconfig
# Copyright (c) 2026, LISTENAI
# SPDX-License-Identifier: Apache-2.0

if ACOMP_PALM

	config ACOMP_PALM_RES_DETECT_ADDRESS
		hex "palm detect resource address"
		default 0x0

	config ACOMP_PALM_RES_DETECT_LENGTH
		int "palm detect resource length"
		default 0

	config ACOMP_PALM_RES_VERIFY_ADDRESS
		hex "palm verify resource address"
		default 0x0

	config ACOMP_PALM_RES_VERIFY_LENGTH
		int "palm verify resource length"
		default 0

endif
```

## arcs-sdk/components/acomp/resmgr/Kconfig
```kconfig
# Copyright (c) 2025, LISTENAI
# SPDX-License-Identifier: Apache-2.0

if ACOMP

	menuconfig ACOMP_RESMGR
		bool "Enable Flash Resource Manager"
		help
			Enable flash resource manager for algorithm models.
			Parses a flash-resident resource header table and provides
			lookups by resource ID. Shared by cv, xtts, translation.

	if ACOMP_RESMGR
		config ACOMP_RESMGR_FLASH_ADDR
			hex "Flash XIP address of resource header"
			default 0x30420000
			help
				Flash XIP base address where the resource header is burned.
				Must match the respack tool burn address.

		config ACOMP_RESMGR_TAGNAME
			hex "Resource header tag ID"
			default 0x594C4649
			help
				Expected tag in the resource header (must match respack tool config).
				Default 0x594C4649 = "IFLY" in little-endian.

		config ACOMP_RESMGR_DATCHK
			bool "Enable data CRC verify"
			default y
			select MODULE_CRC32
			help
				Enable CRC32 verification of the resource header.
	endif

endif
```
