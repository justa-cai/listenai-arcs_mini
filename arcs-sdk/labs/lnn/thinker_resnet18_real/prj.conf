## CMakeLists.txt
```
cmake_minimum_required(VERSION 3.19)

set(CMAKE_EXPORT_COMPILE_COMMANDS ON)

find_package(listenai-cmake REQUIRED HINTS $ENV{ARCS_BASE})

set(THINKER_RESNET18_REAL_CP_TARGET thinker_resnet18_real_cp)
set(THINKER_RESNET18_REAL_AP_TARGET thinker_resnet18_real_ap)

project(${THINKER_RESNET18_REAL_CP_TARGET} C)

listenai_add_executable(${PROJECT_NAME})

target_sources(${PROJECT_NAME} PRIVATE
    src/ap_client.c
    src/app.c
    src/board_pins.c
    src/ipc_client.c
    src/ipc_shared.c
    src/main.c
    src/lnn_usb_adb.c
    src/usb_descriptors.c
)

target_include_directories(${PROJECT_NAME} PRIVATE
    include
)

listenai_include_directories(
    src
)

include(ExternalProject)

ExternalProject_Add(
    remote_core
    SOURCE_DIR ${CMAKE_CURRENT_SOURCE_DIR}/remote
    BINARY_DIR ${CMAKE_CURRENT_BINARY_DIR}/remote
    CMAKE_ARGS
        -DCMAKE_BUILD_TYPE=${CMAKE_BUILD_TYPE}
        -DCMAKE_TOOLCHAIN_FILE=${CMAKE_TOOLCHAIN_FILE}
        -DCMAKE_MAKE_PROGRAM=${CMAKE_MAKE_PROGRAM}
        -DBOARD=${BOARD}
        $<$<BOOL:${BOARD_SEARCH_PATH}>:-DBOARD_SEARCH_PATH=${BOARD_SEARCH_PATH}>
    BUILD_ALWAYS 1
    INSTALL_COMMAND ""
)

add_dependencies(${PROJECT_NAME} remote_core)

find_program(PYTHON3 python3 REQUIRED)
set(MERGE_SCRIPT "$ENV{ARCS_BASE}/tools/scripts/merge_bins.py")
set(MODEL_BIN "${CMAKE_CURRENT_SOURCE_DIR}/../thinker_resnet18/resources/resnet18_arcs.bin")

add_custom_target(merge_images ALL
    COMMAND ${PYTHON3} ${MERGE_SCRIPT}
            --output ${CMAKE_CURRENT_BINARY_DIR}/merged.bin
            --bin 0x000000 ${CMAKE_CURRENT_BINARY_DIR}/remote/${THINKER_RESNET18_REAL_AP_TARGET}.bin
            --bin 0x200000 ${CMAKE_CURRENT_BINARY_DIR}/${PROJECT_NAME}.bin
            --bin 0x500000 ${MODEL_BIN}
    DEPENDS ${PROJECT_NAME} remote_core
    COMMENT "Merging AP image, CP image and ResNet18 model into merged.bin"
)

message(STATUS "========================================")
message(STATUS "Thinker ResNet18 Real Sample")
message(STATUS "========================================")
message(STATUS "CP Core (camera/LVGL): ${PROJECT_NAME}")
message(STATUS "AP Core (Thinker):     ${THINKER_RESNET18_REAL_AP_TARGET}")
message(STATUS "Model resource:        ${MODEL_BIN}")
message(STATUS "Merged image:          ${CMAKE_CURRENT_BINARY_DIR}/merged.bin")
message(STATUS "========================================")
```

## Kconfig
```
# Copyright (c) 2026, LISTENAI
# SPDX-License-Identifier: Apache-2.0

osource "$ARCS_BASE/Kconfig"

orsource "$ARCS_BASE/labs/lnn/common/arcs/libraries/Kconfig"

config THINKER_RESNET18_REAL_MODEL_ADDR
	hex "Thinker ResNet18 real model flash address"
	default 0x30200000
	help
	  XIP flash address of resnet18_arcs.bin. Burn the model at
	  offset 0x500000 when MEM_FLASH_BASE is 0x30000000.

config THINKER_RESNET18_REAL_MODEL_SIZE
	hex "Thinker ResNet18 real model size"
	default 0x1FD1E0
	help
	  Size of resnet18_arcs.bin in bytes.

config THINKER_RESNET18_REAL_PSRAM_POOL_SIZE
	hex "Thinker ResNet18 real PSRAM pool size"
	default 0x10000
	help
	  PSRAM pool used for Thinker runtime memory plan entries on AP Core.

config THINKER_RESNET18_REAL_SHARE_POOL_SIZE
	hex "Thinker ResNet18 real share pool size"
	default 0x58000
	help
	  APRAM pool used for Thinker SHARE_MEM memory plan entries.

config THINKER_RESNET18_REAL_CP_FLASH_BASE
	hex "Thinker ResNet18 real CP image flash base"
	default 0x30600000
	help
	  Flash XIP address used by AP Core to boot the CP image.
```

## sample.yaml
```
tests:
  labs.lnn.thinker_resnet18_real:
    build_only: true
```

## prj.conf
```kconfig
# CP Core: camera capture, LVGL preview and touch UI.
CONFIG_MEM_CONFIG=y
CONFIG_MEM_SRAM_BASE=0x20030000
CONFIG_MEM_SRAM_SIZE=0x00010000
CONFIG_MEM_PSRAM_BASE=0x28130000
CONFIG_MEM_PSRAM_SIZE=0x00460000
CONFIG_MEM_FLASH_BASE=0x30600000
CONFIG_MEM_FLASH_SIZE=0x00400000
CONFIG_MEM_LUNA_SHARED_SIZE=0x00005000
CONFIG_MEM_IPC_BASE=0x2004D000
CONFIG_MEM_IPC_SIZE=0x00003000
CONFIG_MEM_APRAM_BASE=0x20051000
CONFIG_MEM_APRAM_SIZE=0x0005F000
CONFIG_MEM_INTERRUPT_STACK_SIZE=0x0E00

CONFIG_ARCS_CP_CORE=y
CONFIG_BOOT=n
CONFIG_ARCS_HAL_IPC=y
CONFIG_ARCS_HAL_IPC_MASTER=y
CONFIG_ARCS_HAL_IPC_MRPC_SERVER=n
CONFIG_ARCS_HAL_IPC_MRPC_CLIENT=n
CONFIG_ARCS_HAL_IPC_PRINT=y
CONFIG_ARCS_HAL_IPC_PRINT_SOURCE_TAG="AP"
CONFIG_ARCS_HAL_LSF=n
CONFIG_IPC_LSF=n
CONFIG_LSF_CLIENT=n
CONFIG_DISK_MEM=n
CONFIG_DISK_MEM_CLIENT=n
CONFIG_DISK_MEM_SERVER=n

CONFIG_LOG=y
CONFIG_PRINTF_LOG_REDIRECT=y
CONFIG_BACK_TRACE=y

CONFIG_HEAP_SIZE=0x4000
CONFIG_PSRAM_HEAP_SIZE=0x300000
CONFIG_MAIN_TASK_STACK_SIZE=3072
CONFIG_MAIN_TASK_PRIORITY=1
CONFIG_FREERTOS_STATIC_ALLOCATION_ENABLE=y

CONFIG_LISA_DEVICE=y
CONFIG_LISA_GPIO_DEVICE=y
CONFIG_LISA_GPIOA=y
CONFIG_LISA_GPIOB=y
CONFIG_LISA_PWM=y
CONFIG_LISA_SPI0=y
CONFIG_LISA_SPI1=y
CONFIG_LISA_I2C=y
CONFIG_LISA_I2C0=y

CONFIG_LISA_DISPLAY_DEVICE=y
CONFIG_LISA_DISPLAY_PANEL_ST7789P3=y
CONFIG_LISA_DISPLAY_CPDMA_ROTATE=y
CONFIG_LISA_DISPLAY_BUS_SPI_4WIRE=y
# arcs_mini LCD: SPI0 + TE 同步（对齐产品 prj.conf）
CONFIG_LISA_DISPLAY_TE_SYNC=y
CONFIG_PANEL_ST7789P3_WIDTH=240
CONFIG_PANEL_ST7789P3_HEIGHT=320
CONFIG_PANEL_ST7789P3_X_OFFSET=0
CONFIG_LISA_DISPLAY_COLOR_INVERT=y

CONFIG_LISA_TOUCH_DEVICE=n
CONFIG_LISA_TOUCH_ARCS_CST328=n

CONFIG_SDK_MODULE_LVGL8=y
CONFIG_LV_DEMO_SYS_HEAP=y
CONFIG_LV_DRIVER_PIXEL_ALIGN_SIZE=16
CONFIG_LV_USE_GPU_CSK_DMA2D=y
CONFIG_LV_DOUBLE_VDB=y
CONFIG_LV_USE_PERF_MONITOR=n
CONFIG_LV_DRIVER_FULL_REFRESH=y
CONFIG_LV_CUSTOM_MONITOR=n
CONFIG_LV_REFR_UNCONDITIONAL_AREA_JOIN=y
CONFIG_LV_DRIVER_ROTATE_90=y
CONFIG_LV_ATTRIBUTE_FAST_MEM_USE_IRAM=y

CONFIG_LISA_CAMERA_DEVICE=y
CONFIG_LISA_CAMERA_BUS_DVP=y
CONFIG_LISA_CAMERA_SENSOR_GC032A=y
CONFIG_LISA_CAMERA_SENSOR_GC0328=y

CONFIG_THINKER_RESNET18_REAL_CP_FLASH_BASE=0x30600000

# USB ADB（shell + reboot recovery），免手动进 BOOT 模式
CONFIG_CHERRYUSB=y
CONFIG_CHERRYUSB_DEVICE=y
CONFIG_CHERRYUSB_DEVICE_SPEED_HS=y
CONFIG_CHERRYUSB_DEVICE_MUSB_LISA=y
CONFIG_CHERRYUSB_DEVICE_TEMPLATE_NONE=y
CONFIG_CHERRYUSB_APP_CLASS=y
CONFIG_ADB=y
CONFIG_ADB_SYNC=n
CONFIG_ADB_REBOOT=y
CONFIG_ADB_SHELL=y
CONFIG_ADB_SHELL_BUFFER_SIZE=2048
CONFIG_SDK_MODULE_LETTER_SHELL=y
CONFIG_SDK_MODULE_LETTER_SHELL_CONFIG_FILE="shell_cfg_user.h"
```

## src/main.c
```c
/*
 * Copyright (c) 2026 Anhui Listenai Co., Ltd.
 * SPDX-License-Identifier: Apache-2.0
 */

#define LOG_TAG "lnn_real_cp"

#include <lisa_log.h>

#include "FreeRTOS.h"
#include "task.h"

#include "lnn_resnet18_real_cp.h"

static void log_boot_banner(void)
{
    LOGI("Thinker ResNet18 real sample CP start");
}

int main(int argc, char **argv)
{
    (void)argc;
    (void)argv;

    log_boot_banner();

    if (lnn_mbox_init() != 0) {
        return -1;
    }

    if (lnn_display_touch_init() != 0) {
        return -1;
    }

    if (lnn_camera_init() != 0) {
        return -1;
    }

    if (lnn_ipc_mutex_init() != 0) {
        return -1;
    }

    if (xTaskCreate(lnn_task_ui, "lnn_ui", 4096, NULL, configMAX_PRIORITIES - 2, NULL) != pdPASS) {
        LOGE("create UI task failed");
        return -1;
    }

    if (xTaskCreate(lnn_task_camera, "lnn_camera", 4096, NULL, configMAX_PRIORITIES - 3, NULL) != pdPASS) {
        LOGE("create camera task failed");
        return -1;
    }

    /* ADB shell + reboot recovery：demo 下也能 adb reboot recovery 进 BOOT 烧录 */
    if (lnn_usb_adb_init() != 0) {
        LOGW("usb adb init failed (flash via burn_serial.sh)");
    }

    return 0;
}
```

## include/lnn_resnet18_real_ipc.h
```c
/*
 * Copyright (c) 2026 Anhui Listenai Co., Ltd.
 * SPDX-License-Identifier: Apache-2.0
 */

#pragma once

#include <stdint.h>

#define LNN_RESNET18_REAL_IPC_MAGIC       (0x4C4E4E52U) /* LNNR */
#define LNN_RESNET18_REAL_IPC_VERSION     (1U)
#define LNN_RESNET18_REAL_MSG_REQUEST     (1U)
#define LNN_RESNET18_REAL_MSG_STATUS      (2U)
#define LNN_RESNET18_REAL_MBOX_CH         (6U)

#define LNN_RESNET18_REAL_INPUT_CHANNELS  (3U)
#define LNN_RESNET18_REAL_INPUT_WIDTH     (192U)
#define LNN_RESNET18_REAL_INPUT_HEIGHT    (192U)
#define LNN_RESNET18_REAL_INPUT_BYTES     \
    (LNN_RESNET18_REAL_INPUT_CHANNELS * LNN_RESNET18_REAL_INPUT_WIDTH * LNN_RESNET18_REAL_INPUT_HEIGHT)

#define LNN_RESNET18_REAL_LABEL_MAX       (32U)
#define LNN_RESNET18_REAL_MESSAGE_MAX     (64U)

typedef enum {
    LNN_RESNET18_REAL_STATE_BOOTING = 0,
    LNN_RESNET18_REAL_STATE_IDLE,
    LNN_RESNET18_REAL_STATE_REQUEST,
    LNN_RESNET18_REAL_STATE_BUSY,
    LNN_RESNET18_REAL_STATE_DONE,
    LNN_RESNET18_REAL_STATE_ERROR,
} lnn_resnet18_real_state_t;

typedef struct __attribute__((aligned(64))) {
    volatile uint32_t magic;
    volatile uint32_t version;
    volatile uint32_t struct_size;
    volatile uint32_t seq;
    volatile uint32_t state;
    volatile uint32_t input_width;
    volatile uint32_t input_height;
    volatile uint32_t input_bytes;
    volatile int32_t result_score;
    volatile int32_t result_index;
    volatile uint32_t label_len;
    char result_label[LNN_RESNET18_REAL_LABEL_MAX];
    char message[LNN_RESNET18_REAL_MESSAGE_MAX];
    /* YOLO 输入张量 110KB 放不进 12KB 的 IPC RAM：
     * 张量本体在 CP 侧共享 PSRAM（.lnn.input 段），此处只交接地址。
     * CP 写入后 flush D-cache；AP 侧 DCache 常关，直接读。 */
    volatile uint32_t input_addr;
    volatile uint32_t reserved[15]; /* 补齐到 64 字节对齐 */
} lnn_resnet18_real_ipc_t;

typedef struct __attribute__((aligned(4))) {
    uint32_t magic;
    uint32_t seq;
    uint32_t type;
    uint32_t state;
} lnn_resnet18_real_msg_t;

extern volatile lnn_resnet18_real_ipc_t lnn_resnet18_real_ipc_block;

static inline volatile lnn_resnet18_real_ipc_t *lnn_resnet18_real_ipc_get(void)
{
    return &lnn_resnet18_real_ipc_block;
}
```

## src/ap_client.c
```c
/*
 * Copyright (c) 2026 Anhui Listenai Co., Ltd.
 * SPDX-License-Identifier: Apache-2.0
 */

#define LOG_TAG "lnn_ap_client"

#include <lisa_log.h>
#include <stdint.h>
#include <cache.h>
#include <stdio.h>

#include "lnn_resnet18_real_cp.h"

#define RGB565_RED(value)   (uint8_t)((((value) >> 11) & 0x1FU) << 3)
#define RGB565_GREEN(value) (uint8_t)((((value) >> 5) & 0x3FU) << 2)
#define RGB565_BLUE(value)  (uint8_t)(((value) & 0x1FU) << 3)

/* YOLO 输入归一化 img/255 -> 双极性 int8（整数运算，避免 110K 次 double） */
static int8_t quantize_input(uint8_t value, uint32_t channel)
{
    (void)channel;
    int32_t q = ((int32_t)value * 254 + 127) / 255 - 127;
    return (int8_t)q;
}

/* YOLO 输入张量 110KB：放 CP 共享 PSRAM，AP 直接经 input_addr 读取 */
static int8_t lnn_input_tensor[LNN_RESNET18_REAL_INPUT_BYTES]
    __attribute__((section(".psram.bss"), aligned(64)));

static uint16_t rgb565_window_get_pixel(const rgb565_window_t *window, uint32_t x, uint32_t y)
{
    /* 传感器相对屏幕旋转 90°（逆时针）：输出坐标 (x,y) 采样源窗口 (W-1-y, x)，
     * 预览与 NN 输入共用同一映射，识别方向与显示方向一致 */
    uint32_t sx = window->width - 1U - y;
    uint32_t sy = x;
    return window->pixels[(window->y + sy) * window->stride + window->x + sx];
}

static void preprocess_rgb565_to_tensor(const rgb565_window_t *src, int8_t *dst)
{
    for (uint32_t y = 0; y < LNN_RESNET18_REAL_INPUT_HEIGHT; y++) {
        for (uint32_t x = 0; x < LNN_RESNET18_REAL_INPUT_WIDTH; x++) {
            uint32_t src_x = x * src->width / LNN_RESNET18_REAL_INPUT_WIDTH;
            uint32_t src_y = y * src->height / LNN_RESNET18_REAL_INPUT_HEIGHT;
            uint32_t offset = y * LNN_RESNET18_REAL_INPUT_WIDTH + x;
            uint16_t rgb565 = rgb565_window_get_pixel(src, src_x, src_y);

            dst[0 * LNN_RESNET18_REAL_INPUT_WIDTH * LNN_RESNET18_REAL_INPUT_HEIGHT + offset] =
                quantize_input(RGB565_RED(rgb565), 0);
            dst[1 * LNN_RESNET18_REAL_INPUT_WIDTH * LNN_RESNET18_REAL_INPUT_HEIGHT + offset] =
                quantize_input(RGB565_GREEN(rgb565), 1);
            dst[2 * LNN_RESNET18_REAL_INPUT_WIDTH * LNN_RESNET18_REAL_INPUT_HEIGHT + offset] =
                quantize_input(RGB565_BLUE(rgb565), 2);
        }
    }
}

bool lnn_ap_ready_for_request(void)
{
    volatile lnn_resnet18_real_ipc_t *ipc = lnn_resnet18_real_ipc_get();
    bool ready;

    lnn_ipc_lock();
    lnn_ipc_cache_invalidate(ipc);
    ready = lnn_ipc_ready_for_request(ipc);
    lnn_ipc_unlock();

    return ready;
}

int lnn_ap_submit_window_for_inference(const rgb565_window_t *window)
{
    volatile lnn_resnet18_real_ipc_t *ipc = lnn_resnet18_real_ipc_get();
    uint32_t prev_state;
    uint32_t seq;
    uint32_t readback_seq;
    uint32_t readback_state;

    if (window == NULL || window->pixels == NULL || window->width == 0U || window->height == 0U) {
        return -1;
    }

    lnn_ipc_lock();
    lnn_ipc_cache_invalidate(ipc);
    if (!lnn_ipc_ready_for_request(ipc)) {
        LOGW("AP not ready: magic=0x%08x state=%u message=%s", ipc->magic, ipc->state, (const char *)ipc->message);
        lnn_ipc_unlock();
        return -1;
    }
    prev_state = ipc->state;

    int8_t *input = lnn_input_tensor;
    preprocess_rgb565_to_tensor(window, input);

    ipc->seq++;
    ipc->state = LNN_RESNET18_REAL_STATE_REQUEST;
    ipc->input_width = LNN_RESNET18_REAL_INPUT_WIDTH;
    ipc->input_height = LNN_RESNET18_REAL_INPUT_HEIGHT;
    ipc->input_bytes = LNN_RESNET18_REAL_INPUT_BYTES;
    ipc->input_addr = (uint32_t)(uintptr_t)lnn_input_tensor;
    HAL_FlushDCache_by_Addr((uint32_t *)lnn_input_tensor, sizeof(lnn_input_tensor));
    ipc->result_label[0] = '\0';
    ipc->label_len = 0;
    ipc->result_score = 0;
    ipc->result_index = -1;
    (void)snprintf((char *)ipc->message, LNN_RESNET18_REAL_MESSAGE_MAX, "CP request seq=%u", ipc->seq);

    seq = ipc->seq;
    lnn_ipc_cache_flush(ipc);
    lnn_ipc_cache_invalidate(ipc);
    readback_seq = ipc->seq;
    readback_state = ipc->state;
    lnn_ipc_unlock();

    int notify_ret = lnn_ipc_notify_ap(seq);
    LOGI("submit frame seq=%u prev_state=%u readback=%u/%u window=%ux%u+%u+%u ipc_addr=0x%08x notify=%s:%d", seq,
         prev_state, readback_seq, readback_state, window->width, window->height, window->x, window->y,
         (uint32_t)(uintptr_t)ipc, REQUEST_NOTIFY_MODE, notify_ret);
    return 0;
}

void lnn_ap_read_status(lnn_ap_status_t *status)
{
    volatile lnn_resnet18_real_ipc_t *ipc = lnn_resnet18_real_ipc_get();

    if (status == NULL) {
        return;
    }

    lnn_ipc_lock();
    lnn_ipc_cache_invalidate(ipc);
    status->magic = ipc->magic;
    status->seq = ipc->seq;
    status->state = ipc->state;
    status->result_score = ipc->result_score;
    (void)snprintf(status->result_text, sizeof(status->result_text), "%s", (const char *)ipc->result_label);
    (void)snprintf(status->message, sizeof(status->message), "%s", (const char *)ipc->message);
    lnn_ipc_unlock();
}

void lnn_ap_mark_status_dirty(void)
{
    lnn_ipc_mark_status_dirty();
}

bool lnn_ap_take_status_dirty(void)
{
    return lnn_ipc_take_status_dirty();
}
```

## src/app.c
```c
/*
 * Copyright (c) 2026 Anhui Listenai Co., Ltd.
 * SPDX-License-Identifier: Apache-2.0
 */

#define LOG_TAG "lnn_real_cp"

#include <IOMuxManager.h>
#include <board.h>
#include <cache.h>
#include <lisa_camera.h>
#include <lisa_device.h>
#include <lisa_display.h>
#include <lisa_log.h>
#include <lisa_thread.h>
#ifdef CONFIG_LISA_TOUCH_DEVICE
#include <lisa_touch.h>
#endif
#include <lv_port_disp.h>
#include <lvgl.h>
#include <stdbool.h>
#include <stdint.h>

#include "FreeRTOS.h"
#include "task.h"

#include "lnn_resnet18_real_cp.h"

static lisa_device_t *display_device;
static lisa_device_t *camera_device;
#ifdef CONFIG_LISA_TOUCH_DEVICE
static lisa_device_t *touch_device;
#endif
static lv_obj_t *preview_obj;
static lv_obj_t *result_label;
static lv_obj_t *status_label;
static lv_obj_t *recognize_btn;
static lv_obj_t *preview_btn;
static lv_img_dsc_t preview_dsc;
#ifdef CONFIG_LISA_TOUCH_DEVICE
static lv_indev_drv_t touch_indev_drv;
#endif

static uint16_t preview_buf[PREVIEW_WIDTH * PREVIEW_HEIGHT]
    __attribute__((section(".psram.bss"), aligned(64)));

static volatile bool preview_dirty;

/* 帧率与耗时统计（每 5s 打印一次） */
#define FPS_STAT_WINDOW_MS 5000U
static volatile uint32_t stat_capture_cnt;
static volatile uint32_t stat_scale_ms;
static volatile uint32_t stat_scale_cnt;
static volatile uint32_t stat_flush_cnt;
static volatile uint32_t stat_lvhandler_ms;
static volatile uint32_t stat_lvhandler_cnt;
static volatile uint32_t stat_uitask_cnt;
static volatile uint32_t stat_wait_ms;
static volatile uint32_t stat_wait_max;
static volatile uint32_t stat_poll_ms;
static uint32_t stat_window_start;
static volatile bool preview_frozen;
static volatile bool recognize_requested;
static volatile bool request_in_flight;
#ifdef CONFIG_LISA_TOUCH_DEVICE
static volatile uint16_t touch_last_x;
static volatile uint16_t touch_last_y;
static volatile uint8_t touch_last_state = LV_INDEV_STATE_REL;
#endif

static uint32_t min_u32(uint32_t a, uint32_t b)
{
    return a < b ? a : b;
}

#ifdef CONFIG_LISA_TOUCH_DEVICE
static void touch_transform_coordinates(lv_coord_t *x, lv_coord_t *y)
{
    if (x == NULL || y == NULL) {
        return;
    }

#if CONFIG_LV_POINTER_SWAP_XY
    lv_coord_t cur_x = *y;
    lv_coord_t cur_y = *x;
#else
    lv_coord_t cur_x = *x;
    lv_coord_t cur_y = *y;
#endif

#if CONFIG_LV_POINTER_INVERT_X
    cur_x = (lv_coord_t)SCREEN_WIDTH - cur_x;
#endif

#if CONFIG_LV_POINTER_INVERT_Y
    cur_y = (lv_coord_t)SCREEN_HEIGHT - cur_y;
#endif

    *x = cur_x;
    *y = cur_y;
}

static void touch_interrupt_callback(const lisa_touch_event_t *event, void *user_data)
{
    (void)user_data;

    if (event != NULL && event->type == LISA_TOUCH_EVENT_PRESS && event->point_count > 0U) {
        lv_coord_t x = (lv_coord_t)event->points[0].x;
        lv_coord_t y = (lv_coord_t)event->points[0].y;

        touch_transform_coordinates(&x, &y);
        touch_last_x = (uint16_t)x;
        touch_last_y = (uint16_t)y;
        touch_last_state = LV_INDEV_STATE_PR;
    } else {
        touch_last_state = LV_INDEV_STATE_REL;
    }
}

static void touch_interrupt_read(struct _lv_indev_drv_t *indev_drv, lv_indev_data_t *data)
{
    (void)indev_drv;

    data->point.x = (lv_coord_t)touch_last_x;
    data->point.y = (lv_coord_t)touch_last_y;
    data->state = touch_last_state;
    data->continue_reading = 0;
}

static int touch_interrupt_init(lisa_device_t *touch_dev)
{
    int ret = lisa_touch_set_callback(touch_dev, touch_interrupt_callback, NULL);
    if (ret != LISA_DEVICE_OK) {
        LOGE("touch callback set failed: %d", ret);
        return -1;
    }

    ret = lisa_touch_set_int_mode(touch_dev, LISA_TOUCH_INT_MODE_INTERRUPT);
    if (ret != LISA_DEVICE_OK) {
        LOGE("touch interrupt mode set failed: %d", ret);
        return -1;
    }

    ret = lisa_touch_enable(touch_dev);
    if (ret != LISA_DEVICE_OK) {
        LOGE("touch enable failed: %d", ret);
        return -1;
    }

    lisa_touch_capabilities_t caps = {0};
    ret = lisa_touch_get_capabilities(touch_dev, &caps);
    if (ret == LISA_DEVICE_OK) {
        LOGI("touch caps: max_x=%u max_y=%u max_points=%u", caps.max_x, caps.max_y, caps.max_points);
    }

    touch_device = touch_dev;
    lv_indev_drv_init(&touch_indev_drv);
    touch_indev_drv.type = LV_INDEV_TYPE_POINTER;
    touch_indev_drv.read_cb = touch_interrupt_read;
    lv_indev_drv_register(&touch_indev_drv);
    LOGI("touch interrupt mode enabled");
    return 0;
}
#endif

static rgb565_window_t make_rgb565_center_window(const uint16_t *src, uint32_t width, uint32_t height)
{
    uint32_t window_width = min_u32(width, CAMERA_WINDOW_WIDTH);
    uint32_t window_height = min_u32(height, CAMERA_WINDOW_HEIGHT);
    uint32_t window_size = min_u32(window_width, window_height);

    rgb565_window_t window = {
        .pixels = src,
        .stride = width,
        .x = (width - window_size) / 2U,
        .y = (height - window_size) / 2U,
        .width = window_size,
        .height = window_size,
    };

    return window;
}

static uint16_t rgb565_window_get_pixel(const rgb565_window_t *window, uint32_t x, uint32_t y)
{
    /* 传感器相对屏幕旋转 90°（逆时针）：输出坐标 (x,y) 采样源窗口 (W-1-y, x)，
     * 预览与 NN 输入共用同一映射，识别方向与显示方向一致 */
    uint32_t sx = window->width - 1U - y;
    uint32_t sy = x;
    return window->pixels[(window->y + sy) * window->stride + window->x + sx];
}

static void scale_rgb565_to_preview(const rgb565_window_t *src)
{
    for (uint32_t y = 0; y < PREVIEW_HEIGHT; y++) {
        for (uint32_t x = 0; x < PREVIEW_WIDTH; x++) {
            uint32_t src_x = x * src->width / PREVIEW_WIDTH;
            uint32_t src_y = y * src->height / PREVIEW_HEIGHT;
            preview_buf[y * PREVIEW_WIDTH + x] = rgb565_window_get_pixel(src, src_x, src_y);
        }
    }

    HAL_FlushDCache_by_Addr((uint32_t *)preview_buf, sizeof(preview_buf));
    preview_dirty = true;
}

static void update_control_states(bool ap_ready)
{
    bool run_enabled = ap_ready && !recognize_requested && !request_in_flight && !preview_frozen;

    if (run_enabled) {
        lv_obj_clear_state(recognize_btn, LV_STATE_DISABLED);
    } else {
        lv_obj_add_state(recognize_btn, LV_STATE_DISABLED);
    }

    if (preview_frozen) {
        lv_obj_clear_state(preview_btn, LV_STATE_DISABLED);
    } else {
        lv_obj_add_state(preview_btn, LV_STATE_DISABLED);
    }
}

static void recognize_event_cb(lv_event_t *e)
{
    if (lv_event_get_code(e) != LV_EVENT_CLICKED) {
        return;
    }

    if (!lnn_ap_ready_for_request() || recognize_requested || request_in_flight || preview_frozen) {
        return;
    }

    recognize_requested = true;
    lv_label_set_text(status_label, "capturing...");
    lv_label_set_text(result_label, "--");
    update_control_states(false);
}

#ifndef CONFIG_LISA_TOUCH_DEVICE
/* 无触摸板型：每 2s 自动触发一次识别（预览冻结 3s 后自动恢复） */
static void auto_recognize_timer_cb(lv_timer_t *t)
{
    (void)t;

    if (request_in_flight) {
        return;
    }

    if (!lnn_ap_ready_for_request() || recognize_requested) {
        return;
    }

    recognize_requested = true;
    lv_label_set_text(status_label, "capturing...");
    lv_label_set_text(result_label, "--");
    update_control_states(false);
}
#endif

static void preview_event_cb(lv_event_t *e)
{
    if (lv_event_get_code(e) != LV_EVENT_CLICKED) {
        return;
    }

    preview_frozen = false;
    recognize_requested = false;
    lnn_ap_mark_status_dirty();
    update_control_states(false);
}

static lv_obj_t *create_screen(void)
{
    lv_obj_t *screen = lv_obj_create(NULL);
    lv_obj_clear_flag(screen, LV_OBJ_FLAG_SCROLLABLE);
    lv_obj_set_style_bg_color(screen, lv_color_black(), LV_PART_MAIN);
    lv_obj_set_style_bg_opa(screen, LV_OPA_COVER, LV_PART_MAIN);

    preview_dsc.header.cf = LV_IMG_CF_TRUE_COLOR;
    preview_dsc.header.w = PREVIEW_WIDTH;
    preview_dsc.header.h = PREVIEW_HEIGHT;
    preview_dsc.data = (uint8_t *)preview_buf;
    preview_dsc.data_size = sizeof(preview_buf);

    preview_obj = lv_img_create(screen);
    lv_obj_set_pos(preview_obj, 0, 0);
    lv_obj_set_size(preview_obj, PREVIEW_WIDTH, PREVIEW_HEIGHT);
    lv_img_set_src(preview_obj, &preview_dsc);

    lv_obj_t *panel = lv_obj_create(screen);
    lv_obj_clear_flag(panel, LV_OBJ_FLAG_SCROLLABLE);
    lv_obj_set_style_bg_color(panel, lv_color_hex(0x202020), LV_PART_MAIN);
    lv_obj_set_style_bg_opa(panel, LV_OPA_COVER, LV_PART_MAIN);
    lv_obj_set_style_border_width(panel, 0, LV_PART_MAIN);
    lv_obj_set_style_radius(panel, 0, LV_PART_MAIN);
    lv_obj_set_pos(panel, PREVIEW_WIDTH, 0);
    lv_obj_set_size(panel, SIDE_PANEL_WIDTH, SCREEN_HEIGHT);

    status_label = lv_label_create(panel);
    lv_obj_set_width(status_label, SIDE_PANEL_WIDTH - 8);
    lv_obj_set_style_text_color(status_label, lv_color_hex(0xE0E0E0), LV_PART_MAIN);
    lv_label_set_long_mode(status_label, LV_LABEL_LONG_WRAP);
    lv_label_set_text(status_label, "waiting AP");
    lv_obj_align(status_label, LV_ALIGN_TOP_MID, 0, 8);

    result_label = lv_label_create(panel);
    lv_obj_set_width(result_label, SIDE_PANEL_WIDTH - 8);
    lv_obj_set_style_text_color(result_label, lv_color_hex(0xFFFFFF), LV_PART_MAIN);
    lv_label_set_long_mode(result_label, LV_LABEL_LONG_WRAP);
    lv_label_set_text(result_label, "--");
    lv_obj_align(result_label, LV_ALIGN_CENTER, 0, -18);

    recognize_btn = lv_btn_create(panel);
    lv_obj_set_size(recognize_btn, SIDE_PANEL_WIDTH - 10, 36);
    lv_obj_align(recognize_btn, LV_ALIGN_BOTTOM_MID, 0, -52);
    lv_obj_add_event_cb(recognize_btn, recognize_event_cb, LV_EVENT_CLICKED, NULL);
    lv_obj_add_state(recognize_btn, LV_STATE_DISABLED);

    lv_obj_t *btn_label = lv_label_create(recognize_btn);
    lv_label_set_text(btn_label, "RUN");
    lv_obj_center(btn_label);

    preview_btn = lv_btn_create(panel);
    lv_obj_set_size(preview_btn, SIDE_PANEL_WIDTH - 10, 36);
    lv_obj_align(preview_btn, LV_ALIGN_BOTTOM_MID, 0, -10);
    lv_obj_add_event_cb(preview_btn, preview_event_cb, LV_EVENT_CLICKED, NULL);
    lv_obj_add_state(preview_btn, LV_STATE_DISABLED);

    btn_label = lv_label_create(preview_btn);
    lv_label_set_text(btn_label, "PREVIEW");
    lv_obj_center(btn_label);

    return screen;
}

static void refresh_status_from_ap(void)
{
    static uint32_t last_logged_seq = UINT32_MAX;
    static uint32_t last_logged_state = UINT32_MAX;
    lnn_ap_status_t status;

    lnn_ap_read_status(&status);
    if (status.magic != LNN_RESNET18_REAL_IPC_MAGIC) {
        request_in_flight = false;
        lv_label_set_text(status_label, "AP offline");
        update_control_states(false);
        return;
    }

    if (status.seq != last_logged_seq || status.state != last_logged_state) {
        LOGI("ap shared status seq=%u state=%u message=%s", status.seq, status.state, status.message);
        last_logged_seq = status.seq;
        last_logged_state = status.state;
    }

    switch (status.state) {
    case LNN_RESNET18_REAL_STATE_BOOTING:
        lv_label_set_text(status_label, "AP booting");
        update_control_states(false);
        break;
    case LNN_RESNET18_REAL_STATE_IDLE:
        request_in_flight = false;
        lv_label_set_text(status_label, "ready");
        update_control_states(true);
        break;
    case LNN_RESNET18_REAL_STATE_REQUEST:
        request_in_flight = true;
        lv_label_set_text(status_label, "request sent");
        update_control_states(false);
        break;
    case LNN_RESNET18_REAL_STATE_BUSY:
        request_in_flight = true;
        lv_label_set_text(status_label, "recognizing...");
        update_control_states(false);
        break;
    case LNN_RESNET18_REAL_STATE_DONE:
        request_in_flight = false;
        lv_label_set_text_fmt(status_label, "score: %d", (int)status.result_score);
        lv_label_set_text_fmt(result_label, "%s", status.result_text);
        update_control_states(true);
        break;
    case LNN_RESNET18_REAL_STATE_ERROR:
        request_in_flight = false;
        lv_label_set_text(status_label, status.message);
        update_control_states(false);
        break;
    default:
        lv_label_set_text(status_label, "unknown");
        update_control_states(false);
        break;
    }
}

void lnn_task_ui(void *arg)
{
    (void)arg;

    lv_obj_t *screen = create_screen();
    lv_scr_load(screen);
    lv_task_handler();
    lisa_display_blanking_off(display_device);
    TickType_t last_result_poll = 0;

    while (1) {
        if (preview_dirty) {
            preview_dirty = false;
            stat_flush_cnt++;
            lv_img_set_src(preview_obj, &preview_dsc);
            lv_obj_invalidate(preview_obj);
        }

        stat_uitask_cnt++;
        TickType_t now = xTaskGetTickCount();
        if (lnn_ap_take_status_dirty() || (now - last_result_poll) >= pdMS_TO_TICKS(RESULT_POLL_INTERVAL_MS)) {
            last_result_poll = now;
            uint32_t t_poll = (uint32_t)xTaskGetTickCount();
            refresh_status_from_ap();
            stat_poll_ms += (uint32_t)xTaskGetTickCount() - t_poll;
        }

        uint32_t t_lv = (uint32_t)xTaskGetTickCount();
        uint32_t wait_time = lv_task_handler();
        stat_lvhandler_ms += (uint32_t)xTaskGetTickCount() - t_lv;
        stat_lvhandler_cnt++;
        /* 睡眠上限 15ms：LVGL 返回的 time_till_next 在无脏区时可能偏大，
         * 免费跑高循环频率可及时消费 preview_dirty，预览不再卡顿 */
        if (wait_time > 15U || wait_time == 0U) {
            wait_time = (wait_time == 0U) ? 5U : 15U;
        }
        stat_wait_ms += wait_time;
        if (wait_time > stat_wait_max) {
            stat_wait_max = wait_time;
        }
        lisa_thread_mdelay(wait_time);
    }
}

int lnn_display_touch_init(void)
{
    lv_init();

    lisa_device_t *gpioa_dev = lisa_device_get("gpioa");
    lisa_device_t *gpiob_dev = lisa_device_get("gpiob");

    lisa_display_config_t display_config = {
        .bus_type = LISA_DISPLAY_BUS_SPI_4WIRE,
        /* arcs_mini: LCD 挂 spi0，CS/CD/TE 在 gpioa(PAD_A)，RST 在 gpiob，
         * 背光 PWM 通道 1 高有效（对齐产品 service_brightness 配置） */
        .bus_config = {.spi_4wire =
                           {
                               .spi_dev = lisa_device_get("spi0"),
                               .cs_gpio = gpioa_dev,
                               .cs_pin = LCD_CS_PIN,
                               .dc_gpio = gpioa_dev,
                               .dc_pin = LCD_CD_PIN,
                               .spi_freq = 50 * 1000 * 1000,
                           }},
        .te_gpio = gpioa_dev,
        .te_pin = LCD_TE_PIN,
        .backlight = {.type = LISA_DISPLAY_BACKLIGHT_TYPE_PWM,
                      .blacklight_polarity = LISA_DISPLAY_BLACKLIGHT_POLARITY_HIGH,
                      .config.pwm = {.channel = 1, .dev = lisa_device_get("pwm0"), .freq = 2000}},
        .rst_gpio = gpiob_dev,
        .rst_pin = LCD_RST_PIN,
    };

    display_device = lisa_device_get("display");
    if (!display_device) {
        LOGE("failed to get display device");
        return -1;
    }

    int ret = lisa_display_attach_bus(display_device, &display_config);
    if (ret != 0) {
        LOGE("display attach bus failed: %d", ret);
        return -1;
    }
    lv_port_disp_init(display_device);

#ifdef CONFIG_LISA_TOUCH_DEVICE
    /* arcs_mini 无触摸屏：跳过触摸初始化，用定时自动识别代替按键 */
    touch_device = lisa_device_get(TOUCH_DEVICE);
    if (!lisa_device_ready(touch_device)) {
        LOGE("%s device not ready", TOUCH_DEVICE);
        return -1;
    }

    lisa_device_t *i2c_dev = lisa_device_get(I2C_DEVICE);
    if (!lisa_device_ready(i2c_dev)) {
        LOGE("%s device not ready", I2C_DEVICE);
        return -1;
    }

    lisa_touch_bus_config_t touch_config = {
        .bus_type = LISA_TOUCH_BUS_I2C,
        .config = {.i2c =
                       {
                           .i2c_dev = i2c_dev,
                           .int_gpio = gpioa_dev,
                           .int_pin = TOUCH_INT_PIN,
                           .rst_gpio = gpioa_dev,
                           .rst_pin = TOUCH_RST_PIN,
                       }},
    };

    ret = lisa_touch_attach_bus(touch_device, &touch_config);
    if (ret != 0) {
        LOGE("touch attach bus failed: %d", ret);
        return -1;
    }

    ret = touch_interrupt_init(touch_device);
    if (ret != 0) {
        return ret;
    }
#else
    lv_timer_t *auto_timer = lv_timer_create(auto_recognize_timer_cb, 2000, NULL);
    if (!auto_timer) {
        return -1;
    }
#endif

    lisa_display_set_brightness(display_device, 90);

    return 0;
}

int lnn_camera_init(void)
{
    camera_device = lisa_device_get(CAMERA_DEVICE);
    if (!lisa_device_ready(camera_device)) {
        LOGE("%s device not ready", CAMERA_DEVICE);
        return -1;
    }

    lisa_device_t *i2c_dev = lisa_device_get(I2C_DEVICE);
    if (!lisa_device_ready(i2c_dev)) {
        LOGE("%s device not ready", I2C_DEVICE);
        return -1;
    }

    lisa_camera_config_t config = {
        .hw_config = {
            .mclk_pad = CSK_IOMUX_PAD_A,
            .mclk_pin = CAM_MCLK_PIN,
#ifdef CAM_PWDN_PIN
            .pwdn_gpio_dev = lisa_device_get("gpiob"),
            .pwdn_pin = CAM_PWDN_PIN,
#else
            /* arcs_mini 板型摄像头无 PWDN 引脚 */
            .pwdn_gpio_dev = NULL,
            .pwdn_pin = -1,
#endif
            .pwdn_delay_us = 0,
            .xclk_delay_us = 0,
            .i2c_dev = i2c_dev,
        },
        .xclk_freq_hz = 18000000,
        .fb_count = 3,
        .enable_hmirror = false,
        .enable_vflip = false,
        .enable_colorbar = false,
    };

    int ret = lisa_camera_setup(camera_device, &config);
    if (ret != LISA_DEVICE_OK) {
        LOGE("camera setup failed: %d", ret);
        return -1;
    }

    ret = lisa_camera_set_pixformat(camera_device, LISA_CAMERA_PIXFMT_RGB565);
    if (ret != LISA_DEVICE_OK) {
        LOGW("set RGB565 failed: %d, use sensor default", ret);
    }

    lisa_camera_bus_config_t bus_config = {
        .dma_channel = CAMERA_DMA_CHANNEL,
        .bus_type = LISA_CAMERA_BUS_DVP,
        .config.dvp = {
            .dvp_dev = lisa_device_get(DVP_DEVICE),
            .dvp_freq = config.xclk_freq_hz,
            .data_align = 1,
            .line_offset = 0,
            .pixel_offset = 0,
            .pclk_polarity = 0,
            .vsync_polarity = 1,
            .hsync_polarity = 1,
        },
    };
    lisa_camera_get_framesize(camera_device, &bus_config.width, &bus_config.height);
    bus_config.pixel_format = lisa_camera_get_pixformat(camera_device);

    ret = lisa_camera_attach_bus(camera_device, &bus_config);
    if (ret != LISA_DEVICE_OK) {
        LOGE("camera attach bus failed: %d", ret);
        return -1;
    }

    ret = lisa_camera_start(camera_device);
    if (ret != LISA_DEVICE_OK) {
        LOGE("camera start failed: %d", ret);
        return -1;
    }

    LOGI("camera started: %ux%u format=%d", bus_config.width, bus_config.height, bus_config.pixel_format);
    return 0;
}

void lnn_task_camera(void *arg)
{
    (void)arg;

    while (1) {
        lisa_camera_fb_t *fb = NULL;
        int ret = lisa_camera_capture(camera_device, &fb);
        if (ret != LISA_DEVICE_OK || fb == NULL) {
            LOGE("capture failed: %d", ret);
            lisa_thread_mdelay(100);
            continue;
        }

        stat_capture_cnt++;
        uint32_t now = (uint32_t)xTaskGetTickCount();

        if (fb->format == LISA_CAMERA_PIXFMT_RGB565 && fb->buf != NULL) {
            rgb565_window_t window = make_rgb565_center_window((const uint16_t *)fb->buf, fb->width, fb->height);

            uint32_t t0 = (uint32_t)xTaskGetTickCount();
            if (recognize_requested) {
                scale_rgb565_to_preview(&window);
                if (lnn_ap_submit_window_for_inference(&window) == 0) {
                    recognize_requested = false;
                    request_in_flight = true;   /* 预览继续，结果异步刷新标签 */
                    lnn_ap_mark_status_dirty();
                } else {
                    recognize_requested = false;
                    preview_frozen = false;
                    lnn_ap_mark_status_dirty();
                }
            } else if (!preview_frozen) {
                scale_rgb565_to_preview(&window);
            }
            stat_scale_ms += (uint32_t)xTaskGetTickCount() - t0;
            stat_scale_cnt++;
        } else {
            LOGW("unsupported camera frame format=%d", fb->format);
        }

        lisa_camera_release_fb(camera_device, fb);

        if (stat_window_start == 0U) {
            stat_window_start = now;
        } else if (now - stat_window_start >= FPS_STAT_WINDOW_MS) {
            LOGI("fps-stat: capture=%u.%02u fps, scale=%ums/call, ui-refresh=%u, busy=%u%%, "
                 "lv_handler=%ums x%u, ui-loop=%u, sleep=%u(max%u), poll=%ums",
                 (unsigned)((uint64_t)stat_capture_cnt * 100000U / FPS_STAT_WINDOW_MS / 100U),
                 (unsigned)((uint64_t)stat_capture_cnt * 100000U / FPS_STAT_WINDOW_MS % 100U),
                 stat_scale_cnt ? stat_scale_ms / stat_scale_cnt : 0U,
                 stat_flush_cnt,
                 stat_scale_ms * 100U / FPS_STAT_WINDOW_MS,
                 stat_lvhandler_cnt ? stat_lvhandler_ms / stat_lvhandler_cnt : 0U,
                 stat_lvhandler_cnt,
                 stat_uitask_cnt,
                 stat_wait_ms,
                 stat_wait_max,
                 stat_poll_ms);
            stat_capture_cnt = 0;
            stat_scale_ms = 0;
            stat_scale_cnt = 0;
            stat_flush_cnt = 0;
            stat_lvhandler_ms = 0;
            stat_lvhandler_cnt = 0;
            stat_uitask_cnt = 0;
            stat_wait_ms = 0;
            stat_wait_max = 0;
            stat_poll_ms = 0;
            stat_window_start = now;
        }

        vTaskDelay(pdMS_TO_TICKS(3));
    }
}
```

## src/board_pins.c
```c
/*
 * Copyright (c) 2026 Anhui Listenai Co., Ltd.
 * SPDX-License-Identifier: Apache-2.0
 */

#include <IOMuxManager.h>
#include <board.h>

#include "lnn_resnet18_real_cp.h"

#ifdef CONFIG_BOARD_ARCS_EVB

void lisa_gpioa_pinmux(void)
{
    IOMuxManager_PinConfigure(CSK_IOMUX_PAD_A, LCD_RST_PIN, CSK_IOMUX_FUNC_ALTER1);
    IOMuxManager_PinConfigure(TOUCH_RST_PORT, TOUCH_RST_PIN, TOUCH_RST_FUNC);
    IOMuxManager_PinConfigure(TOUCH_INT_PORT, TOUCH_INT_PIN, TOUCH_INT_FUNC);
}

void lisa_gpiob_pinmux(void)
{
    IOMuxManager_PinConfigure(CSK_IOMUX_PAD_B, LCD_TE_PIN, CSK_IOMUX_FUNC_DEFAULT);
    IOMuxManager_PinConfigure(CSK_IOMUX_PAD_B, LCD_CD_PIN, CSK_IOMUX_FUNC_DEFAULT);
    IOMuxManager_PinConfigure(CSK_IOMUX_PAD_B, LCD_CS_PIN, CSK_IOMUX_FUNC_DEFAULT);
    IOMuxManager_PinConfigure(CSK_IOMUX_PAD_B, CAM_PWDN_PIN, CSK_IOMUX_FUNC_DEFAULT);
}

void lisa_i2c0_pinmux(void)
{
    IOMuxManager_PinConfigure(TOUCH_I2C_SDA_PORT, TOUCH_I2C_SDA_PIN, TOUCH_I2C_SDA_FUNC);
    IOMuxManager_PinConfigure(TOUCH_I2C_SCL_PORT, TOUCH_I2C_SCL_PIN, TOUCH_I2C_SCL_FUNC);
}

void lisa_spi1_pinmux(void)
{
    IOMuxManager_PinConfigure(CSK_IOMUX_PAD_B, LCD_SPI_CLK_PIN, CSK_IOMUX_FUNC_ALTER6);
    IOMuxManager_PinConfigure(CSK_IOMUX_PAD_B, LCD_SPI_DATA_PIN, CSK_IOMUX_FUNC_ALTER6);
}

void lisa_pwm_pinmux(void)
{
    IOMuxManager_PinConfigure(CSK_IOMUX_PAD_A, LCD_PWM_PIN, CSK_IOMUX_FUNC_ALTER12);
}

void lisa_dvp_pinmux(void)
{
    IOMuxManager_PinConfigure(CSK_IOMUX_PAD_A, CAM_HSYNC_PIN, CSK_IOMUX_FUNC_ALTER16);
    IOMuxManager_PinConfigure(CSK_IOMUX_PAD_A, CAM_VSYNC_PIN, CSK_IOMUX_FUNC_ALTER16);
    IOMuxManager_PinConfigure(CSK_IOMUX_PAD_A, CAM_PCLK_PIN, CSK_IOMUX_FUNC_ALTER16);
    IOMuxManager_PinConfigure(CSK_IOMUX_PAD_A, CAM_D0_PIN, CSK_IOMUX_FUNC_ALTER16);
    IOMuxManager_PinConfigure(CSK_IOMUX_PAD_A, CAM_D1_PIN, CSK_IOMUX_FUNC_ALTER16);
    IOMuxManager_PinConfigure(CSK_IOMUX_PAD_A, CAM_D2_PIN, CSK_IOMUX_FUNC_ALTER16);
    IOMuxManager_PinConfigure(CSK_IOMUX_PAD_A, CAM_D3_PIN, CSK_IOMUX_FUNC_ALTER16);
    IOMuxManager_PinConfigure(CSK_IOMUX_PAD_A, CAM_D4_PIN, CSK_IOMUX_FUNC_ALTER16);
    IOMuxManager_PinConfigure(CSK_IOMUX_PAD_A, CAM_D5_PIN, CSK_IOMUX_FUNC_ALTER16);
    IOMuxManager_PinConfigure(CSK_IOMUX_PAD_A, CAM_D6_PIN, CSK_IOMUX_FUNC_ALTER16);
    IOMuxManager_PinConfigure(CSK_IOMUX_PAD_A, CAM_D7_PIN, CSK_IOMUX_FUNC_ALTER16);
}

#endif
```

## src/ipc_client.c
```c
/*
 * Copyright (c) 2026 Anhui Listenai Co., Ltd.
 * SPDX-License-Identifier: Apache-2.0
 */

#define LOG_TAG "mbox_client"

#include <cache.h>
#include <Driver_MBX.h>
#include <lisa_log.h>
#include <stdbool.h>
#include <stdint.h>

#include "FreeRTOS.h"
#include "semphr.h"
#include "task.h"

#include "lnn_resnet18_real_cp.h"

static SemaphoreHandle_t ipc_mutex;
static volatile bool ap_status_dirty = true;
static lnn_resnet18_real_msg_t mbox_rx_msg __attribute__((aligned(4)));

void lnn_ipc_cache_flush(volatile lnn_resnet18_real_ipc_t *ipc)
{
    HAL_FlushDCache_by_Addr((uint32_t *)(uintptr_t)ipc, sizeof(*ipc));
    HAL_FlushDCache();
    __asm__ volatile("fence iorw, iorw" : : : "memory");
}

void lnn_ipc_cache_invalidate(volatile lnn_resnet18_real_ipc_t *ipc)
{
    __asm__ volatile("fence iorw, iorw" : : : "memory");
    HAL_InvalidateDCache_by_Addr((uint32_t *)(uintptr_t)ipc, sizeof(*ipc));
}

void lnn_ipc_lock(void)
{
    if (ipc_mutex != NULL) {
        (void)xSemaphoreTake(ipc_mutex, portMAX_DELAY);
    }
}

void lnn_ipc_unlock(void)
{
    if (ipc_mutex != NULL) {
        (void)xSemaphoreGive(ipc_mutex);
    }
}

bool lnn_ipc_ready_for_request(volatile lnn_resnet18_real_ipc_t *ipc)
{
    return ipc->magic == LNN_RESNET18_REAL_IPC_MAGIC &&
           (ipc->state == LNN_RESNET18_REAL_STATE_IDLE || ipc->state == LNN_RESNET18_REAL_STATE_DONE);
}

void lnn_ipc_mark_status_dirty(void)
{
    ap_status_dirty = true;
}

bool lnn_ipc_take_status_dirty(void)
{
    bool dirty = ap_status_dirty;

    ap_status_dirty = false;
    return dirty;
}

int lnn_ipc_mutex_init(void)
{
    ipc_mutex = xSemaphoreCreateMutex();
    if (ipc_mutex == NULL) {
        LOGE("create IPC mutex failed");
        return -1;
    }

    return 0;
}

static int8_t lnn_mbox_event_handler(uint32_t event, uint32_t param)
{
    if (event == CSK_MBX_EVENT_RECEIVE_COMPLETE) {
        const lnn_resnet18_real_msg_t msg = mbox_rx_msg;

        if (param == LNN_RESNET18_REAL_MBOX_CH && msg.magic == LNN_RESNET18_REAL_IPC_MAGIC &&
            msg.type == LNN_RESNET18_REAL_MSG_STATUS) {
            lnn_ipc_mark_status_dirty();
        }
        (void)MBX_Receive(NULL, &mbox_rx_msg, LNN_RESNET18_REAL_MBOX_CH);
    }

    return 0;
}

int lnn_mbox_init(void)
{
    int32_t ret = MBX_Initialize(NULL, lnn_mbox_event_handler);
    if (ret != CSK_DRIVER_OK) {
        LOGE("init mailbox failed: %d", ret);
        return -1;
    }

    ret = MBX_Receive(NULL, &mbox_rx_msg, LNN_RESNET18_REAL_MBOX_CH);
    if (ret != CSK_DRIVER_OK) {
        LOGE("arm mailbox receive failed: %d", ret);
        return -1;
    }

    return 0;
}

int lnn_ipc_notify_ap(uint32_t seq)
{
    lnn_resnet18_real_msg_t msg = {
        .magic = LNN_RESNET18_REAL_IPC_MAGIC,
        .seq = seq,
        .type = LNN_RESNET18_REAL_MSG_REQUEST,
        .state = LNN_RESNET18_REAL_STATE_REQUEST,
    };
    int32_t ret = CSK_DRIVER_OK;

    for (uint32_t i = 0; i < 20U; i++) {
        ret = MBX_Send(NULL, &msg, LNN_RESNET18_REAL_MBOX_CH);
        if (ret == CSK_DRIVER_OK) {
            return 0;
        }
        vTaskDelay(pdMS_TO_TICKS(1U));
    }

    LOGW("notify AP by mailbox failed: %d", ret);
    return -1;
}
```

## src/ipc_shared.c
```c
/*
 * Copyright (c) 2026 Anhui Listenai Co., Ltd.
 * SPDX-License-Identifier: Apache-2.0
 */

#include "lnn_resnet18_real_ipc.h"

volatile lnn_resnet18_real_ipc_t lnn_resnet18_real_ipc_block
    __attribute__((section(".ipc.lnn"), aligned(64)));

_Static_assert((sizeof(lnn_resnet18_real_ipc_t) % 64U) == 0U,
               "LNN IPC shared block must stay cache-line aligned");
_Static_assert(sizeof(lnn_resnet18_real_msg_t) == 16U,
               "LNN mailbox message must fit in four mailbox words");
```

## src/lnn_resnet18_real_cp.h
```c
/*
 * Copyright (c) 2026 Anhui Listenai Co., Ltd.
 * SPDX-License-Identifier: Apache-2.0
 */

#pragma once

#include <stdbool.h>
#include <stdint.h>

#include "lnn_resnet18_real_ipc.h"

#define CAMERA_DEVICE             "camera"
#define DVP_DEVICE                "dvp0"
#define TOUCH_DEVICE              "touch_cst328"
#define I2C_DEVICE                "i2c0"

#define CAMERA_DMA_CHANNEL        (2U)

#define SCREEN_WIDTH              (320U)
#define SCREEN_HEIGHT             (240U)
#define CAMERA_WINDOW_WIDTH       (480U)
#define CAMERA_WINDOW_HEIGHT      (480U)
#define PREVIEW_WIDTH             (240U)
#define PREVIEW_HEIGHT            (240U)
#define SIDE_PANEL_WIDTH          (SCREEN_WIDTH - PREVIEW_WIDTH)
#define RESULT_POLL_INTERVAL_MS   (200U)
#define TOUCH_POLL_INTERVAL_MS    (50U)
#define REQUEST_NOTIFY_MODE       "mbox"

#ifdef CONFIG_BOARD_ARCS_EVB

#define LCD_CS_PIN                5
#define LCD_SPI_CLK_PIN           3
#define LCD_SPI_DATA_PIN          1

#define CAM_PWDN_PIN              7
#define CAM_HSYNC_PIN             10
#define CAM_VSYNC_PIN             11
#define CAM_PCLK_PIN              12
#define CAM_MCLK_PIN              26
#define CAM_D0_PIN                13
#define CAM_D1_PIN                14
#define CAM_D2_PIN                15
#define CAM_D3_PIN                16
#define CAM_D4_PIN                17
#define CAM_D5_PIN                18
#define CAM_D6_PIN                19
#define CAM_D7_PIN                20

#define TOUCH_I2C_SDA_PORT        CSK_IOMUX_PAD_A
#define TOUCH_I2C_SDA_PIN         22
#define TOUCH_I2C_SDA_FUNC        8
#define TOUCH_I2C_SCL_PORT        CSK_IOMUX_PAD_A
#define TOUCH_I2C_SCL_PIN         23
#define TOUCH_I2C_SCL_FUNC        8
#define TOUCH_RST_PORT            CSK_IOMUX_PAD_A
#define TOUCH_RST_PIN             25
#define TOUCH_RST_FUNC            0
#define TOUCH_INT_PORT            CSK_IOMUX_PAD_A
#define TOUCH_INT_PIN             24
#define TOUCH_INT_FUNC            0

#endif

typedef struct {
    const uint16_t *pixels;
    uint32_t stride;
    uint32_t x;
    uint32_t y;
    uint32_t width;
    uint32_t height;
} rgb565_window_t;

typedef struct {
    uint32_t magic;
    uint32_t seq;
    uint32_t state;
    int32_t result_score;
    char result_text[LNN_RESNET18_REAL_LABEL_MAX];
    char message[LNN_RESNET18_REAL_MESSAGE_MAX];
} lnn_ap_status_t;

int lnn_mbox_init(void);
int lnn_ipc_mutex_init(void);
void lnn_ipc_lock(void);
void lnn_ipc_unlock(void);
void lnn_ipc_cache_flush(volatile lnn_resnet18_real_ipc_t *ipc);
void lnn_ipc_cache_invalidate(volatile lnn_resnet18_real_ipc_t *ipc);
bool lnn_ipc_ready_for_request(volatile lnn_resnet18_real_ipc_t *ipc);
int lnn_ipc_notify_ap(uint32_t seq);
void lnn_ipc_mark_status_dirty(void);
bool lnn_ipc_take_status_dirty(void);

bool lnn_ap_ready_for_request(void);
int lnn_ap_submit_window_for_inference(const rgb565_window_t *window);
void lnn_ap_read_status(lnn_ap_status_t *status);
void lnn_ap_mark_status_dirty(void);
bool lnn_ap_take_status_dirty(void);

int lnn_display_touch_init(void);
int lnn_camera_init(void);
void lnn_task_ui(void *arg);
void lnn_task_camera(void *arg);
```

## src/lnn_usb_adb.c
```c
/*
 * lnn_usb_adb.c - LNN demo 的最小 ADB 服务（shell + reboot recovery）
 *
 * 移植自 samples/subsys/usb/device/cherryusb_adb：只保留 adb 协议所需的
 * vendor bulk 端点。启用后可直接在 demo 固件上：
 *   adb shell              # 查看运行日志 / shell 命令
 *   adb reboot recovery    # 重启进 BOOT recovery，配合 auto.sh 烧录
 *   adb reboot hard        # 普通硬复位
 * 免去每次烧录手动进 BOOT 模式。
 */
#include <lisa_log.h>
#include "soc/chip.h"

#include "FreeRTOS.h"
#include "task.h"

#include "usbd_core.h"
#include "adb.h"
#include "adb_device.h"
#include "adb_reboot.h"
#include "adb_shell.h"

#include "PowerManager.h"

#define LOG_TAG "lnn_adb"

extern const struct usb_descriptor cherryusb_adb_descriptor;
extern const uint8_t g_adb_in_ep;
extern const uint8_t g_adb_out_ep;

static uint8_t g_usb_busid;
static struct usbd_interface adb_intf;

/* adb reboot recovery 的落点：写 AON 恢复标志后全片复位，
 * 下次 boot 据此进入 BOOT ADB recovery（对齐产品 power_reboot_recovery） */
void sys_platform_recovery(void)
{
#define BOOT_INFO_RECOVER_REASON_SOFT 0x00000100u
#define SYSTEM_SW_RESET_KEY           0xCAFE000Au
    uint32_t boot_info = IP_AON_CTRL->REG_AON_DIG_RSVD4.all;
    boot_info |= BOOT_INFO_RECOVER_REASON_SOFT | (1u << 31); /* RECOVERY_REQ */
    IP_AON_CTRL->REG_AON_DIG_RSVD4.all = boot_info;
    (void)IP_AON_CTRL->REG_AON_DIG_RSVD4.all;
    __RWMB();

    while (1) {
        IP_SYSCTRL->REG_SW_RESET_CP1.bit.CMNSW2CMN_RST_EN = 1;
        IP_SYSCTRL->REG_SW_RESET_CP1.bit.CMNSW2CP_RST_EN = 1;
        IP_SYSCTRL->REG_SW_RESET_CP1.bit.CMNSW2AP_RST_EN = 1;
        __RWMB();
        IP_SYSCTRL->REG_SW_RESET_CP0.all = SYSTEM_SW_RESET_KEY;
        __RWMB();
    }
#undef BOOT_INFO_RECOVER_REASON_SOFT
#undef SYSTEM_SW_RESET_KEY
}

static void usbd_event_handler(uint8_t busid, uint8_t event)
{
    (void)busid;
    switch (event) {
    case USBD_EVENT_CONFIGURED:
        LOGI("usb configured");
        break;
    case USBD_EVENT_DISCONNECTED:
        LOGW("usb disconnected");
        break;
    default:
        break;
    }
}

int lnn_usb_adb_start(void)
{
    /* USB 时钟与 PHY（对齐产品 app_usb 流程） */
    IP_SYSCTRL->REG_PERI_CLK_CFG6.bit.ENA_USB_CLK = 0x01;
    IP_CMN_SYS->REG_USB_CTRL1.bit.USBPHY_OUTCLKSEL = 0x1;
    IP_CMN_SYS->REG_USB_CTRL1.bit.USBC_CFG_IDDIG = 0x1;
    IP_CMN_SYS->REG_USB_CTRL1.bit.UTMI_DATABUS16_8 = 0x1;

    usbd_desc_register(g_usb_busid, &cherryusb_adb_descriptor);
    usbd_add_interface(g_usb_busid,
                       adb_dev_init_intf(g_usb_busid, &adb_intf,
                                         g_adb_in_ep, g_adb_out_ep));

    adb_init();
#if CONFIG_ADB_REBOOT
    adb_reboot_init();
#endif
#if CONFIG_ADB_SHELL
    adb_shell_init();
#endif

    usbd_initialize(g_usb_busid, USBC_BASE, usbd_event_handler);
    LOGI("adb ready (shell + reboot recovery)");
    return 0;
}

static void lnn_task_usb(void *arg)
{
    (void)arg;
    lnn_usb_adb_start();
    while (1) {
        vTaskDelay(pdMS_TO_TICKS(1000));
    }
}

int lnn_usb_adb_init(void)
{
    if (xTaskCreate(lnn_task_usb, "lnn_adb", 4096, NULL, 5, NULL) != pdPASS) {
        LOGE("create usb task failed");
        return -1;
    }
    return 0;
}
```
