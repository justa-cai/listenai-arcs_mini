## CMakeLists.txt
```
cmake_minimum_required(VERSION 3.19)

set(CMAKE_EXPORT_COMPILE_COMMANDS ON)

find_package(listenai-cmake REQUIRED HINTS $ENV{ARCS_BASE})

project(thinker_resnet18_real_ap C)

set(CONFIG_ALGO_DMA_COPY_USE_DMA 1)
set(CONFIG_ALGO_DMA_CHANNEL_PERSISTENT 1)

add_subdirectory(
    ${CMAKE_CURRENT_LIST_DIR}/../../common/arcs
    ${CMAKE_CURRENT_BINARY_DIR}/lnn_common_arcs
)

listenai_add_executable(${PROJECT_NAME})

target_sources(${PROJECT_NAME} PRIVATE
    ../src/ipc_shared.c
    src/main.c
    src/resnet18_real_ap.c
)

target_include_directories(${PROJECT_NAME} PRIVATE
    src
    ../include
)

listenai_add_linker_section(
    FILE ${CMAKE_CURRENT_SOURCE_DIR}/../linker/thinker-apram.ld
    SLOT COMPONENTS
    SORT_KEY "50-app"
)

target_link_libraries(${PROJECT_NAME} PRIVATE
    thinker
    arcs_dma_cpy
)
```

## Kconfig
```
# Copyright (c) 2026, LISTENAI
# SPDX-License-Identifier: Apache-2.0

osource "$ARCS_BASE/Kconfig"

orsource "$ARCS_BASE/labs/lnn/common/arcs/libraries/Kconfig"

config THINKER_RESNET18_REAL_MODEL_ADDR
	hex "Thinker ResNet18 real model flash address"
	default 0x30500000

config THINKER_RESNET18_REAL_MODEL_SIZE
	hex "Thinker ResNet18 real model size"
	default 0x1FD1E0

config THINKER_RESNET18_REAL_PSRAM_POOL_SIZE
	hex "Thinker ResNet18 real PSRAM pool size"
	default 0x10000

config THINKER_RESNET18_REAL_SHARE_POOL_SIZE
	hex "Thinker ResNet18 real share pool size"
	default 0x58000

config THINKER_RESNET18_REAL_CP_FLASH_BASE
	hex "Thinker ResNet18 real CP image flash base"
	default 0x30200000
```

## prj.conf
```kconfig
# AP Core: Thinker runtime and ResNet18 inference.
CONFIG_MEM_CONFIG=y
CONFIG_MEM_SRAM_BASE=0x20010000
CONFIG_MEM_SRAM_SIZE=0x00020000
CONFIG_MEM_PSRAM_BASE=0x28000000
CONFIG_MEM_PSRAM_SIZE=0x00700000
CONFIG_MEM_FLASH_BASE=0x30040000
CONFIG_MEM_FLASH_SIZE=0x000C0000
CONFIG_MEM_LUNA_SHARED_SIZE=0x00005000
CONFIG_MEM_IPC_BASE=0x2004D000
CONFIG_MEM_IPC_SIZE=0x00003000
CONFIG_MEM_APRAM_BASE=0x20051000
CONFIG_MEM_APRAM_SIZE=0x0005F000

CONFIG_ARCS_AP_CORE=y
CONFIG_CLOCK_INIT=y
CONFIG_PSRAM_INIT=y
CONFIG_ARCS_HAL_IPC=y
CONFIG_ARCS_HAL_IPC_SLAVE=y
CONFIG_ARCS_HAL_IPC_MRPC_SERVER=n
CONFIG_ARCS_HAL_IPC_MRPC_CLIENT=n
CONFIG_ARCS_HAL_IPC_PRINT=y
CONFIG_ARCS_HAL_LSF=n
CONFIG_IPC_LSF=n
CONFIG_LSF_SERVER=n
CONFIG_DISK_MEM=n
CONFIG_DISK_MEM_CLIENT=n
CONFIG_DISK_MEM_SERVER=n

CONFIG_LOG=y
CONFIG_PRINTF_LOG_REDIRECT=y
CONFIG_BACK_TRACE=y

CONFIG_HEAP_SIZE=0x10000
CONFIG_PSRAM_HEAP_SIZE=0x100000
CONFIG_MAIN_TASK_STACK_SIZE=8192
CONFIG_MAIN_TASK_PRIORITY=1
CONFIG_FREERTOS_STATIC_ALLOCATION_ENABLE=y

CONFIG_THINKER_LIB=y
CONFIG_THINKER_RESNET18_REAL_MODEL_ADDR=0x30200000
# 模型区 0x30200000..0x34400000（wake_word+emoji 借用区）上限；pkg 头自带真实长度
CONFIG_THINKER_RESNET18_REAL_MODEL_SIZE=0x220000
# 不得越过 0x28100000（PSRAM nocache heap 起点，1MB 对齐），否则 tModelInit memset 踩堆
CONFIG_THINKER_RESNET18_REAL_PSRAM_POOL_SIZE=0xE0000
CONFIG_THINKER_RESNET18_REAL_SHARE_POOL_SIZE=0x58000
CONFIG_THINKER_RESNET18_REAL_CP_FLASH_BASE=0x30600000
```

## src/main.c
```c
/*
 * Copyright (c) 2026 Anhui Listenai Co., Ltd.
 * SPDX-License-Identifier: Apache-2.0
 */

#define LOG_TAG "lnn_real_ap"

#include <arcs_ap.h>
#include <cache.h>
#include <Driver_MBX.h>
#include <lisa_log.h>
#include <stdbool.h>
#include <stdint.h>
#include <stdio.h>
#include <string.h>

#include "FreeRTOS.h"
#include "queue.h"
#include "task.h"

#include "lnn_resnet18_real_ipc.h"
#include "resnet18_real_ap.h"

#define REQUEST_POLL_INTERVAL_MS  (50U)
#define AP_HEARTBEAT_INTERVAL_MS  (2000U)
#define STATUS_NOTIFY_QUEUE_DEPTH (4U)

typedef struct {
    uint32_t seq;
    uint32_t state;
} ap_status_notify_t;

typedef enum {
    AP_PHASE_BOOT = 0,
    AP_PHASE_MODEL_INIT,
    AP_PHASE_READY,
    AP_PHASE_WAIT,
    AP_PHASE_INVALIDATE,
    AP_PHASE_ACCEPT,
    AP_PHASE_BUSY,
    AP_PHASE_FORWARD,
    AP_PHASE_RESULT,
    AP_PHASE_ERROR,
} ap_phase_t;

static volatile uint32_t ap_phase = AP_PHASE_BOOT;
static volatile uint32_t ap_loop_count;
static volatile uint32_t ap_mbox_msg_count;
static volatile uint32_t ap_last_notified;
static volatile uint32_t ap_last_msg_seq;
static volatile uint32_t ap_last_msg_state;
static volatile uint32_t ap_last_seq;
static volatile uint32_t ap_last_state = LNN_RESNET18_REAL_STATE_BOOTING;
static volatile uint32_t ap_last_input_bytes;
static QueueHandle_t status_notify_queue;
static TaskHandle_t inference_task_handle;
static lnn_resnet18_real_msg_t mbox_rx_msg __attribute__((aligned(4)));

static const char *ap_phase_name(uint32_t phase)
{
    switch ((ap_phase_t)phase) {
    case AP_PHASE_BOOT:
        return "boot";
    case AP_PHASE_MODEL_INIT:
        return "model_init";
    case AP_PHASE_READY:
        return "ready";
    case AP_PHASE_WAIT:
        return "wait";
    case AP_PHASE_INVALIDATE:
        return "invalidate";
    case AP_PHASE_ACCEPT:
        return "accept";
    case AP_PHASE_BUSY:
        return "busy";
    case AP_PHASE_FORWARD:
        return "forward";
    case AP_PHASE_RESULT:
        return "result";
    case AP_PHASE_ERROR:
        return "error";
    default:
        return "unknown";
    }
}

static void ipc_cache_flush(volatile lnn_resnet18_real_ipc_t *ipc)
{
    HAL_FlushDCache_by_Addr((uint32_t *)(uintptr_t)ipc, sizeof(*ipc));
    HAL_FlushDCache();
    __asm__ volatile("fence iorw, iorw" : : : "memory");
}

static void ipc_cache_invalidate(volatile lnn_resnet18_real_ipc_t *ipc)
{
    __asm__ volatile("fence iorw, iorw" : : : "memory");
    HAL_InvalidateDCache_by_Addr((uint32_t *)(uintptr_t)ipc, sizeof(*ipc));
}

static void ipc_set_message(volatile lnn_resnet18_real_ipc_t *ipc, const char *message)
{
    char *dst = (char *)ipc->message;

    if (message == NULL) {
        dst[0] = '\0';
        return;
    }

    (void)snprintf(dst, LNN_RESNET18_REAL_MESSAGE_MAX, "%s", message);
}

static int8_t lnn_mbox_event_handler(uint32_t event, uint32_t param)
{
    BaseType_t higher_priority_task_woken = pdFALSE;

    if (event == CSK_MBX_EVENT_RECEIVE_COMPLETE) {
        const lnn_resnet18_real_msg_t msg = mbox_rx_msg;

        if (param == LNN_RESNET18_REAL_MBOX_CH && msg.magic == LNN_RESNET18_REAL_IPC_MAGIC &&
            msg.type == LNN_RESNET18_REAL_MSG_REQUEST) {
            ap_mbox_msg_count++;
            ap_last_notified = 1U;
            ap_last_msg_seq = msg.seq;
            ap_last_msg_state = msg.state;
            if (inference_task_handle != NULL) {
                vTaskNotifyGiveFromISR(inference_task_handle, &higher_priority_task_woken);
            }
        }
        (void)MBX_Receive(NULL, &mbox_rx_msg, LNN_RESNET18_REAL_MBOX_CH);
    }

    portYIELD_FROM_ISR(higher_priority_task_woken);
    return 0;
}

static int lnn_mbox_init(void)
{
    int32_t ret = MBX_Initialize(NULL, lnn_mbox_event_handler);
    if (ret != CSK_DRIVER_OK) {
        LOGE("init mailbox failed: %d", ret);
        return -1;
    }

    ret = MBX_Receive(NULL, &mbox_rx_msg, LNN_RESNET18_REAL_MBOX_CH);
    if (ret != CSK_DRIVER_OK) {
        LOGE("arm mailbox receive failed: %d", ret);
        return -1;
    }

    return 0;
}

static void ap_gpio_irq_disable_for_cp_touch(void)
{
    /*
     * GPIOA/GPIOB are owned by CP touch in this sample. AP must not enable the
     * local GPIO IRQ vectors; CP may enable GPIO REG_INTREN and handle peripheral
     * status. Do not clear REG_INTRSTATUS here.
     */
    disable_IRQ(IRQ_GPIOA_VECTOR);
    disable_IRQ(IRQ_GPIOB_VECTOR);
    clear_IRQ(IRQ_GPIOA_VECTOR);
    clear_IRQ(IRQ_GPIOB_VECTOR);
}

static void notify_cp_direct(uint32_t seq, uint32_t state)
{
    lnn_resnet18_real_msg_t msg = {
        .magic = LNN_RESNET18_REAL_IPC_MAGIC,
        .seq = seq,
        .type = LNN_RESNET18_REAL_MSG_STATUS,
        .state = state,
    };
    int32_t ret = CSK_DRIVER_OK;

    for (uint32_t i = 0; i < 10U; i++) {
        ret = MBX_Send(NULL, &msg, LNN_RESNET18_REAL_MBOX_CH);
        if (ret == CSK_DRIVER_OK) {
            return;
        }
        vTaskDelay(pdMS_TO_TICKS(1U));
    }

    LOGW("notify CP by mailbox failed: %d", ret);
}

static void notify_cp(uint32_t seq, uint32_t state)
{
    if (status_notify_queue == NULL) {
        return;
    }

    ap_status_notify_t notify = {
        .seq = seq,
        .state = state,
    };

    (void)xQueueSend(status_notify_queue, &notify, 0);
}

static void status_notify_task(void *arg)
{
    (void)arg;
    ap_status_notify_t notify;

    while (1) {
        if (xQueueReceive(status_notify_queue, &notify, portMAX_DELAY) == pdPASS) {
            notify_cp_direct(notify.seq, notify.state);
        }
    }
}

static void boot_cp_core(void)
{
    LOGI("boot CP from 0x%08x", (uint32_t)CONFIG_THINKER_RESNET18_REAL_CP_FLASH_BASE);
    IP_CMN_SYS->REG_N300_CP_RST_ADDR.all = CONFIG_THINKER_RESNET18_REAL_CP_FLASH_BASE;
    IP_SYSCTRL->REG_SW_RESET_CP0.all = 0xCAFE000A;
}

static void heartbeat_task(void *arg)
{
    (void)arg;

    while (1) {
        vTaskDelay(pdMS_TO_TICKS(AP_HEARTBEAT_INTERVAL_MS));
        LOGI("heartbeat phase=%s loops=%u mbox_msgs=%u msg=%u/%u notified=%u seq=%u state=%u input_bytes=%u",
             ap_phase_name(ap_phase), ap_loop_count, ap_mbox_msg_count, ap_last_msg_seq, ap_last_msg_state,
             ap_last_notified, ap_last_seq, ap_last_state, ap_last_input_bytes);
    }
}

static void inference_task(void *arg)
{
    (void)arg;

    volatile lnn_resnet18_real_ipc_t *ipc = lnn_resnet18_real_ipc_get();
    uint32_t last_seen_seq = UINT32_MAX;
    uint32_t last_seen_state = UINT32_MAX;

    ap_phase = AP_PHASE_MODEL_INIT;
    if (resnet18_real_init() != 0) {
        LOGE("AP model init failed");
        ipc->state = LNN_RESNET18_REAL_STATE_ERROR;
        ipc->result_score = 0;
        ipc->result_index = -1;
        ipc_set_message(ipc, "AP model init failed");
        ipc_cache_flush(ipc);
        ap_phase = AP_PHASE_ERROR;
        ap_last_state = ipc->state;
        notify_cp(ipc->seq, ipc->state);
        vTaskDelete(NULL);
    }

    ipc->state = LNN_RESNET18_REAL_STATE_IDLE;
    ipc_set_message(ipc, "AP ready");
    ipc_cache_flush(ipc);
    ap_phase = AP_PHASE_READY;
    ap_last_state = ipc->state;
    ap_last_input_bytes = ipc->input_bytes;
    notify_cp(ipc->seq, ipc->state);
    LOGI("AP ready for request, ipc_addr=0x%08x", (uint32_t)(uintptr_t)ipc);
    log_flush();

    while (1) {
        ap_phase = AP_PHASE_WAIT;
        (void)ulTaskNotifyTake(pdTRUE, pdMS_TO_TICKS(REQUEST_POLL_INTERVAL_MS));

        ap_loop_count++;
        ap_phase = AP_PHASE_INVALIDATE;
        ipc_cache_invalidate(ipc);
        ap_last_seq = ipc->seq;
        ap_last_state = ipc->state;
        ap_last_input_bytes = ipc->input_bytes;

        if (ipc->magic != LNN_RESNET18_REAL_IPC_MAGIC || ipc->version != LNN_RESNET18_REAL_IPC_VERSION) {
            continue;
        }

        if (ipc->seq != last_seen_seq || ipc->state != last_seen_state) {
            last_seen_seq = ipc->seq;
            last_seen_state = ipc->state;
        }

        if (ipc->state != LNN_RESNET18_REAL_STATE_REQUEST) {
            continue;
        }

        uint32_t seq = ipc->seq;
        if (ipc->input_bytes != LNN_RESNET18_REAL_INPUT_BYTES) {
            ipc->result_label[0] = '\0';
            ipc->label_len = 0;
            ipc->result_score = 0;
            ipc->result_index = -1;
            ipc->state = LNN_RESNET18_REAL_STATE_ERROR;
            ipc_set_message(ipc, "bad input size");
            ipc_cache_flush(ipc);
            ap_phase = AP_PHASE_ERROR;
            ap_last_state = ipc->state;
            notify_cp(seq, ipc->state);
            continue;
        }

        ap_phase = AP_PHASE_ACCEPT;
        ipc->state = LNN_RESNET18_REAL_STATE_BUSY;
        ipc_set_message(ipc, "AP running inference");
        ipc_cache_flush(ipc);
        ap_phase = AP_PHASE_BUSY;
        ap_last_state = ipc->state;
        notify_cp(seq, ipc->state);
        LOGI("request accepted seq=%u input_bytes=%u", seq, ipc->input_bytes);

        const char *label = NULL;
        int8_t score = 0;
        int32_t index = -1;
        ap_phase = AP_PHASE_FORWARD;
        int ret = resnet18_real_run_tensor((const int8_t *)(uintptr_t)ipc->input_addr, &label, &score, &index);

        if (ret == 0 && label != NULL) {
            char *dst = (char *)ipc->result_label;
            (void)snprintf(dst, LNN_RESNET18_REAL_LABEL_MAX, "%s", label);
            ipc->label_len = (uint32_t)strlen(dst);
            ipc->result_score = score;
            ipc->result_index = index;
            ipc->state = LNN_RESNET18_REAL_STATE_DONE;
            ipc_set_message(ipc, "done");
            ap_phase = AP_PHASE_RESULT;
            ap_last_state = ipc->state;
        } else {
            ipc->result_label[0] = '\0';
            ipc->label_len = 0;
            ipc->result_score = 0;
            ipc->result_index = -1;
            ipc->state = LNN_RESNET18_REAL_STATE_ERROR;
            ipc_set_message(ipc, "inference failed");
            ap_phase = AP_PHASE_ERROR;
            ap_last_state = ipc->state;
        }

        ipc_cache_flush(ipc);
        notify_cp(seq, ipc->state);
    }
}

int main(int argc, char **argv)
{
    (void)argc;
    (void)argv;

    volatile lnn_resnet18_real_ipc_t *ipc = lnn_resnet18_real_ipc_get();

    memset((void *)ipc, 0, sizeof(*ipc));
    ipc->magic = LNN_RESNET18_REAL_IPC_MAGIC;
    ipc->version = LNN_RESNET18_REAL_IPC_VERSION;
    ipc->struct_size = sizeof(*ipc);
    ipc->state = LNN_RESNET18_REAL_STATE_BOOTING;
    ipc->input_width = LNN_RESNET18_REAL_INPUT_WIDTH;
    ipc->input_height = LNN_RESNET18_REAL_INPUT_HEIGHT;
    ipc->input_bytes = LNN_RESNET18_REAL_INPUT_BYTES;
    ipc_set_message(ipc, "AP booting");
    ipc_cache_flush(ipc);

    ap_gpio_irq_disable_for_cp_touch();

    boot_cp_core();

    if (lnn_mbox_init() != 0) {
        return -1;
    }

    status_notify_queue = xQueueCreate(STATUS_NOTIFY_QUEUE_DEPTH, sizeof(ap_status_notify_t));
    if (status_notify_queue == NULL) {
        LOGE("create status notify queue failed");
        return -1;
    }

    if (xTaskCreate(status_notify_task, "ap_notify", 2048, NULL, configMAX_PRIORITIES - 4, NULL) != pdPASS) {
        LOGE("create status_notify_task failed");
        return -1;
    }

    if (xTaskCreate(inference_task, "resnet18_ap", 8192, NULL, configMAX_PRIORITIES - 2, &inference_task_handle) !=
        pdPASS) {
        LOGE("create inference_task failed");
        return -1;
    }

    return 0;
}
```

## src/resnet18_real_ap.c
```c
/*
 * Copyright (c) 2026 Anhui Listenai Co., Ltd.
 * SPDX-License-Identifier: Apache-2.0
 */

#define LOG_TAG "resnet18_ap"

#include "resnet18_real_ap.h"

#include <ClockManager.h>
#include <arcs_ap.h>
#include <cache.h>
#include <dma_cpy.h>
#include <lisa_log.h>
#include <luna/luna.h>
#include <stdbool.h>
#include <stddef.h>
#include <stdint.h>
#include <string.h>
#include <sysutils.h>
#include <thinker/thinker.h>
#include <thinker/thinker_status.h>

#include "lnn_resnet18_real_ipc.h"

#define MEMORY_ALIGN       (64U)
#define DTYPE_SIZE(dtype)  ((uint32_t)((dtype) & 0xFU))

#define RETURN_IF_THINKER_FAILED(expr)           \
    do {                                         \
        if (!thinker_status_ok((expr), #expr)) { \
            return -1;                           \
        }                                        \
    } while (0)

#define GOTO_IF_THINKER_FAILED(expr, label)      \
    do {                                         \
        if (!thinker_status_ok((expr), #expr)) { \
            goto label;                          \
        }                                        \
    } while (0)

static uint8_t thinker_psram_pool[CONFIG_THINKER_RESNET18_REAL_PSRAM_POOL_SIZE] __psram_noinit__
    __attribute__((aligned(MEMORY_ALIGN)));
/* 输入张量本池：Luna DMA 无法访问 CP 侧 PSRAM（PMP 隔离），
 * 必须拷贝到 AP 自己的 PSRAM 再喂 tSetInput（对齐原版实现） */
static int8_t input_tensor[LNN_RESNET18_REAL_INPUT_BYTES] __psram_noinit__ __attribute__((aligned(64)));
static char latest_result[32];
static uint8_t thinker_share_pool[CONFIG_THINKER_RESNET18_REAL_SHARE_POOL_SIZE]
    __attribute__((section(".thinker.apram.noinit"), aligned(MEMORY_ALIGN)));
static tMemory memory_list[7];
static int32_t num_memory;
static tModelHandle model;
static tExecHandle executor;
static bool initialized;
static bool dma_ready;

#if 0 /* CIFAR 标签表：YOLO 结构验证阶段不用 */
static const char *results[] = {
    "apple",      "aquarium_fish", "baby",         "bear",       "beaver",      "bed",         "bee",
    "beetle",     "bicycle",       "bottle",       "bowl",       "boy",         "bridge",      "bus",
    "butterfly",  "camel",         "can",          "castle",     "caterpillar", "cattle",      "chair",
    "chimpanzee", "clock",         "cloud",        "cockroach",  "couch",       "crab",        "crocodile",
    "cup",        "dinosaur",      "dolphin",      "elephant",   "flatfish",    "forest",      "fox",
    "girl",       "hamster",       "house",        "kangaroo",   "keyboard",    "lamp",        "lawn_mower",
    "leopard",    "lion",          "lizard",       "lobster",    "man",         "maple_tree",  "motorcycle",
    "mountain",   "mouse",         "mushroom",     "oak_tree",   "orange",      "orchid",      "otter",
    "palm_tree",  "pear",          "pickup_truck", "pine_tree",  "plain",       "plate",       "poppy",
    "porcupine",  "possum",        "rabbit",       "raccoon",    "ray",         "road",        "rocket",
    "rose",       "sea",           "seal",         "shark",      "shrew",       "skunk",       "skyscraper",
    "snail",      "snake",         "spider",       "squirrel",   "streetcar",   "sunflower",   "sweet_pepper",
    "table",      "tank",          "telephone",    "television", "tiger",       "tractor",     "train",
    "trout",      "tulip",         "turtle",       "wardrobe",   "whale",       "willow_tree", "wolf",
    "woman",      "worm"};
#endif

static uint32_t align_up(uint32_t value, uint32_t align)
{
    return (value + align - 1U) & ~(align - 1U);
}

static bool thinker_status_ok(tStatus status, const char *op)
{
    if (status != T_SUCCESS) {
        LOGE("%s failed: %d", op, status);
        return false;
    }

    return true;
}

static int prepare_memory_plan(const int8_t *model_data, uint64_t model_size)
{
    uint32_t psram_used = 0;
    uint32_t share_used = 0;

    memset(memory_list, 0, sizeof(memory_list));
    num_memory = 0;

    RETURN_IF_THINKER_FAILED(tGetMemoryPlan(memory_list, &num_memory, model_data, model_size));

    for (int32_t i = 0; i < num_memory; i++) {
        uint32_t size = align_up(memory_list[i].size_, MEMORY_ALIGN);

        if (memory_list[i].dptr_ != 0U) {
            continue;
        }

        if (memory_list[i].dev_type_ == PSRAM || memory_list[i].dev_type_ == UNCERTAIN) {
            if (psram_used + size > sizeof(thinker_psram_pool)) {
                LOGE("PSRAM pool too small: need=%u configured=%u", psram_used + size,
                     (uint32_t)sizeof(thinker_psram_pool));
                return -1;
            }

            memory_list[i].dptr_ = (addr_type)(uintptr_t)&thinker_psram_pool[psram_used];
            psram_used += size;
        } else if (memory_list[i].dev_type_ == SHARE_MEM) {
            if (share_used + size > sizeof(thinker_share_pool)) {
                LOGE("share pool too small: need=%u configured=%u", share_used + size,
                     (uint32_t)sizeof(thinker_share_pool));
                return -1;
            }

            memory_list[i].dptr_ = (addr_type)(uintptr_t)&thinker_share_pool[share_used];
            share_used += size;
        } else {
            LOGE("unsupported memory plan entry: idx=%d dev_type=%u size=%u", i, memory_list[i].dev_type_,
                 memory_list[i].size_);
            return -1;
        }

        LOGI("memory[%d]: dev=%u mem=%u size=%u ptr=0x%08x", i, memory_list[i].dev_type_,
             memory_list[i].mem_type_, memory_list[i].size_, (uint32_t)memory_list[i].dptr_);
    }

    memset(thinker_psram_pool, 0, psram_used);
    if (share_used > 0U) {
        memset(thinker_share_pool, 0, share_used);
    }

    LOGI("memory plan: entries=%d psram=%u share=%u", num_memory, psram_used, share_used);

    return 0;
}
static void release_dma(void)
{
    if (dma_ready) {
        dma_uninit(ALG_DMA_CH);
        dma_ready = false;
    }
}

int resnet18_real_init(void)
{
    const int8_t *model_data = (const int8_t *)(uintptr_t)CONFIG_THINKER_RESNET18_REAL_MODEL_ADDR;
    /* pkg 头偏移 64 存真实总长：换模型无需改固件（CONFIG 仅作上限校验） */
    uint64_t model_size = *(const uint32_t *)(const void *)(model_data + 64);
    if (model_size == 0U || model_size > CONFIG_THINKER_RESNET18_REAL_MODEL_SIZE) {
        LOGE("pkg size %llu out of range (max 0x%x)", (unsigned long long)model_size,
             (uint32_t)CONFIG_THINKER_RESNET18_REAL_MODEL_SIZE);
        return -1;
    }

    if (initialized) {
        return 0;
    }

    LOGI("Thinker version: %s", tGetVersion(0));
    __HAL_CRM_LUNA_CLK_ENABLE();
    /* Luna validation apps run with DCache disabled; flush first because SDK startup enables it. */
    HAL_FlushDCache();
    HAL_DisableDCache();
    enable_GINT();
    luna_init();
    LOGI("Luna version: 0x%08x freq=%u", luna_version(), CRM_GetLunaFreq());

    dma_ready = dma_init(ALG_DMA_CH);
    if (!dma_ready) {
        LOGE("dma_init failed");
        return -1;
    }

    LOGI("model addr=0x%08x size=%llu", (uint32_t)CONFIG_THINKER_RESNET18_REAL_MODEL_ADDR, model_size);

    if (model_size == 0U) {
        LOGE("CONFIG_THINKER_RESNET18_REAL_MODEL_SIZE is 0");
        release_dma();
        return -1;
    }

    GOTO_IF_THINKER_FAILED(tInitialize(), fail_dma);

    if (prepare_memory_plan(model_data, model_size) != 0) {
        goto fail_runtime;
    }

    LOGI("tModelInit start");
    log_flush();
    GOTO_IF_THINKER_FAILED(tModelInit(&model, model_data, model_size, memory_list, num_memory), fail_runtime);
    LOGI("tModelInit ok");

    LOGI("tCreateExecutor start");
    log_flush();
    GOTO_IF_THINKER_FAILED(tCreateExecutor(model, &executor, memory_list, num_memory), fail_model);
    LOGI("tCreateExecutor ok");

    initialized = true;
    return 0;

fail_model:
    (void)tModelFini(model);
    model = 0;
fail_runtime:
    (void)tUninitialize();
fail_dma:
    release_dma();
    return -1;
}

int resnet18_real_run_tensor(const int8_t *input_data, const char **result_label, int8_t *result_score,
                             int32_t *result_index)
{
    if (!initialized || input_data == NULL || result_label == NULL || result_score == NULL || result_index == NULL) {
        return -1;
    }

    tData input;
    RETURN_IF_THINKER_FAILED(tGetInputInfo(executor, 0, &input));

    uint32_t input_bytes = DTYPE_SIZE(input.dtype_);
    for (uint32_t i = 0; i < input.shape_.ndim_; i++) {
        input_bytes *= input.shape_.dims_[i];
    }

    if (input.dtype_ != Int8 || input_bytes != LNN_RESNET18_REAL_INPUT_BYTES) {
        LOGE("unexpected input: dtype=0x%x bytes=%u expected=%u", input.dtype_, input_bytes,
             LNN_RESNET18_REAL_INPUT_BYTES);
        return -1;
    }

    /* CPU 拷贝 CP 共享 PSRAM 输入 → AP 本池（Luna DMA 不可跨核访问） */
    memcpy(input_tensor, input_data, LNN_RESNET18_REAL_INPUT_BYTES);
    if (input.dptr_ != NULL) {
        memcpy(input.dptr_, input_data, LNN_RESNET18_REAL_INPUT_BYTES);
    } else {
        input.dptr_ = (addr_type)(uintptr_t)input_tensor;
        input.dev_type_ = PSRAM;
    }

    LOGI("input: ptr=%p dev=%u dtype=0x%x ndim=%u bytes=%u", input.dptr_, input.dev_type_, input.dtype_,
         input.shape_.ndim_, input_bytes);
    RETURN_IF_THINKER_FAILED(tSetInput(executor, 0, &input));

    int32_t out_cnt = tGetOutputCount(model);
    LOGI("forward start (outputs=%d)", out_cnt);
    log_flush();
    RETURN_IF_THINKER_FAILED(tForward(executor));
    LOGI("forward done");

    /* YOLO 结构验证阶段：打印全部输出 shape，对 out0 做 argmax 冒烟 */
    uint32_t best_index = 0;
    int8_t best_score = -128;

    for (int32_t o = 0; o < out_cnt; o++) {
        tData output;
        RETURN_IF_THINKER_FAILED(tGetOutput(executor, o, &output));
        if (output.dptr_ == NULL || DTYPE_SIZE(output.dtype_) != 1U) {
            LOGE("unexpected output %d: ptr=%p dtype=0x%x", o, output.dptr_, output.dtype_);
            return -1;
        }
        uint32_t total = 1U;
        char dims[48] = "";
        for (uint32_t i = 0; i < output.shape_.ndim_ && i < 5U; i++) {
            total *= output.shape_.dims_[i];
            char d[12];
            snprintf(d, sizeof(d), "%s%u", i ? "x" : "", output.shape_.dims_[i]);
            strncat(dims, d, sizeof(dims) - strlen(dims) - 1);
        }
        LOGI("out%d: shape=%s total=%u ptr=%p", o, dims, total, output.dptr_);
        if (o == 0) {
            int8_t *scores = (int8_t *)output.dptr_;
            for (uint32_t i = 0; i < total; i++) {
                if (scores[i] > best_score) {
                    best_index = i;
                    best_score = scores[i];
                }
            }
        }
    }

    LOGI("out0 argmax: score=%d index=%u", best_score, best_index);

    snprintf(latest_result, sizeof(latest_result), "yolo o0 amax=%d@%u", best_score, best_index);
    *result_label = latest_result;
    *result_score = best_score;
    *result_index = (int32_t)best_index;

    return 0;
}

int resnet18_real_deinit(void)
{
    if (!initialized) {
        return 0;
    }

    (void)tReleaseExecutor(executor);
    (void)tModelFini(model);
    (void)tUninitialize();
    release_dma();

    executor = 0;
    model = 0;
    initialized = false;

    return 0;
}
```

## src/resnet18_real_ap.h
```c
/*
 * Copyright (c) 2026 Anhui Listenai Co., Ltd.
 * SPDX-License-Identifier: Apache-2.0
 */

#pragma once

#include <stdint.h>

int resnet18_real_init(void);
int resnet18_real_run_tensor(const int8_t *input_data, const char **result_label, int8_t *result_score,
                             int32_t *result_index);
int resnet18_real_deinit(void);
```
