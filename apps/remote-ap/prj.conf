## CMakeLists.txt
```
cmake_minimum_required(VERSION 3.19)

set(CMAKE_EXPORT_COMPILE_COMMANDS ON)

find_package(listenai-cmake REQUIRED HINTS $ENV{ARCS_BASE})

project(remote-ap C ASM)

listenai_include_directories(${CMAKE_CURRENT_SOURCE_DIR})
listenai_include_directories(${CMAKE_CURRENT_SOURCE_DIR}/src)

listenai_add_executable(${PROJECT_NAME})

target_sources(${PROJECT_NAME} PRIVATE
    src/main.c
    src/llm_service.c
    src/neo.c
    src/story_arena.c
    src/story_llm.c
    src/story_mem.c
    res/model.S
)

# .incbin 的搜索路径是编译工作目录（build/），必须显式指向源码 res/
set_source_files_properties(res/model.S PROPERTIES
    COMPILE_OPTIONS "-I${CMAKE_CURRENT_SOURCE_DIR}/res"
)

# 推理内核单独提级（全局 -Os 严重拖慢热点）
set_source_files_properties(src/neo.c PROPERTIES COMPILE_OPTIONS "-O3;-funroll-loops")
set_source_files_properties(src/story_llm.c PROPERTIES COMPILE_OPTIONS "-O2")

# neo.c 的 softmax/gelu 需要 expf/tanhf（数学库）
listenai_link_libraries(m)
```

## Kconfig
```
osource "$ARCS_BASE/Kconfig"

config LLM_WEIGHTS_PSRAM
	bool "Mirror LLM weights to PSRAM at boot"
	default n
	help
	  Flash XIP effective bandwidth (~13 MB/s measured) dominates decode
	  time (every token streams the full 5.8 MB of weights). Copying the
	  weight blob to PSRAM once at boot trades slower startup for a
	  higher read bandwidth during generation. AP has 8 MB of PSRAM;
	  arena/tokenizer/KV already use ~0.8 MB, leaving room for the
	  ~5.9 MB mirror.
```

## prj.conf
```kconfig
# LLM 服务固件（AP 核）：模型嵌入固件，上电自动加载，IPC 监听 chat。
# PSRAM 分割：AP 8MB / CP 8MB（契约见 memap.h）。

# AP 核（上电默认核，0x0 的 boot 完成时钟/PSRAM 初始化后跳入本应用）
CONFIG_ARCS_AP_CORE=y

# 应用侧绝不重复初始化时钟/PSRAM（与 boot 冲突）
CONFIG_BOOT_HART=n
CONFIG_BOOT=n

# 内存窗口
# Flash: AP 从 0x30040000 到 0x30680000（6.5MB，含模型 5.85MB + 代码）
CONFIG_MEM_FLASH_BASE=0x30040000
CONFIG_MEM_FLASH_SIZE=0x00640000

CONFIG_MEM_PSRAM_BASE=0x28000000
CONFIG_MEM_PSRAM_SIZE=0x00800000

# 共享区必须与 CP 侧完全一致（CP: IPC 0x20040000 / LUNA_SHARED 0x20042000+0x7000）
CONFIG_MEM_IPC_BASE=0x20040000
CONFIG_MEM_IPC_SIZE=0x00002000
CONFIG_MEM_LUNA_SHARED_BASE=0x20042000
CONFIG_MEM_LUNA_SHARED_SIZE=0x00007000

# 私有 SRAM：CP 占 0x20017000-0x20040000，共享区占到 0x20049000，
# AP 可用 0x20049000-0x20058000
CONFIG_MEM_SRAM_BASE=0x20049000
CONFIG_MEM_SRAM_SIZE=0x0000F000
CONFIG_MEM_APRAM_BASE=0x20058000
CONFIG_MEM_APRAM_SIZE=0x00000800

CONFIG_LINK_OPTION_NONE_SPECS=y
CONFIG_LINK_CPP_RUNTIME_SECTIONS=n
CONFIG_CPP_EXCEPTIONS=n

CONFIG_HEAP_SIZE=0x8000
CONFIG_PSRAM_HEAP_SIZE=0x100000

CONFIG_BACK_TRACE=y
CONFIG_FREERTOS_STATIC_ALLOCATION_ENABLE=y

CONFIG_MAIN_TASK_STACK_SIZE=4096
CONFIG_MAIN_TASK_PRIORITY=5

# IPC 骨架：HAL IPC 是底层必需（ipc_auto_init 发布共享内存 pattern）
CONFIG_ARCS_HAL_IPC=y
CONFIG_ARCS_HAL_LSF=y
CONFIG_IPC_LSF=y

# 响应 CP 的 halt/resume 信号（CP flash 写前暂停本核）
CONFIG_ARCS_HAL_IPC_HALT_BY_PEER_CORE=y

# AP 日志走 UART1（PA21，921600）
CONFIG_CONSOLE_UART_NAME="uart0"
CONFIG_LLM_WEIGHTS_PSRAM=y
```

## arcs_mini.conf
```kconfig
# arcs_mini 板级 overlay（构建入口 -DCONFIG_FILES=arcs_mini.conf 引用）。
# AP 侧全部配置在 prj.conf；本文件仅作为 Kconfig 合并占位。
```

## arcs_mini3.conf
```kconfig
# arcs_mini3 (LS2663, 8MB PSRAM) AP overlay
# AP 仅 3MB@0x28000000（CP=5MB@0x28300000），6MB 权重镜像放不下，
# 回退 flash XIP（推理 ~405ms/token 而非 ~265ms/token）
# CONFIG_LLM_WEIGHTS_PSRAM is not set
```

## src/main.c
```c
// LLM 服务固件（AP 核）：释放 CP 后启动 LLM 服务，等待 IPC 请求。
// 模型/分词器通过 .incbin 编入固件，上电自动加载，无需运行时烧录。

#include <stdint.h>
#include <stdio.h>

#include "FreeRTOS.h"
#include "task.h"

#include "arcs_ap.h"
#include "memap.h"
#include "ic_message.h"

#define TAG "ap"
#include "lisa_log.h"

/* AP 日志走 UART0（PA3，与 CP 共用串口，按 tag 区分） */

/* CP 镜像 flash 基址契约：必须与 apps/arcs-mini prj.conf 的
 * CONFIG_MEM_FLASH_BASE 一致，防止 AP/CP 分割错配后静默跑飞 */
#ifndef EXPECTED_CP_FLASH_BASE
#define EXPECTED_CP_FLASH_BASE 0x30700000u
#endif
_Static_assert(MEM_CP_FLASH_BASE == EXPECTED_CP_FLASH_BASE,
               "memap.h MEM_CP_FLASH_BASE mismatches CP firmware");

int llm_service_init(void);

int main(int argc, char **argv)
{
    (void)argc;
    (void)argv;

    LISA_LOGI(TAG, "LLM service AP up, hart=%d, releasing CP @0x%x",
              CONFIG_HARTID, MEM_CP_FLASH_BASE);

    /* CP 核释放：入口指向 CP app 分区（0x700000），魔数放行。
     * IPC 共享内存由 ipc_auto_init（PRE_DEVICES_INIT）先于 main 发布。 */
    IP_CMN_SYS->REG_N300_CP_RST_ADDR.all = MEM_CP_FLASH_BASE;
    IP_SYSCTRL->REG_SW_RESET_CP0.all = 0xCAFE000A;

    ic_message_init();
    LISA_LOGI(TAG, "ic_message ready");

    /* LLM 服务：加载嵌入模型 → 监听 IPC 请求 */
    llm_service_init();

    uint32_t loops = 0;
    while (1) {
        vTaskDelay(pdMS_TO_TICKS(60000));
        LISA_LOGI(TAG, "idle %u", (unsigned)++loops);
    }
    return 0;
}
```

## src/llm_service.c
```c
// LLM 服务层：模型嵌入固件，上电自动加载，IPC 邮箱协议交互。
//
// 资源（model.bin / tok.bin）通过 .incbin 编入固件二进制。
// 长文本（问题/答案）走 LUNA 共享内存邮箱（llm_mailbox.h），
// ic_message 只发 ≤4B 状态通知（其载荷上限 10B）。

#include <stdint.h>
#include <stdio.h>
#include <string.h>
#include <math.h>

/* newlib 软浮点可能不提供 expf 单精度版本，用 exp(double) 转发 */
__attribute__((weak)) float expf(float x)
{
    return (float)exp((double)x);
}

#include "FreeRTOS.h"
#include "task.h"

#include "ic_message.h"
#include "cache.h"
#include "lisa_log.h"

#include "neo.h"
#include "story_arena.h"
#include "story_llm.h"
#include "story_log.h"
#include "story_mem.h"
#include "llm_mailbox.h"

/* 嵌入的模型资源（res/model.S 定义） */
extern const uint8_t llm_model_start[];
extern const uint8_t llm_model_end[];
extern const uint8_t llm_tok_start[];
extern const uint8_t llm_tok_end[];

#define TAG "llm.svc"

#define LLM_SERVICE_ID  IC_MESSAGE_ID_LLM

/* mailbox 跨核共享内存 cache 维护（当前 AP 未开 DCACHE，为 no-op；
 * 若未来开启需保证写后 Flush / 读前 Invalidate，与 CP 侧 llm.c 对称） */
static void mb_flush(void)
{
    HAL_FlushDCache_by_Addr((uint32_t *)LLM_MAILBOX_ADDR, sizeof(llm_mailbox_t));
}
static void mb_invalidate(void)
{
    HAL_InvalidateDCache_by_Addr((uint32_t *)LLM_MAILBOX_ADDR, sizeof(llm_mailbox_t));
}

/* arena 缓冲单独声明（放 PSRAM 避免 SRAM 60KB 窗口溢出） */
static uint8_t fast_buf[64 * 1024]  __attribute__((aligned(16), section(".psram.noinit")));
static uint8_t bulk_buf[448 * 1024] __attribute__((aligned(16), section(".psram.noinit")));

#if CONFIG_LLM_WEIGHTS_PSRAM
/* 权重 PSRAM 镜像：flash XIP 有效带宽（实测 ~13MB/s）是 decode 瓶颈
 * （每 token 流式读全部 5.8MB 权重），启动时一次性搬到 PSRAM 常驻。
 * AP 侧 PSRAM 共 8MB，arena+tok+KV 已用 ~0.8MB，镜像后 ~6.7MB。 */
static uint8_t model_mirror[6 * 1024 * 1024] __attribute__((aligned(16), section(".psram.noinit")));
#endif

static struct {
    llm_t llm;
    story_arena_t fast, bulk;
    bool ready;
    TaskHandle_t task;
} S;

static void do_generate(void);   /* 自检与 IPC 循环共用 */

/* 流式 piece 回调：每 token 追加到邮箱并通知 CP */
static uint32_t s_stream_offset = 0;

static bool llm_stream_piece(void *user, const char *piece, int len)
{
    (void)user;
    if (s_stream_offset + len < LLM_MB_TEXT_MAX - 1) {
        memcpy((void *)(LLM_MB->text + s_stream_offset), piece, len);
        s_stream_offset += len;
        LLM_MB->text[s_stream_offset] = '\0';
        LLM_MB->length = s_stream_offset;
        mb_flush();
        llm_notify_t n = { .state = LLM_MB_PIECE };
        ic_message_msg_send_by_id(LLM_SERVICE_ID, LLM_IPC_TYPE_EVT,
                                  &n, sizeof n);
    }
    return true;
}

/* -------------------------------------------------- 推理 worker */

/* ---- 启动自检（LLM_BOOT_SELFTEST）----
 * 定位问题时置 1：CRC 校验 flash 权重 + 两组对比生成
 * （S1 本地常量无回调 / S2 mailbox 全路径含流式回调），
 * 结果写入邮箱，CP 侧 `llm last` 读取。平时关闭（每组耗时 ~2.6s）。 */
#define LLM_BOOT_SELFTEST 0
#if LLM_BOOT_SELFTEST
#define LLM_CRC_MODEL_EXPECTED 0xed0758ceu   /* 主机 zlib.crc32(res/model.bin) */
#define LLM_CRC_TOK_EXPECTED   0x976ddb3cu   /* 主机 zlib.crc32(res/tok.bin)  */

static uint32_t dbg_crc32(const volatile uint8_t *p, size_t n)
{
    uint32_t c = 0xffffffffu;
    for (size_t i = 0; i < n; i++) {
        c ^= p[i];
        for (int k = 0; k < 8; k++)
            c = (c >> 1) ^ (0xedb88320u & (uint32_t)(-(int32_t)(c & 1)));
    }
    return ~c;
}
#endif

static void llm_service_task(void *arg)
{
    (void)arg;
    LISA_LOGI(TAG, "llm service task up");

    const size_t model_len = llm_model_end - llm_model_start;
    const size_t tok_len = llm_tok_end - llm_tok_start;

    LISA_LOGI(TAG, "loading model %u B + tok %u B from embedded flash",
              (unsigned)model_len, (unsigned)tok_len);

    story_arena_init(&S.fast, fast_buf, sizeof fast_buf);
    story_arena_init(&S.bulk, bulk_buf, sizeof bulk_buf);
    story_arena_begin(&S.fast, "llm-fast");
    story_arena_begin(&S.bulk, "llm-bulk");

    llm_blobs_t blobs = {
        .model = llm_model_start,
        .model_len = model_len,
        .tok = llm_tok_start,
        .tok_len = tok_len,
    };
#if CONFIG_LLM_WEIGHTS_PSRAM
    if (model_len > sizeof model_mirror) {
        LISA_LOGE(TAG, "model %u B exceeds PSRAM mirror %u B",
                  (unsigned)model_len, (unsigned)sizeof model_mirror);
        vTaskDelete(NULL);
        return;
    }
    int64_t tm = story_time_us();
    memcpy(model_mirror, llm_model_start, model_len);
    blobs.model = model_mirror;
    LISA_LOGI(TAG, "weights mirrored flash->PSRAM %u B in %lld ms",
              (unsigned)model_len, (long long)(story_time_us() - tm) / 1000);
#endif
    llm_params_t params = llm_default_params();

    int64_t t0 = story_time_us();
    if (!llm_load(&S.llm, &blobs, &params, &S.fast, &S.bulk)) {
        LISA_LOGE(TAG, "llm_load failed — service not ready");
        vTaskDelete(NULL);
        return;
    }
    S.ready = true;
    LISA_LOGI(TAG, "model loaded in %lld ms, service ready",
              (long long)((story_time_us() - t0) / 1000));

#if LLM_BOOT_SELFTEST
    {
        /* 三角定位自检，结果进邮箱（AP 日志走 UART，adb 看不到）：
         *  S1 = 本地常量 + 无流式回调（基线，引擎正确性）
         *  S2 = 问题经 mailbox + 含流式回调（与 IPC 请求完全同路径）
         *  Q  = 生成入口读到的问题快照（AP 实际编码的内容）
         * S1 对 S2 错 → 流式回调或 mailbox 读路径；Q 乱 → mailbox 存储被覆盖 */
        uint32_t mc = dbg_crc32(llm_model_start, model_len);
        uint32_t tc = dbg_crc32(llm_tok_start, tok_len);
        static char ans1[LLM_ANSWER_CHARS + 1], ans2[LLM_ANSWER_CHARS + 1];
        llm_stats_t st1, st2;

        llm_answer(&S.llm, NULL, "what is one plus one",
                   ans1, sizeof ans1, NULL, NULL, &st1);

        /* S2：问题写入 mailbox（模拟 CP 写入），走与 IPC 请求完全相同的路径 */
        strcpy((char *)LLM_MB->text, "what is one plus one");
        LLM_MB->state = LLM_MB_QUESTION;
        do_generate();
        strncpy(ans2, (const char *)LLM_MB->text, sizeof ans2 - 1);
        ans2[sizeof ans2 - 1] = '\0';
        st2.gen_tokens = LLM_MB->tokens;
        st2.gen_us = (int64_t)LLM_MB->ms * 1000;

        int n = snprintf((char *)LLM_MB->text, LLM_MB_TEXT_MAX,
                         "crc_model=%08x(%s) crc_tok=%08x(%s) "
                         "S1[local,no-cb]:%s | S2[mb+stream,%utok]:%s",
                         mc, mc == LLM_CRC_MODEL_EXPECTED ? "OK" : "BAD",
                         tc, tc == LLM_CRC_TOK_EXPECTED ? "OK" : "BAD",
                         ans1, (unsigned)st2.gen_tokens, ans2);
        LLM_MB->length = n > 0 ? (uint32_t)n : 0;
        LLM_MB->tokens = (uint32_t)st1.gen_tokens;
        LLM_MB->ms = (uint32_t)(st1.gen_us / 1000);
        __sync_synchronize();
        LLM_MB->state = LLM_MB_DONE;
        mb_flush();
        llm_notify_t n2 = { .state = LLM_MB_DONE };
        ic_message_msg_send_by_id(LLM_SERVICE_ID, LLM_IPC_TYPE_EVT, &n2, sizeof n2);
    }
#endif

    while (1) {
        ulTaskNotifyTake(pdTRUE, portMAX_DELAY);

        mb_invalidate();
        if (LLM_MB->state != LLM_MB_QUESTION) continue;
        if (!LLM_MB->text[0]) continue;

        do_generate();
    }
}

/* 从 mailbox 取问题并生成；DONE 载荷带 Q-echo（AP 实际编码的问题快照） */
static void do_generate(void)
{
    char qsnap[LLM_MB_TEXT_MAX];
    strncpy(qsnap, (const char *)LLM_MB->text, sizeof qsnap - 1);
    qsnap[sizeof qsnap - 1] = '\0';

    LISA_LOGI(TAG, "generating: '%s'", qsnap);

    /* 清空邮箱文本区，准备流式写入 */
    LLM_MB->length = 0;
    LLM_MB->tokens = 0;
    LLM_MB->ms = 0;
    LLM_MB->text[0] = '\0';
    s_stream_offset = 0;

    static char answer[LLM_ANSWER_CHARS + 1];
    llm_stats_t st;
    bool ok = llm_answer(&S.llm, NULL, qsnap,
                         answer, sizeof answer, llm_stream_piece, NULL, &st);

    /* 写入最终统计 */
    LLM_MB->tokens = (uint32_t)st.gen_tokens;
    LLM_MB->ms = (uint32_t)(st.gen_us / 1000);

    if (!ok) {
        LISA_LOGE(TAG, "generate failed");
        LLM_MB->length = 0;
    } else {
        /* Q-echo：把 AP 实际读到的问题前缀写回载荷，CP 侧可见 */
        uint32_t alen = LLM_MB->length;
        uint32_t qroom = LLM_MB_TEXT_MAX - alen - 1;
        if (alen + 16 < LLM_MB_TEXT_MAX) {
            uint32_t ql = strlen(qsnap);
            if (ql > qroom - 12) ql = qroom - 12;
            memmove((void *)(LLM_MB->text + alen), " |Q=[", 5);
            memcpy((void *)(LLM_MB->text + alen + 5), qsnap, ql);
            memcpy((void *)(LLM_MB->text + alen + 5 + ql), "]", 2);
            LLM_MB->length = alen + 5 + ql + 1;
            mb_flush();
        }
        LISA_LOGI(TAG, "done(%ums, %u tok): %s",
                  LLM_MB->ms, LLM_MB->tokens, LLM_MB->text);
    }

    __sync_synchronize();
    LLM_MB->state = LLM_MB_DONE;
    mb_flush();

    llm_notify_t n = { .state = LLM_MB_DONE };
    int ret = ic_message_msg_send_by_id(LLM_SERVICE_ID, LLM_IPC_TYPE_EVT,
                                        &n, sizeof n);
    LISA_LOGI(TAG, "notify DONE ret=%d", ret);
}

/* -------------------------------------------------- IPC 回调 */
static int32_t llm_ipc_callback(ic_message_handle_info_t *h,
                                ic_message_msg_info_t *m)
{
    (void)h;
    if (!m || !m->msg || m->len < 4) return -1;

    /* 注意：ic_message 接收侧 msg_type 硬编码为 CMD（线上不传类型），
     * 不能用 msg_type 区分方向，只能按 state 分发。
     * QUESTION 只可能来自 CP。 */
    llm_notify_t *n = m->msg;
    if (n->state == LLM_MB_QUESTION && S.ready) {
        if (S.task) xTaskNotifyGive(S.task);
    }
    return 0;
}

/* -------------------------------------------------- 初始化 */
int llm_service_init(void)
{
    BaseType_t ok = xTaskCreate(llm_service_task, "llm.svc",
                                8192, NULL, 4, &S.task);
    if (ok != pdPASS) {
        LISA_LOGE(TAG, "llm service task create failed");
        return -1;
    }

    int ret = ic_message_register_by_id(LLM_SERVICE_ID, llm_ipc_callback, NULL);
    if (ret != 0) {
        LISA_LOGE(TAG, "ic_message register failed: %d", ret);
        return -1;
    }

    /* 清零邮箱 */
    LLM_MB->state = LLM_MB_IDLE;
    LLM_MB->text[0] = '\0';
    mb_flush();

    LISA_LOGI(TAG, "llm service initialized (service_id=0x%x)", LLM_SERVICE_ID);
    return 0;
}
```

## src/neo.h
```c
// SPDX-License-Identifier: GPL-3.0-or-later
// SPDX-FileCopyrightText: Copyright (C) 2026 iamankushpandit <https://github.com/iamankushpandit>
//
// Part of Ivy AI -- https://github.com/iamankushpandit/esp_ai
// Free software under GPL-3.0-or-later, with the Espressif SDK linking
// exception in LICENSE.exception. Reusing any part of this file, in any
// work, must keep this notice, credit iamankushpandit as the author,
// and stay under the same licence with corresponding source offered.
// See LICENSE, LICENSE.exception, NOTICE.md and THIRD_PARTY.md.
//
// Ported from therezor/cardputer-ai (MIT) -- see THIRD_PARTY.md.

// GPT-Neo Q4 inference engine (CRDP v3 model blobs, CTK2 GPT-2 BPE tokenizer).
// C port of therezor/cardputer-ai main/llm.cpp (MIT, see LICENSE.cardputer-ai),
// GPT-Neo path only, with all memory taken from caller-provided phase arenas.
#pragma once
#include <stdbool.h>
#include <stddef.h>
#include <stdint.h>
#include "story_arena.h"

#ifdef __cplusplus
extern "C" {
#endif

typedef struct {
    int dim, hidden_dim, n_layers, n_heads, vocab_size, seq_len;
} neo_config_t;

typedef struct {
    neo_config_t c;
    int kv_len;
    // weights (point into the model blob: PSRAM copy or mmap'd flash)
    const float *ln1_g, *ln1_b, *ln2_g, *ln2_b, *lnf_g, *lnf_b;
    const float *bo, *b_fc, *b_proj, *wpe;
    const uint8_t *wte, *wq, *wk, *wv, *wo, *w1, *w2;
    size_t stride_attn, stride_w1, stride_w2;
    // run state (arena memory)
    float *x, *xb, *xb2, *hb, *q, *k, *v, *att, *logits;
    int8_t *xq;
    float *xs;
    int16_t *xss;             // per-block sum(xq)（点积偏置消除用）
    uint8_t *kc4, *vc4;       // int4 KV [L, kv_len, dim/2]
    uint16_t *kgs, *vgs;      // bf16 group scales [L, kv_len, dim/32]
    void *worker;             // dual-core matmul worker (target only)
} neo_t;

typedef struct {
    const uint8_t *base;
    size_t size;
    int vocab_size, max_len, eos_id, n_merges;
    const uint16_t *byte_ids;
    const uint16_t *merges;    // (a,b,c) sorted by (a,b)
    const uint8_t *pieces;
    uint32_t *piece_off;       // arena-built id -> offset index (O(1) decode)
} neo_tok_t;

typedef struct {
    float temperature;   // 0 = greedy
    float top_p;         // >= 1 disables nucleus
    uint64_t rng;
} neo_sampler_t;

/* 分层权重放置（ARCS CP 移植）：PSRAM 紧张时 wte（绑定输出头，~V*288B）
 * 可单独放 flash XIP，其余权重放压缩后的 PSRAM 副本。
 * - wte:  非 NULL 时使用该地址（16 字节对齐），忽略 blob 内原位置
 * - body: 非 NULL 时视为 [wte_end, blob_end) 字节的独立连续副本基地址，
 *         wq..w2 全部改按 body 相对偏移绑定
 * 两者均可为 NULL（全 blob 单块，原行为）。偏移算式与 neo_init 内一致。 */
typedef struct {
    const uint8_t *wte;
    const uint8_t *body;
} neo_split_t;

// Parse the header only (no allocation). Returns false on a bad blob.
bool neo_parse_config(const uint8_t *model, size_t size, neo_config_t *out);

// wte 在完整 blob 中的字节区间 [off, off+len)，以及 blob 完整长度
// （与 neo_init 绑定序列同步）。
bool neo_wte_span(const uint8_t *hdr64, size_t *off, size_t *len, size_t *total);

// Bind weights and allocate run state. Hot, small buffers go to `fast`
// (internal SRAM) when they fit, otherwise to `bulk` (PSRAM); each placement
// is logged. Returns false (after logging why) on any failure.
// split: optional tiered placement (wte in flash, body compacted in PSRAM).
bool neo_init(neo_t *m, const uint8_t *model, size_t size, int kv_len,
              story_arena_t *fast, story_arena_t *bulk, const neo_split_t *split);
void neo_deinit(neo_t *m);   // stops the worker task; arena memory is released by the phase

float *neo_forward(neo_t *m, int token, int slot, int abspos);
int neo_kv_slide(neo_t *m, int keep_head, int evict);

bool neo_tok_init(neo_tok_t *t, const uint8_t *data, size_t size, story_arena_t *arena);
// Encodes into tokens[max]; returns count, or -1 if it did not fit.
int neo_tok_encode(const neo_tok_t *t, const char *text, int *tokens, int max);
// Returns the byte string of a token (not NUL-terminated) and its length.
const char *neo_tok_piece(const neo_tok_t *t, int id, int *len);

void neo_sampler_init(neo_sampler_t *s, float temperature, float top_p, uint64_t seed);
int neo_sample(neo_sampler_t *s, float *logits, int vocab);

#ifdef __cplusplus
}
#endif
```

## src/story_llm.c
```c
// SPDX-License-Identifier: GPL-3.0-or-later
// SPDX-FileCopyrightText: Copyright (C) 2026 iamankushpandit <https://github.com/iamankushpandit>
//
// Part of Ivy AI -- https://github.com/iamankushpandit/esp_ai
// Free software under GPL-3.0-or-later, with the Espressif SDK linking
// exception in LICENSE.exception. Reusing any part of this file, in any
// work, must keep this notice, credit iamankushpandit as the author,
// and stay under the same licence with corresponding source offered.
// See LICENSE, LICENSE.exception, NOTICE.md and THIRD_PARTY.md.

// TinyTalk chat on the GPT-Neo engine. Prompt template from the fine-tune:
//   User: <u1>\nBot: <b1><eos>\nUser: <u2>\nBot:
#include "story_llm.h"
#include "story_log.h"
#include "story_mem.h"
#include <ctype.h>
#include <stdio.h>
#include <string.h>

static const char *TAG = "llm";

llm_params_t llm_default_params(void)
{
    llm_params_t p = {
        .temperature = 0.0f,   // chat 走贪心：事实类问题采样会丢分（esp_ai MODELS.md 15/16 vs 采样改错）
        .top_p = 0.9f,
        .soft_max_tokens = 48,
        .hard_max_tokens = 80,
        .kv_len = 128,
        .seed = 0,
    };
    return p;
}

void llm_history_clear(llm_history_t *h) { memset(h, 0, sizeof *h); }

static void copy_trim(char *dst, const char *src, size_t cap)
{
    while (*src == ' ') src++;
    size_t n = strlen(src);
    if (n >= cap) n = cap - 1;
    memcpy(dst, src, n);
    dst[n] = 0;
}

void llm_history_push(llm_history_t *h, const char *user, const char *bot)
{
    if (h->n == LLM_MAX_TURNS) {  // drop oldest
        memmove(h->user[0], h->user[1], sizeof(h->user[0]) * (LLM_MAX_TURNS - 1));
        memmove(h->bot[0], h->bot[1], sizeof(h->bot[0]) * (LLM_MAX_TURNS - 1));
        h->n--;
    }
    copy_trim(h->user[h->n], user, LLM_TURN_CHARS);
    copy_trim(h->bot[h->n], bot, LLM_TURN_CHARS);
    h->n++;
}

bool llm_load(llm_t *l, const llm_blobs_t *b, const llm_params_t *p, story_arena_t *fast,
              story_arena_t *bulk)
{
    memset(l, 0, sizeof *l);
    l->params = *p;
    int64_t t0 = story_time_us();
    if (!neo_tok_init(&l->tok, b->tok, b->tok_len, bulk)) return false;
    neo_split_t split = {.wte = b->wte, .body = b->body};
    if (!neo_init(&l->net, b->model, b->model_len, p->kv_len, fast, bulk,
                  (b->wte || b->body) ? &split : NULL)) {
        return false;
    }
    if (l->tok.vocab_size != l->net.c.vocab_size) {
        SLOGE(TAG, "tokenizer vocab %d != model vocab %d", l->tok.vocab_size, l->net.c.vocab_size);
        neo_deinit(&l->net);
        return false;
    }
    l->prompt = story_arena_alloc(bulk, sizeof(int) * l->net.kv_len, 4, "llm.prompt");
    if (!l->prompt) { neo_deinit(&l->net); return false; }
    l->loaded = true;
    SLOGI(TAG, "loaded in %lld ms", (long long)(story_time_us() - t0) / 1000);
    return true;
}

void llm_unload(llm_t *l)
{
    if (l->loaded) neo_deinit(&l->net);
    l->loaded = false;
}

// Encode "User: <u>\nBot:<b>" segments newest-first within budget.
static int build_prompt(llm_t *l, const llm_history_t *h, const char *q, int budget)
{
    char seg[LLM_TURN_CHARS * 2 + 32];
    int tmp[256];
    int *out = l->prompt;
    int n = 0;

    // Current question first (it must fit; truncate if not).
    snprintf(seg, sizeof seg, "User: %s\nBot:", q);
    int qn = neo_tok_encode(&l->tok, seg, tmp, 256);
    if (qn < 0 || qn > budget) {
        char qq[LLM_TURN_CHARS];
        copy_trim(qq, q, sizeof qq);
        for (int cut = (int)strlen(qq); cut > 0; cut -= 8) {
            qq[cut] = 0;
            snprintf(seg, sizeof seg, "User: %s\nBot:", qq);
            qn = neo_tok_encode(&l->tok, seg, tmp, 256);
            if (qn > 0 && qn <= budget) break;
        }
        if (qn <= 0 || qn > budget) return -1;
    }
    int used = qn;

    // Pick how many history turns fit, newest first.
    int first = h ? h->n : 0;
    while (first > 0) {
        snprintf(seg, sizeof seg, "User: %s\nBot: %s", h->user[first - 1], h->bot[first - 1]);
        int hn = neo_tok_encode(&l->tok, seg, tmp, 256);
        if (hn < 0 || used + hn + 2 > budget) break;
        used += hn + 2;  // + eos + "\n"
        first--;
    }
    int nl_tok[4];
    int nl_n = neo_tok_encode(&l->tok, "\n", nl_tok, 4);
    for (int i = first; h && i < h->n; i++) {
        snprintf(seg, sizeof seg, "User: %s\nBot: %s", h->user[i], h->bot[i]);
        n += neo_tok_encode(&l->tok, seg, out + n, budget - n);
        out[n++] = l->tok.eos_id;
        for (int k = 0; k < nl_n; k++) out[n++] = nl_tok[k];
    }
    snprintf(seg, sizeof seg, "User: %s\nBot:", q);
    int m = neo_tok_encode(&l->tok, seg, out + n, budget - n);
    if (m < 0) {  // truncated case: re-use tmp
        memcpy(out + n, tmp, qn * sizeof(int));
        m = qn;
    }
    return n + m;
}

// Shared decode loop. `chat` stops when the model starts a new "User" turn.
// A repetition guard stops (and trims) when a REP_N-token run repeats, which is
// how small models fall into loops ("who is the one who is the one ...").
#define REP_N 6
#define REP_HIST 96
static bool generate(llm_t *l, int n_prompt, bool chat, char *ans, size_t cap, llm_piece_cb cb,
                     void *user, llm_stats_t *st)
{
    const llm_params_t *p = &l->params;
    int kvL = l->net.kv_len;
    st->prompt_tokens = n_prompt;
    neo_sampler_t smp;
    neo_sampler_init(&smp, p->temperature, p->top_p, p->seed ? p->seed : (uint64_t)story_time_us());

    int gen_ids[REP_HIST];
    size_t gen_alen[REP_HIST];   // answer length before each generated token
    int64_t t0 = story_time_us();
    int pos = 0, abspos = 0, token = l->prompt[0];
    size_t alen = 0;
    bool pending_nl = false;
    st->stop_reason = "hard";
    int V = l->net.c.vocab_size;
    while (1) {
        if (l->stop) { st->stop_reason = "stopped"; break; }
        if (abspos >= l->net.c.seq_len - 1) { st->stop_reason = "ctx"; break; }
        if (pos >= kvL - 1) {
            int keep = kvL / 4 < n_prompt ? kvL / 4 : n_prompt;
            int ev = neo_kv_slide(&l->net, keep, kvL / 4);
            if (ev < 1) { st->stop_reason = "ctx"; break; }
            pos -= ev;
        }
        float *logits = neo_forward(&l->net, token, pos, abspos);
        int next;
        if (abspos < n_prompt - 1) {
            next = l->prompt[abspos + 1];
            if (abspos + 1 == n_prompt - 1) st->prefill_us = story_time_us() - t0;
        } else {
            next = neo_sample(&smp, logits, V);
            if (next == l->tok.eos_id) { st->stop_reason = "eos"; break; }
            int g = st->gen_tokens;
            if (g < REP_HIST) { gen_ids[g] = next; gen_alen[g] = alen; }
            st->gen_tokens++;
            // Repetition guard: last REP_N tokens seen before in this answer?
            if (g + 1 >= 2 * REP_N && g < REP_HIST) {
                int s = g + 1 - REP_N;
                for (int j = 0; j + REP_N <= s; j++) {
                    if (!memcmp(gen_ids + j, gen_ids + s, REP_N * sizeof(int))) {
                        alen = gen_alen[s];   // drop the repeated run
                        ans[alen] = 0;
                        st->stop_reason = "repeat";
                        goto out;
                    }
                }
            }
            int plen;
            const char *piece = neo_tok_piece(&l->tok, next, &plen);
            if (pending_nl) {
                // In chat mode a newline followed by "User" is the next turn.
                if (chat && plen >= 4 && !strncmp(piece, "User", 4)) { st->stop_reason = "turn"; break; }
                if (alen > 0 && alen + 1 < cap && !(plen > 0 && piece[0] == ' ')) ans[alen++] = ' ';
                pending_nl = false;
            }
            if (plen == 1 && piece[0] == '\n') {
                pending_nl = true;
            } else if (plen > 0) {
                const char *pc = piece;
                int pl = plen;
                if (alen == 0) while (pl > 0 && *pc == ' ') { pc++; pl--; }
                if (alen + pl >= cap || alen + pl >= LLM_ANSWER_CHARS) { st->stop_reason = "hard"; break; }
                memcpy(ans + alen, pc, pl);
                alen += pl;
                ans[alen] = 0;
                if (cb && pl > 0 && !cb(user, pc, pl)) { st->stop_reason = "stopped"; break; }
            }
            if (st->gen_tokens >= p->hard_max_tokens) { st->stop_reason = "hard"; break; }
            if (st->gen_tokens >= p->soft_max_tokens && alen > 0 &&
                strchr(".!?", ans[alen - 1])) { st->stop_reason = "soft"; break; }
        }
        token = next;
        pos++;
        abspos++;
    }
out:
    st->gen_us = story_time_us() - t0 - st->prefill_us;
    // If we were cut off mid-sentence (hard/repeat), end at the last sentence.
    if (strcmp(st->stop_reason, "eos") && strcmp(st->stop_reason, "soft")) {
        size_t k = alen;
        while (k > 0 && !strchr(".!?", ans[k - 1])) k--;
        if (k > 0) alen = k;
    }
    while (alen > 0 && isspace((unsigned char)ans[alen - 1])) alen--;
    ans[alen] = 0;
    return true;
}

bool llm_answer(llm_t *l, const llm_history_t *h, const char *q, char *ans, size_t cap,
                llm_piece_cb cb, void *user, llm_stats_t *st)
{
    llm_stats_t dummy;
    if (!st) st = &dummy;
    memset(st, 0, sizeof *st);
    ans[0] = 0;
    if (!l->loaded) { SLOGE(TAG, "answer: model not loaded"); return false; }
    l->stop = false;
    int n_prompt = build_prompt(l, h, q, l->net.kv_len - 16);
    if (n_prompt <= 0) { SLOGE(TAG, "prompt did not fit"); return false; }
    return generate(l, n_prompt, true, ans, cap, cb, user, st);
}

bool llm_story(llm_t *l, const char *topic, char *ans, size_t cap, llm_piece_cb cb, void *user,
               llm_stats_t *st)
{
    llm_stats_t dummy;
    if (!st) st = &dummy;
    memset(st, 0, sizeof *st);
    ans[0] = 0;
    if (!l->loaded) { SLOGE(TAG, "story: model not loaded"); return false; }
    l->stop = false;
    // TinyStories-Instruct's native format.
    char seg[LLM_TURN_CHARS + 32];
    char t[LLM_TURN_CHARS];
    copy_trim(t, topic, sizeof t);
    snprintf(seg, sizeof seg, "Summary: %s\nStory:", t);
    int n = neo_tok_encode(&l->tok, seg, l->prompt, l->net.kv_len - 16);
    if (n <= 0) { SLOGE(TAG, "story prompt did not fit"); return false; }
    // Stories get a longer budget than chat answers.
    llm_params_t saved = l->params;
    l->params.soft_max_tokens = saved.soft_max_tokens + 24;
    l->params.hard_max_tokens = saved.hard_max_tokens + 32;
    bool ok = generate(l, n, false, ans, cap, cb, user, st);
    l->params = saved;
    return ok;
}
```

## src/story_log.h
```c
// SPDX-License-Identifier: GPL-3.0-or-later
// SPDX-FileCopyrightText: Copyright (C) 2026 iamankushpandit <https://github.com/iamankushpandit>
//
// Part of Ivy AI -- https://github.com/iamankushpandit/esp_ai
// Free software under GPL-3.0-or-later, with the Espressif SDK linking
// exception in LICENSE.exception. Reusing any part of this file, in any
// work, must keep this notice, credit iamankushpandit as the author,
// and stay under the same licence with corresponding source offered.
// See LICENSE, LICENSE.exception, NOTICE.md and THIRD_PARTY.md.

// Logging shim: lisa_log on ARCS CP target, printf on host builds.
#pragma once
#ifdef STORY_HOST
#include <stdio.h>
#define SLOGE(tag, fmt, ...) fprintf(stderr, "E (%s) " fmt "\n", tag, ##__VA_ARGS__)
#define SLOGW(tag, fmt, ...) fprintf(stderr, "W (%s) " fmt "\n", tag, ##__VA_ARGS__)
#define SLOGI(tag, fmt, ...) fprintf(stderr, "I (%s) " fmt "\n", tag, ##__VA_ARGS__)
#else
#include "lisa_log.h"
#define SLOGE(tag, fmt, ...) LISA_LOGE(tag, fmt, ##__VA_ARGS__)
#define SLOGW(tag, fmt, ...) LISA_LOGW(tag, fmt, ##__VA_ARGS__)
#define SLOGI(tag, fmt, ...) LISA_LOGI(tag, fmt, ##__VA_ARGS__)
#endif
```
