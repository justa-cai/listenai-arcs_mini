## arcs-sdk/arcs-base/hal/chip/arcs/ipc/Kconfig
```kconfig
config ARCS_HAL_IPC
    bool "Enable ARCS HAL IPC"
    select ARCS_HAL_IC_LOCK
    default n
    help
        Enable IPC (Inter-Process Communication) support

if ARCS_HAL_IPC
    config ARCS_HAL_IPC_UTILS_IPC_FUNC_SECTION
        string "IPC utils function section"
        default .itcm_text
        help
            Enable IPC utils function section

    choice
        prompt "arcs hal wifi/lwip ipc type"
        default ARCS_HAL_IPC_MASTER if LWIP
        default ARCS_HAL_IPC_SLAVE if WIFI
        config ARCS_HAL_IPC_SLAVE
            bool "IPC Slave"
            select ARCS_HAL_IPC_MRPC_SERVER_WIFI if WIFI_LWIP_DIFF_CORE
            select ARCS_HAL_IPC_MRPC_CLIENT_LWIP if WIFI_LWIP_DIFF_CORE
        config ARCS_HAL_IPC_MASTER
            bool "IPC Master"
            select ARCS_HAL_IPC_MRPC_CLIENT_WIFI if WIFI_LWIP_DIFF_CORE
            select ARCS_HAL_IPC_MRPC_SERVER_LWIP if WIFI_LWIP_DIFF_CORE
    endchoice

    config ARCS_HAL_IPC_MRPC_SERVER
        bool "Enable MRPC server"
        default y
        help
            Enable MRPC (Message Remote Procedure Call) server support

    config ARCS_HAL_IPC_MRPC_CLIENT
        bool "Enable MRPC client"
        default y
        help
            Enable MRPC (Message Remote Procedure Call) client support

    config ARCS_HAL_IPC_MRPC_SERVER_LWIP
        bool "Enable LWIP MRPC server"
        default n
        select ARCS_HAL_IPC_MRPC_SERVER
        help
            Enable MRPC server for LWIP API

    config ARCS_HAL_IPC_MRPC_CLIENT_LWIP
        bool "Enable LWIP MRPC client"
        default n
        select ARCS_HAL_IPC_MRPC_CLIENT
        help
            Enable MRPC client for LWIP API

    config ARCS_HAL_IPC_MRPC_SERVER_WIFI
        bool "Enable WIFI MRPC server"
        default n
        select ARCS_HAL_IPC_MRPC_SERVER
        help
            Enable MRPC server for WIFI API

    config ARCS_HAL_IPC_MRPC_CLIENT_WIFI
        bool "Enable WIFI MRPC client"
        default n
        select ARCS_HAL_IPC_MRPC_CLIENT
        help
            Enable MRPC client for WIFI API

    config ARCS_HAL_IPC_MRPC_SERVER_NVS
        bool "Enable NVS MRPC server"
        default n
        select ARCS_HAL_IPC_MRPC_SERVER
        help
            Enable MRPC server for NVS API

    config ARCS_HAL_IPC_MRPC_CLIENT_NVS
        bool "Enable NVS MRPC client"
        default n
        select ARCS_HAL_IPC_MRPC_CLIENT
        help
            Enable MRPC client for NVS API
    
    config ARCS_HAL_IPC_MRPC_SERVER_UTILS
        bool "Enable utils MRPC server"
        default n
        select ARCS_HAL_IPC_MRPC_SERVER
        help
            Enable MRPC server for utils API

    config ARCS_HAL_IPC_MRPC_CLIENT_UTILS
        bool "Enable utils MRPC client"
        default n
        select ARCS_HAL_IPC_MRPC_CLIENT
        help
            Enable MRPC client for utils API

    config ARCS_HAL_IPC_MRPC_CLIENT_FLASH_IF
        bool "Enable flash if MRPC client"
        default n
        select ARCS_HAL_IPC_MRPC_CLIENT
        help
            Enable MRPC client for flash if API

    config ARCS_HAL_IPC_MRPC_SERVER_FLASH_IF
        bool "Enable flash if MRPC server"
        default n
        select ARCS_HAL_IPC_MRPC_SERVER
        help
            Enable MRPC server for flash if API

    config ARCS_HAL_IPC_MRPC_CLIENT_OTP
        bool "Enable otp MRPC client"
        default n
        select ARCS_HAL_IPC_MRPC_CLIENT
        help
            Enable MRPC client for otp API
    
    config ARCS_HAL_IPC_MRPC_SERVER_OTP
        bool "Enable otp MRPC server"
        default n
        select ARCS_HAL_IPC_MRPC_SERVER
        help
            Enable MRPC server for otp API
 
    config ARCS_HAL_IPC_HALT_BY_PEER_CORE
        bool "Halt by peer core"
        default n
        help
            Halt by peer core

    config ARCS_HAL_IPC_HALT_PEER_CORE
        bool "Halt peer core"
        default n
        help
            Halt peer core
    
    config ARCS_HAL_IPC_FLASH_AGENT
        bool "Enable flash agent"
        default n
        depends on ARCS_HAL_FLASH_IF
        help
            Enable flash agent

endif
```

## arcs-sdk/arcs-base/hal/chip/arcs/lib/Kconfig.wifi
```kconfig
menuconfig WIFI
    bool "WiFi Support"
    default n
    select ARCS_HAL_VRTC
    select ARCS_HAL_WCND
    select RTOS_AL
    select SDK_MODULE_MBEDTLS
    select MBEDTLS_HSU
    help
        Enable WiFi support including core WiFi functionality

choice WIFI_LWIP_CORE_MODE
    prompt "WiFi and LWIP Core Mode"
    default WIFI_LWIP_DIFF_CORE if WIFI || LWIP
    help
        Select the core mode for WiFi and LWIP.
        For compatibility, please choose according to your hardware and software configuration.

config WIFI_LWIP_SAME_CORE
    bool "WiFi and LWIP run on the same core"
    help
        Select this if both WiFi stack and LWIP stack run on the same CPU core.

config WIFI_LWIP_DIFF_CORE
    bool "WiFi and LWIP run on different cores"
    select ARCS_HAL_SIMSOCKET if WIFI
    select ARCS_HAL_IPC
    help
        Select this if WiFi stack and LWIP stack run on different CPU cores.
        This mode may be used for specific performance optimization or multi-core architecture.

endchoice


if WIFI

config MEM_WIFI_LA_DUMP_SIZE
    int "WiFi LA dump size"
    default 32768
    help
        WiFi LA dump size

config WIFI_CALI_BUF
    bool "Enable exclusive calibration buffer"
    default n
    help
        Enable exclusive calibration buffer

config WIFI_TX_BUF_COPY
    bool "Enable WiFi TX buffer copy"
    default n
    help
        Enable WiFi TX buffer copy


choice
    prompt "WiFi Mode"
    default WIFI_STA
    config WIFI_AP
        bool "WiFi Access Point Mode"
        default n
        help
        Enable WiFi Access Point (AP) mode support

    config WIFI_STA
        bool "WiFi Station Mode"
        default n
        help
        Enable WiFi Station (STA) mode support

endchoice

endif # WIFI
```

## arcs-sdk/arcs-base/hal/chip/arcs/wcnd/Kconfig
```kconfig
config ARCS_HAL_WCND
    bool "Enable ARCS HAL WCND"
    depends on WIFI
    default n
    help
        Enable WCND (Wireless Controller Network) support

if ARCS_HAL_WCND
    choice
        prompt "mac addr implementation"
        default ARCS_HAL_WCND_MAC_TRUE
        
        config ARCS_HAL_WCND_MAC_TRUE
            bool "true mac address from efuse"
        config ARCS_HAL_WCND_MAC_FAKE
            bool "fake mac address"
    endchoice

    config ARCS_HAL_WCND_CFG_DPD_LUNA
        bool "Enable DPD Luna"
        default n
        help
            Enable DPD Luna support

    config ARCS_HAL_WCND_GPADC_IC_MUTEX
        bool "Enable GPADC IC Mutex for multi cores"
        depends on ARCS_HAL_IC_MUTEX
        default n
        help
            Enable GPADC IC Mutex for multi cores
    
    config ARCS_HAL_WCND_RF_SELFCALI_FROM_NV
        bool "Enable RF selfcali from nv"
        default n
        help
            Enable RF selfcali from nv
    
    config ARCS_HAL_WCND_RF_SELFCALI_WRITE_TO_NV
        bool "Enable RF selfcali write to nv"
        default n
        help
            Enable RF selfcali write to nv
    
    config ARCS_HAL_WCND_USE_FLASH_OTP
        bool "Enable RF flash otp"
        default y
        help
            Enable RF flash otp

    config ARCS_HAL_WCND_RF_BOARD_VER
        int "RF Board Version"
        default 0
        help
            RF Board Version

endif
```

## arcs-sdk/arcs-base/hal/chip/arcs/wlif/Kconfig
```kconfig
config ARCS_HAL_WLIF
    bool "Enable ARCS HAL WLIF"
    default n
    help
        Enable WLIF (Wireless Link Interface) support
```

## arcs-sdk/arcs-base/hal/modules/profiles/Kconfig
```kconfig
# BLE Profiles Kconfig aggregator

menu "BLE Profiles"
    depends on BLE

rsource "hogp/Kconfig"
rsource "bas/Kconfig"
rsource "dis/Kconfig"
rsource "netcfg_ble/netcfg_bles/Kconfig"

endmenu
```

## arcs-sdk/arcs-base/hal/modules/profiles/bas/Kconfig
```kconfig
config BLE_PROFILE_BASC
    bool "Enable BLE Profile BAS Client"
    default n
    help
        Enable BLE Battery Service Client (BAS-C) support

config BLE_PROFILE_BASS
    bool "Enable BLE Profile BAS Server"
    default n
    help
        Enable BLE Battery Service Server (BAS-S) support
```

## arcs-sdk/arcs-base/hal/modules/profiles/dis/Kconfig
```kconfig
config BLE_PROFILE_DISC
    bool "Enable BLE Profile DISC over BLE Server"
    default n
    help
        Enable BLE-based Device Information Client support

config BLE_PROFILE_DISS
    bool "Enable BLE Profile DISS over BLE Server"
    default n
    help
        Enable BLE-based Device Information Service support
```

## arcs-sdk/arcs-base/hal/modules/vrtc/Kconfig
```kconfig
config ARCS_HAL_VRTC
    bool "Virtual RTC Support in HAL"
    default n
    help
        Enable Virtual RTC support in HAL
```

## arcs-sdk/arcs-base/startup/Kconfig
```kconfig
menu "ARCS System Startup Configuration"

rsource "arcs/Kconfig"

config ARCS_STARTUP_CONFIG
    bool "ARCS startup config"
    default y
    imply MODULE_FREERTOS
    imply MODULE_HEAP
    imply LOG
    imply ARCS_HAL_WARNING_DISABLE
    imply BOOT_HART

if ARCS_STARTUP_CONFIG

choice
    prompt "core type"
    default ARCS_CP_CORE

    config ARCS_AP_CORE
        bool "ap core"
        imply FPU

    config ARCS_CP_CORE
        bool "cp core"

endchoice

config ARCS_STARTUP_CUSTOM_LINKER_FILE
    bool "ARCS startup custom linker file"
    default n

config PSRAM_INIT
    bool "PSRAM init"
    default n

config CLOCK_INIT
    bool "CLOCK init"
    default n

config BOOT
    bool "BOOT embedded"
    default y
    depends on ARCS_CP_CORE

endif
endmenu

if BOOT
    orsource "boot/Kconfig.boot"
endif
```

## arcs-sdk/arcs-base/startup/arcs/Kconfig.heap
```kconfig
menu "heap"

config HEAP
    bool
    default y
    help
        Enable the heap

config HEAP_SIZE
    hex "Heap size"
    default 0x5000
    depends on HEAP
    help
        Size of the heap in bytes

config PSRAM_HEAP
    bool "Enable PSRAM heap"
    default y
    help
        Enable the PSRAM heap

config PSRAM_HEAP_SIZE
    hex "PSRAM heap size"
    default 0x20000
    depends on PSRAM_HEAP
    help
        Size of the PSRAM heap in bytes

config PSRAM_NOCACHE_HEAP
    bool "Enable non-cache PSRAM heap"
    default n
    help
        Enable the non-cache PSRAM heap
    
if PSRAM_NOCACHE_HEAP
config PSRAM_NOCACHE_HEAP_SIZE
    hex "no-cache PSRAM heap size"
    default 0x1000
    help
        Size of the non-cache PSRAM heap in bytes, must be a power of 2.
endif

endmenu
```

## arcs-sdk/boards/Kconfig
```kconfig
# ARCS BOARD CONFIGURATION
#
# Copyright (c) 2025, LISTENAI
# SPDX-License-Identifier: Apache-2.0

osource "$BOARD_KCONFIG_PATH"
```

## arcs-sdk/boards/arcs_evb/Kconfig
```kconfig
# Board Configuration
#
# Copyright (c) 2025, LISTENAI
# SPDX-License-Identifier: Apache-2.0

config BOARD_NAME
	string
	default "arcs_evb"
	prompt "Board Name"
	help
		Board Name

config BOARD_ARCS_EVB
	bool
	default y
	select SOC_LS2684
	help
		Board is arcs_evb

config BOARD_PANEL_ST7789P3
	bool
	default y

config BOARD_PANEL_ST7789P3_WIDTH
	int
	default 320

config BOARD_PANEL_ST7789P3_HEIGHT
	int
	default 240

config BOARD_PANEL_ST7789P3_X_OFFSET
	int
	default 0

config BOARD_PANEL_ST7789P3_Y_OFFSET
	int
	default 0
```
