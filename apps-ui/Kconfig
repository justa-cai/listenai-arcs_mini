## apps-ui/Kconfig
```kconfig
menu  "Application UI"

config APPLICATION_UI
    bool "application ui"
    default n

if APPLICATION_UI

config ALARM_RING_AUTO_RETURN_MS
    int "Alarm ring UI auto return timeout (ms)"
    default 60000
    help
        Time before alarm ring page automatically returns to Home.

config TTS_TEXT_MS_PER_CHAR
    int "TTS text display time per character (ms)"
    default 250
    help
        Display duration per spoken character for TTS subtitle text.
        Can be overridden at runtime via KV key user.tts_text_ms_per_char.

menu "NES Game"
    visible if APPLICATION_UI

config GAME_NES_ENABLE
    bool "Enable NES game screen"
    default n

config GAME_NES_AUDIO_ENABLE
    bool "Enable NES APU audio playback"
    default y
    depends on GAME_NES_ENABLE

config GAME_NES_FRAME_SKIP
    int "Logic frames per drawn frame (1 = draw every frame)"
    default 1
    range 0 4
    depends on GAME_NES_ENABLE

config GAME_NES_PERF_LOG_ENABLE
    bool "Enable periodic performance log"
    default y
    depends on GAME_NES_ENABLE

config GAME_NES_FAST_VISIBLE_RENDER
    bool "Fast visible-region render"
    default y
    depends on GAME_NES_ENABLE

config GAME_NES_FAST_PPU_PACKED_PATTERN
    bool "Pack CHR pattern rows into 16-bit words"
    default y
    depends on GAME_NES_ENABLE

config GAME_NES_FAST_CPU_BRANCH
    bool "Fast CPU branch dispatch"
    default y
    depends on GAME_NES_ENABLE

config GAME_NES_FAST_CPU_JMP_IDLE
    bool "Fast JMP idle detection"
    default y
    depends on GAME_NES_ENABLE

config GAME_NES_FAST_SKIP_SPRITES
    bool "Skip sprite rendering when sprites hidden"
    default y
    depends on GAME_NES_ENABLE

config GAME_NES_MAPPER_INFONES_ENABLE
    bool "Enable InfoNES mapper compatibility layer"
    default y
    depends on GAME_NES_ENABLE

config GAME_NES_MAPPER_INFONES_DEFAULT_SET
    bool "Enable the default InfoNES mapper set"
    default y
    depends on GAME_NES_MAPPER_INFONES_ENABLE

endmenu

endif

endmenu
```

## apps/arcs-mini/Kconfig
```kconfig
osource "$ARCS_BASE/Kconfig"

menu "Voice Application"

rsource "../../modules/Kconfig"
rsource "../../src/Kconfig"
orsource "../../apps-ui/Kconfig"

rsource "miniapp/Kconfig"

config APP_CAMERA_SERVICE
    bool "Start camera service at boot"
    default y
    help
      Camera service allocates two DVP frame buffers (~1.2MB PSRAM) at
      boot. Disable on memory-constrained builds (e.g. on-device LLM)
      to reclaim the runtime heap; UI camera flows then fail gracefully.

config LLM_TERMINAL_UI
    bool "LLM terminal as the only desktop UI"
    default n
    help
      Replace the standard app UI (home/standby/QR/emoji pages and their
      models) with a fullscreen LVGL terminal chatting with the AP-side
      LLM. Input comes from the network keyboard (UDP, tools/llmkb).
      Single-click button navigation to HOME is disabled accordingly.

config LLMTERM_TTS
    bool "Speak LLM answers via cloud TTS"
    default y
    depends on LLM_TERMINAL_UI
    help
      Subscribe to the streaming LLM answer in the terminal and speak
      each finished sentence through the cloud TTS pipeline
      (voice_cloud_tts_synth + voice_player_tts). Requires WiFi and the
      LSC cloud session; silently skipped when offline. Runtime toggle:
      "llmterm tts on|off".

config LLMTERM_ASR
    bool "Push-to-talk cloud ASR input for the terminal"
    default y
    depends on LLM_TERMINAL_UI && LS_CHAT
    help
      Hold the power/function key (PB4) to record, recognize via the
      AIUI cloud IAT session (NLU/TTS replies suppressed) and auto
      submit the text as a question to the LLM. Requires WiFi and the
      LSC cloud session; shows a hint and records nothing while
      offline. Runtime toggle: "llmterm asr on|off".

config CP_FIRMWARE_COMPAT
    bool "Embed CP PSRAM range"
    default y
    help
      Store the CP PSRAM base and size selected by prj.conf immediately after the
      standard ARCS image header so AP can reject an incompatible CP image.

config CP_FIRMWARE_COMPAT_OFFSET
    hex "CP PSRAM range image offset"
    default 0x180
    depends on CP_FIRMWARE_COMPAT
    help
      Offset from the CP image base. Keep this synchronized with AP.

endmenu
```

## apps/arcs-mini/miniapp/Kconfig
```kconfig
menuconfig MINIAPP
    bool "Lua miniapps"
    default y
    help
      Run cloud-delivered Lua source in PSRAM. Source is transient; bounded app data can be saved in KV.

if MINIAPP

config MINIAPP_ADB_DEBUG
    bool "Debug local Lua scripts with adb push/pull"
    depends on ADB && CHERRYUSB_APP_CLASS && !ADB_SYNC
    default y
    help
      Register a small sync service for /miniapp/<id>.lua only. Receive
      source in PSRAM and start it without a filesystem or cloud download.
      Keep the active source for adb pull /miniapp/miniapp.lua. The source
      snapshot uses at most MINIAPP_SOURCE_MAX_BYTES plus a small header;
      an in-progress pull retains its snapshot across replacement or exit.
      Full ADB sync must stay disabled because both use the sync service.

config MINIAPP_SOURCE_MAX_BYTES
    int "Maximum Lua source bytes"
    range 1024 262144
    default 65536
    help
      Upper bound on one app's Lua source. Raising it also needs a matching
      MINIAPP_CHUNK_DEADLINE_MS: parsing is charged to the chunk budget, and
      the device parses about 130 bytes/ms, so 128 KiB already costs ~1 s
      before a single statement runs. Application-level opt-in only; the
      default keeps a startup stall under the original 1 s window.

config MINIAPP_HEAP_MAX_BYTES
    int "Maximum heap bytes per Lua VM"
    range 65536 524288
    default 393216
    help
      Replacing an active app temporarily needs two VMs for rollback.

config MINIAPP_SCREEN
    bool "Expose screen drawing"
    depends on APPLICATION_UI
    default y

config MINIAPP_SCREEN_WIDTH
    int "Miniapp screen width"
    range 1 2048
    default 240

config MINIAPP_SCREEN_HEIGHT
    int "Miniapp screen height"
    range 1 2048
    default 240

config MINIAPP_BUTTON
    bool "Expose the function button"
    default y

config MINIAPP_LED
    bool "Expose the status LED"
    default y

config MINIAPP_BUZZER
    bool "Expose speaker-generated tones"
    default y

endif

config MINIAPP_BUILTIN_APP
    bool "Autostart a Lua app from the luaapp flash partition"
    default n
    help
      Boot the firmware with one Lua app preloaded in flash. The app lives
      in a ROMFS image flashed at 0x580000 (partition "luaapp", between
      respak and app). A delayed task mounts it ~15 s after boot, installs
      /radio.lua under id "local:radio" and starts it. adb push to the
      same id still replaces it at runtime; the builtin copy returns on
      the next reboot. Skipped while a voice session is active.

config MINIAPP_BUILTIN_DELAY_MS
    int "Builtin app autostart delay"
    depends on MINIAPP_BUILTIN_APP
    range 3000 120000
    default 15000
    help
      Boot grace period before the builtin app takes the screen. Wait for
      network attach and the first UI paint, and keep voice interaction
      responsive during startup.
```

## apps/arcs-mini/pet/Kconfig
```kconfig
menuconfig PET
    bool "Tamagotchi virtual pet"
    depends on APPLICATION_UI
    default y
    help
      Run a Tamagotchi P1 emulator (TamaLIB, GPLv2) as a full-screen pet on
      the device. The pet is voice-controlled via the pet_care MCP tool,
      survives power cycles through lisa_kv and beeps through the miniapp
      player when MINIAPP_BUZZER is enabled.

if PET

config PET_BUZZER
    bool "Pet piezo beep synthesis"
    depends on MINIAPP_BUZZER
    default y
    help
      Synthesize the original piezo beeps as 16 kHz square waves. Without
      this (or without MINIAPP_BUZZER) the pet stays silent.

endif
```

## apps/arcs-mini/soundsense/Kconfig
```kconfig
menuconfig SOUNDSENSE
    bool "SoundSense abnormal-sound detection (cry/snoring)"
    default y
    help
      Stream microphone PCM to a LAN SoundSense server over WebSocket
      (docs/SoundSense_PROTOCOL.md) and surface snoring/baby_cry events.

if SOUNDSENSE

config SOUNDSENSE_SCREEN
    bool "Auto screen blanking + event wake"
    default y
    help
      Blank the panel after inactivity (30 s daytime / 10 s after 22:00),
      wake on button/voice/detection events.

endif
```

## apps/arcs-mini/video/Kconfig
```kconfig
# SPDX-License-Identifier: Apache-2.0

menu "Video player"

config VIDEO_PLAYER
    bool "Enable online H264/AAC stream video player"
    default n
    help
        Online H264+AAC stream player: pulls an HTTP MPEG-TS live stream,
        decodes H264 in software (h264dec component), converts YUV420P to
        RGB565 for the LVGL video page and plays AAC through app_player.
        No local storage involved. Requires CONFIG_H264DEC and
        CONFIG_LISA_HTTP to be enabled as well.

if VIDEO_PLAYER

config VIDEO_PLAYER_MAX_W
    int "Maximum video width"
    default 240
    help
        Playback ceiling; streams with larger resolution are rejected.

config VIDEO_PLAYER_MAX_H
    int "Maximum video height"
    default 240
    help
        Playback ceiling; streams with larger resolution are rejected.

endif # VIDEO_PLAYER

endmenu
```

## arcs-sdk/Kconfig
```kconfig
# Copyright (c) 2025, LISTENAI
# SPDX-License-Identifier: Apache-2.0

menu "LISTENAI SDK"

rsource "system/Kconfig"
rsource "soc/Kconfig"
rsource "components/Kconfig"
rsource "drivers/Kconfig"
rsource "boards/Kconfig"
rsource "modules/Kconfig"
rsource "cmake/Kconfig"

endmenu
```

## arcs-sdk/arcs-base/freertos/Kconfig
```kconfig
menuconfig MODULE_FREERTOS
    bool "FreeRTOS Module"
    default y
    help
        Free RTOS(Real Time Operation System)

config FREERTOS_STATIC_ALLOCATION_ENABLE
    bool "support static allocation"
    default n
    help
        support static allocation
    depends on MODULE_FREERTOS

config FREERTOS_FAST_FUNC_SECTION
    string "freertos fast function section name"
    default ".fast_text"
    help
      freertos fast function section name
    depends on MODULE_FREERTOS

config FREERTOS_TIMER_TASK_STACK_SIZE
    int "freertos timer task stack size"
    default 1024
    help
      freertos timer task stack size
    depends on MODULE_FREERTOS

config FREERTOS_STACK_HW_CHECK
    bool "support stack hw check"
    default y
    help
        support stack hw check
    depends on MODULE_FREERTOS

config FREERTOS_STATIC_STACK_MEM_SECTION_ENABLE
    bool "support static stack mem section"
    default n
    help
      support static stack mem section
    depends on MODULE_FREERTOS

if FREERTOS_STATIC_STACK_MEM_SECTION_ENABLE
    config FREERTOS_STATIC_STACK_MEM_SECTION
        string "freertos static stack mem section name"
        default ""
        help
        freertos static stack mem section name
endif

menuconfig RISCV_FPU
    bool "support fpu"
    default n
    help
        support fpu
```

## arcs-sdk/arcs-base/hal/chip/arcs/atcmd/Kconfig
```kconfig
config ARCS_HAL_AT_CMD
    bool "Enable ARCS HAL AT CMD"
    default n
    help
        Enable AT CMD support
```

## arcs-sdk/arcs-base/hal/chip/arcs/btos/Kconfig
```kconfig
config ARCS_HAL_BTOS
    bool "Enable ARCS HAL BTOS"
    default n
    help
        Enable BTOS support
```

## arcs-sdk/arcs-base/hal/chip/arcs/cli_cmd/Kconfig
```kconfig
config ARCS_HAL_CLI_CMD
    bool "Enable ARCS HAL CLI CMD"
    default n
    imply ARCS_HAL_CLI_CMD_CFG_WIFI_MFG
    help
        Enable CLI CMD (Command Line Interface Command) support

if ARCS_HAL_CLI_CMD
    config ARCS_HAL_CLI_CMD_CFG_WIFI_MFG
        bool "Enable CFG WIFI MFG in CLI CMD"
        default n
        help
            Enable CFG WIFI MFG in CLI CMD support
endif
```

## arcs-sdk/arcs-base/hal/chip/arcs/flash_if/Kconfig
```kconfig
config ARCS_HAL_FLASH_IF
    bool "Flash Interface"
    default n
    help
        Flash Interface

if ARCS_HAL_FLASH_IF

endif
```

## arcs-sdk/arcs-base/hal/chip/arcs/ic_lock/Kconfig
```kconfig
config ARCS_HAL_IC_LOCK
    bool "Inter-cores Lock"
    default n
    help
        Inter-cores Lock

if ARCS_HAL_IC_LOCK
endif
```
